AUTOSAR XML (schema 4-2-2)
package /System_EcuExtract
  system EXTR_BMS: category=ECU_EXTRACT, ecu-extract-version=1.0.0, system-version=1.0.0
    system mapping SYSMPG_BMS
      data-mappings:
        data-element=CPT_BMS_FlatView.crash_r.DataElements_VariableDataPrototype_0, system-signal=TMR_VoltageHV
        data-element=CPT_BMS_FlatView.soc_p.DataElements_VariableDataPrototype_0, system-signal=BMS_BattCellOrder18Vol
      sw-mappings:
        swc to ecu mapping SwcToEcuMapping_0: component=[CPT_BMS_FlatView.CPT_ComM, CPT_BMS_FlatView.CPT_swc], ecu-instance=BMS
    root-software-compositions:
      root sw composition prototype CPT_BMS_FlatView: flat-map=BMS_FlatMap, software-composition=BMS_FlatView
