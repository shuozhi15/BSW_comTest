AUTOSAR XML (schema 4-2-2)
package /ARPackage_0
  sender receiver interface soc
    data soc_p: type=uint16
  sender receiver interface crash
    data crash_r: type=uint8
