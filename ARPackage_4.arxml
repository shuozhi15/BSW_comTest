AUTOSAR XML (schema 4-2-2)
package /ARPackage_4
  system System_0: category=SYSTEM_DESCRIPTION, system-version=1.0.0
    system mapping SystemMapping_0
      data-mappings:
        data-element=CPT_swc.RootSwCompositionPrototype_0.PPortPrototype_0.DataElements_VariableDataPrototype_0, system-signal=BMS_BattTempSensorOrder26
        data-element=CPT_swc.RootSwCompositionPrototype_0.RPortPrototype_0.DataElements_VariableDataPrototype_0, system-signal=TMR_VoltageHV
      sw-mappings:
        swc to ecu mapping SwcToEcuMapping_0: ecu-instance=BMS
          component:
            RootSwCompositionPrototype_0.CPT_swc
            RootSwCompositionPrototype_0.CPT_ComM
            RootSwCompositionPrototype_0.CPT_BswM
            RootSwCompositionPrototype_0.CPT_EcuM
    root-software-compositions:
      root sw composition prototype RootSwCompositionPrototype_0: software-composition=CompositionSwComponentType_0
