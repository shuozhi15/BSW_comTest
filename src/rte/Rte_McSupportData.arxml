AUTOSAR XML (schema 4-2-2)
package /AUTOSAR_Rte/BswImplementations
  bsw implementation Rte: mc-support=mc-sw-emulation-method-support=category=NONE
