AUTOSAR XML (schema 4-2-2)
standard types defined: uint8_least, uint16, uint8
package /AUTOSAR_Rte/BswModuleDescriptions
  bsw module description Rte: outgoing-callbacks=[Rte_StartHook_Return, Rte_StartHook_Start, Rte_StopHook_Return, Rte_StopHook_Start, Rte_Task_Activate]
    provided-entrys:
      Rte_ActivateRE
      Rte_DecrementWaitingCount
      Rte_GetCurrentTaskIndex
      Rte_ImplWrite_swc_PPortPrototype_0_DataElements_VariableDataPrototype_0
      Rte_MainFunction
      Rte_ReadQueue
      Rte_SetEvent
      Rte_Start
      Rte_Stop
      Rte_WaitWithTimeout
      Rte_WriteQueue
      Rte_memcpy
      SchM_Deinit
      SchM_Init
    bsw module dependency AUTOSAR_Os: target-module-id=1
      required-entrys:
        ActivateTask
        GetResource
        ReleaseResource
        ResumeOSInterrupts
        Rte_ResumeAllInterrupts
        Rte_SuspendAllInterrupts
        SuspendOSInterrupts
        TerminateTask
    bsw module dependency AUTOSAR_Com: target-module-id=50, required-entrys=[Com_ReceiveSignal, Com_SendSignal], expected-callbacks=Rte_COMCbk_TMR_VoltageHV
    bsw internal behavior RteInternalBehavior
      constant-memorys:
        9 x parameter data prototype:
          Rte_Inst_BswM: type=Rte_CDS_BswM
          Rte_Inst_ComM: type=Rte_CDS_ComM
          Rte_Inst_EcuM: type=Rte_CDS_EcuM
          Rte_Inst_swc: type=Rte_CDS_swc
          Rte_Self_CPT_BswM: type=Rte_SelfType_BswM
          Rte_Self_CPT_ComM: type=Rte_SelfType_ComM
          Rte_Self_CPT_EcuM: type=Rte_SelfType_EcuM
          Rte_Self_CPT_swc: type=Rte_SelfType_swc
          Rte_Tasks: type=Rte_TaskInfo
      static-memorys:
        data Rte_ImplicitBufs: type=Rte_ImplicitBufsType
        data Rte_Rx_000000: type=uint8_least
        data Rte_Rx_000001: type=uint16
      15 x bsw called entity, all with sw-addr-method=CODE:
        Rte_ActivateRE: implemented-entry=Rte_ActivateRE
        Rte_COMCbk_TMR_VoltageHV: implemented-entry=Rte_COMCbk_TMR_VoltageHV
        Rte_DecrementWaitingCount: implemented-entry=Rte_DecrementWaitingCount
        Rte_GetCurrentTaskIndex: implemented-entry=Rte_GetCurrentTaskIndex
        Rte_ImplWrite_swc_PPortPrototype_0_DataElements_VariableDataPrototype_0: implemented-entry=Rte_ImplWrite_swc_PPortPrototype_0_DataElements_VariableDataPrototype_0
        Rte_MainFunction: implemented-entry=Rte_MainFunction
        Rte_ReadQueue: implemented-entry=Rte_ReadQueue
        Rte_SetEvent: implemented-entry=Rte_SetEvent
        Rte_Start: implemented-entry=Rte_Start
        Rte_Stop: implemented-entry=Rte_Stop
        Rte_WaitWithTimeout: implemented-entry=Rte_WaitWithTimeout
        Rte_WriteQueue: implemented-entry=Rte_WriteQueue
        Rte_memcpy: implemented-entry=Rte_memcpy
        SchM_Deinit: implemented-entry=SchM_Deinit
        SchM_Init: implemented-entry=SchM_Init
package /AUTOSAR_Rte/BswModuleEntrys
  19 x bsw module entry:
    Rte_ActivateRE: call-type=REGULAR
    Rte_DecrementWaitingCount: call-type=REGULAR
    Rte_GetCurrentTaskIndex: call-type=REGULAR
    Rte_ImplWrite_swc_PPortPrototype_0_DataElements_VariableDataPrototype_0: call-type=REGULAR
    Rte_MainFunction: call-type=REGULAR
    Rte_ReadQueue: call-type=REGULAR
    Rte_SetEvent: call-type=REGULAR
    Rte_Start: call-type=REGULAR
    Rte_StartHook_Return: call-type=CALLBACK
    Rte_StartHook_Start: call-type=CALLBACK
    Rte_Stop: call-type=REGULAR
    Rte_StopHook_Return: call-type=CALLBACK
    Rte_StopHook_Start: call-type=CALLBACK
    Rte_Task_Activate: call-type=CALLBACK
    Rte_WaitWithTimeout: call-type=REGULAR
    Rte_WriteQueue: call-type=REGULAR
    Rte_memcpy: call-type=REGULAR
    SchM_Deinit: call-type=REGULAR
    SchM_Init: call-type=REGULAR
package /AUTOSAR_Rte/BswImplementations
  bsw implementation Rte: programming-language=C, sw-version=0.0.0, used-code-generator=ETAS RTEGen, ar-release-version=4.0.0, behavior=RteInternalBehavior
    generated-artifacts:
      34 x dependency on artifact:
        Com_h: artifact-descriptor={short-label=Com_h, category=SWHDR, domain=AUTOSAR}
        Ioc_h: artifact-descriptor={short-label=Ioc_h, category=SWHDR, domain=AUTOSAR}
        NvM_h: artifact-descriptor={short-label=NvM_h, category=SWHDR, domain=AUTOSAR}
        Os_h: artifact-descriptor={short-label=Os_h, category=SWHDR, domain=AUTOSAR}
        OsTask_0_h: artifact-descriptor={short-label=OsTask_0_h, category=SWHDR, domain=AUTOSAR}
        Rte_c: artifact-descriptor={short-label=Rte_c, category=SWSRC, domain=AUTOSAR}
        Rte_h: artifact-descriptor={short-label=Rte_h, category=SWHDR, domain=AUTOSAR}
        Rte_BswM_h: artifact-descriptor={short-label=Rte_BswM_h, category=SWHDR, domain=AUTOSAR}
        Rte_BswM_Type_h: artifact-descriptor={short-label=Rte_BswM_Type_h, category=SWHDR, domain=AUTOSAR}
        Rte_Cbk_h: artifact-descriptor={short-label=Rte_Cbk_h, category=SWHDR, domain=AUTOSAR}
        Rte_Cfg_h: artifact-descriptor={short-label=Rte_Cfg_h, category=SWHDR, domain=AUTOSAR}
        Rte_ComM_h: artifact-descriptor={short-label=Rte_ComM_h, category=SWHDR, domain=AUTOSAR}
        Rte_ComM_Type_h: artifact-descriptor={short-label=Rte_ComM_Type_h, category=SWHDR, domain=AUTOSAR}
        Rte_Const_h: artifact-descriptor={short-label=Rte_Const_h, category=SWHDR, domain=AUTOSAR}
        Rte_DataHandleType_h: artifact-descriptor={short-label=Rte_DataHandleType_h, category=SWHDR, domain=AUTOSAR}
        Rte_EcuM_h: artifact-descriptor={short-label=Rte_EcuM_h, category=SWHDR, domain=AUTOSAR}
        Rte_EcuM_Type_h: artifact-descriptor={short-label=Rte_EcuM_Type_h, category=SWHDR, domain=AUTOSAR}
        Rte_Hook_h: artifact-descriptor={short-label=Rte_Hook_h, category=SWHDR, domain=AUTOSAR}
        Rte_Intl_h: artifact-descriptor={short-label=Rte_Intl_h, category=SWHDR, domain=AUTOSAR}
        Rte_Lib_c: artifact-descriptor={short-label=Rte_Lib_c, category=SWSRC, domain=AUTOSAR}
        Rte_Main_h: artifact-descriptor={short-label=Rte_Main_h, category=SWHDR, domain=AUTOSAR}
        Rte_Type_h: artifact-descriptor={short-label=Rte_Type_h, category=SWHDR, domain=AUTOSAR}
        Rte_swc_h: artifact-descriptor={short-label=Rte_swc_h, category=SWHDR, domain=AUTOSAR}
        Rte_swc_Type_h: artifact-descriptor={short-label=Rte_swc_Type_h, category=SWHDR, domain=AUTOSAR}
        SchM_BswM_h: artifact-descriptor={short-label=SchM_BswM_h, category=SWHDR, domain=AUTOSAR}
        SchM_BswM_Type_h: artifact-descriptor={short-label=SchM_BswM_Type_h, category=SWHDR, domain=AUTOSAR}
        SchM_CanSM_h: artifact-descriptor={short-label=SchM_CanSM_h, category=SWHDR, domain=AUTOSAR}
        SchM_CanSM_Type_h: artifact-descriptor={short-label=SchM_CanSM_Type_h, category=SWHDR, domain=AUTOSAR}
        SchM_Com_h: artifact-descriptor={short-label=SchM_Com_h, category=SWHDR, domain=AUTOSAR}
        SchM_ComM_h: artifact-descriptor={short-label=SchM_ComM_h, category=SWHDR, domain=AUTOSAR}
        SchM_ComM_Type_h: artifact-descriptor={short-label=SchM_ComM_Type_h, category=SWHDR, domain=AUTOSAR}
        SchM_Com_Type_h: artifact-descriptor={short-label=SchM_Com_Type_h, category=SWHDR, domain=AUTOSAR}
        SchM_EcuM_h: artifact-descriptor={short-label=SchM_EcuM_h, category=SWHDR, domain=AUTOSAR}
        SchM_EcuM_Type_h: artifact-descriptor={short-label=SchM_EcuM_Type_h, category=SWHDR, domain=AUTOSAR}
    resource consumption ResConsumption
      12 x memory section:
        RTE_EXT_CODE: executable-entity=[Rte_ActivateRE, Rte_SetEvent, Rte_WriteQueue], prefix=RTE_EXT, sw-addrmethod=CODE, symbol=CODE
        RTE_LIB_CODE: executable-entity=[Rte_GetCurrentTaskIndex, Rte_memcpy], prefix=RTE_LIB, sw-addrmethod=CODE, symbol=CODE
        RTE_MAIN_CODE: executable-entity=[Rte_MainFunction, Rte_Start, Rte_Stop, SchM_Deinit, SchM_Init], prefix=RTE_MAIN, sw-addrmethod=CODE, symbol=CODE
        RTE_OSTASK_0_CODE: prefix=RTE_OSTASK_0, sw-addrmethod=CODE, symbol=CODE
        RTE_SIG_TMR_VOLTAGEHV_CODE: executable-entity=Rte_COMCbk_TMR_VoltageHV, prefix=RTE_SIG_TMR_VOLTAGEHV, sw-addrmethod=CODE, symbol=CODE
        RTE_SYS_CODE: executable-entity=[Rte_DecrementWaitingCount, Rte_ReadQueue, Rte_WaitWithTimeout], prefix=RTE_SYS, sw-addrmethod=CODE, symbol=CODE
        RTE_SWC_CODE: executable-entity=Rte_ImplWrite_swc_PPortPrototype_0_DataElements_VariableDataPrototype_0, prefix=RTE_SWC, sw-addrmethod=CODE, symbol=CODE
        CONST_UNSPECIFIED: alignment=UNSPECIFIED, sw-addrmethod=CONST
        VAR_CLEARED_16: alignment=16, sw-addrmethod=VAR_CLEARED
        VAR_CLEARED_32: alignment=32, sw-addrmethod=VAR_CLEARED
        RTE_SYS_VAR_CLEARED_32: alignment=32, prefix=RTE_SYS, sw-addrmethod=VAR_CLEARED, symbol=VAR_CLEARED_32
        VAR_CLEARED_BOOLEAN: alignment=BOOLEAN, sw-addrmethod=VAR_CLEARED
      7 x section name prefix:
        RTE_EXT
        RTE_LIB
        RTE_MAIN
        RTE_OSTASK_0
        RTE_SIG_TMR_VOLTAGEHV
        RTE_SWC
        RTE_SYS
package /AUTOSAR_Rte/ImplementationDataTypes
  14 x impl type:
    Rte_DE_uint8_least: category=STRUCTURE
      element value: implementation-data-type=uint8_least
    Rte_DE_uint16: category=STRUCTURE
      element value: implementation-data-type=uint16
    Rte_TDB_OsTask_0: category=STRUCTURE
      element rbuf0: implementation-data-type=Rte_DE_uint8_least
      element sbuf1: implementation-data-type=Rte_DE_uint16
    Rte_ISA_1: category=UNION
      element Rte_OsTask_0: implementation-data-type=Rte_TDB_OsTask_0
    Rte_ImplicitBufsType: category=STRUCTURE
      element isa_1: implementation-data-type=Rte_ISA_1
    Rte_CDS_BswM: category=STRUCTURE
      element Rte_Dummy: implementation-data-type=uint8
    Rte_CDS_ComM: category=STRUCTURE
      element Rte_Dummy: implementation-data-type=uint8
    Rte_CDS_EcuM: category=STRUCTURE
      element Rte_Dummy: implementation-data-type=uint8
    Rte_CDS_swc: category=STRUCTURE
      element RunnableEntity_0_PPortPrototype_0_DataElements_VariableDataPrototype_0: implementation-data-type=Rte_DE_uint16
      element RunnableEntity_0_RPortPrototype_0_DataElements_VariableDataPrototype_0: implementation-data-type=Rte_DE_uint8_least
    Rte_SelfType_BswM: implementation-data-type=Rte_CDS_BswM
    Rte_SelfType_ComM: implementation-data-type=Rte_CDS_ComM
    Rte_SelfType_EcuM: implementation-data-type=Rte_CDS_EcuM
    Rte_SelfType_swc: implementation-data-type=Rte_CDS_swc
    Rte_TaskInfo: category=VALUE  # This is an external type, i.e. it is declared in the Rte Library and not in the XML. RTEGen does not have any information about this type apart from its name.
package /AUTOSAR_Rte/SwAddrMethods
  sw addr method CODE: memory-allocation-keyword-policy=ADDR-METHOD-SHORT-NAME, section-type=CODE
  sw addr method CONST: memory-allocation-keyword-policy=ADDR-METHOD-SHORT-NAME-AND-ALIGNMENT, section-type=CONST
  sw addr method VAR_CLEARED: memory-allocation-keyword-policy=ADDR-METHOD-SHORT-NAME-AND-ALIGNMENT, section-initialization-policy=CLEARED, section-type=VAR
package /AUTOSAR_Rte/SwBaseTypes
  base type AUTOSAR_PlatformTypes_SwBaseTypes_uint8_least: category=FIXED_LENGTH, base-type-size=32, base-type-encoding=NONE, mem-alignment=32  # unsigned integer at least 8 bit | This standard AUTOSAR type shall be at least 8 bit unsigned.
  base type AUTOSAR_PlatformTypes_SwBaseTypes_uint16: category=FIXED_LENGTH, base-type-size=16, base-type-encoding=NONE, mem-alignment=16  # unsigned integer 16bit | This standard AUTOSAR type shall be of 16 bit unsigned.
  base type AUTOSAR_Platform_BaseTypes_uint8: category=FIXED_LENGTH, base-type-size=8, base-type-encoding=NONE, mem-alignment=8  # unsigned integer 8bit | This standard AUTOSAR type shall be of 8 bit unsigned.
