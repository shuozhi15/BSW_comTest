AUTOSAR XML (schema 4-0-3)
package /Os
  module config Os
    RTE_RESOURCE (OsResource): OsResourceProperty=STANDARD
    OsTask_10ms (OsTask): OsTaskResourceRef=RTE_RESOURCE
    Rte_TickCounter (OsCounter): OsCounterMaxAllowedValue=65535, OsCounterMinCycle=1, OsCounterTicksPerBase=1, OsCounterType=SOFTWARE
    Rte_ScheduleTable (OsScheduleTable): OsScheduleTableRepeating=true, OsScheduleTableDuration=1, OsScheduleTableCounterRef=Rte_TickCounter
      rte_Stimulus_1 (OsScheduleTableExpiryPoint): OsScheduleTblExpPointOffset=0
        TaskActivation1 (OsScheduleTableTaskActivation): OsScheduleTableActivateTaskRef=OsTask_10ms
