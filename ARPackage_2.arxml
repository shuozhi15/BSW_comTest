AUTOSAR XML (schema 4-2-2)
package /ARPackage_2
  sender receiver interface crash
    data DataElements_VariableDataPrototype_0: type=uint8_least
