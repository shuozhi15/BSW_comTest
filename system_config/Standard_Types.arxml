AUTOSAR XML (schema 4-2-2)
standard types defined: Std_ReturnType
package /AUTOSAR_Std/ImplementationDataTypes  # AUTOSAR Standard types
  impl type Std_VersionInfoType: category=STRUCTURE, type-emitter=HEADER_FILE  # Standard Version Info Type | This type shall be used to request the version of a BSW module using the <Module name>_GetVersionInfo()function.
    5 x element, all with category=TYPE_REFERENCE:
      vendorID: implementation-data-type=uint16
      moduleID: implementation-data-type=uint16
      sw_major_version: implementation-data-type=uint8
      sw_minor_version: implementation-data-type=uint8
      sw_patch_version: implementation-data-type=uint8
package /AUTOSAR_Std/CompuMethods
  compu method Std_High_Low: 0=STD_LOW (no error occurred), 1=STD_HIGH (generic indication that an error occurred)
  compu method Std_Active_Idle: 0=STD_IDLE (no error occurred), 1=STD_ACTIVE (generic indication that an error occurred)
  compu method Std_On_Off: 0=STD_OFF (no error occurred), 1=STD_ON (generic indication that an error occurred)
  compu method CompuMethod_usrData5_CDU_NMm_CDU: raw=phys for phys 0..255
  compu method CompuMethod_usrData4_CDU_NMm_CDU: raw=phys for phys 0..255
  compu method CompuMethod_usrData3_CDU_NMm_CDU: raw=phys for phys 0..255
  compu method CompuMethod_usrData2_CDU_NMm_CDU: raw=phys for phys 0..255
  compu method CompuMethod_ECUSPEC_AWAKE_CDU_NMm_CDU: raw=phys for phys 0..1, 0=INACTIVE, 1=ACTIVE
  compu method CompuMethod_DIAGNOSTIC_AWAKE_CDU_NMm_CDU: raw=phys for phys 0..1, 0=INACTIVE, 1=ACTIVE
  compu method CompuMethod_IGNITION_AWAKE_CDU_NMm_CDU: raw=phys for phys 0..1, 0=INACTIVE, 1=ACTIVE
  compu method CompuMethod_NETWORK_AWAKE_CDU_NMm_CDU: raw=phys for phys 0..1, 0=INACTIVE, 1=ACTIVE
  compu method CompuMethod_ECUSPEC_WAKEUP_CDU_NMm_CDU: raw=phys for phys 0..1, 0=INACTIVE, 1=ACTIVE
  compu method CompuMethod_NETWORK_WAKEUP_CDU_NMm_CDU: raw=phys for phys 0..1, 0=INACTIVE, 1=ACTIVE
  compu method CompuMethod_RESET_WAKEUP_CDU_NMm_CDU: raw=phys for phys 0..1, 0=INACTIVE, 1=ACTIVE
  compu method CompuMethod_IGNITION_WAKEUP_CDU_NMm_CDU: raw=phys for phys 0..1, 0=INACTIVE, 1=ACTIVE
  compu method CompuMethod_usrData0_CDU_NMm_CDU: raw=phys for phys 0..255, 230=NOTUSED, 231=NOTUSED, 110=NOTUSED, 232=NOTUSED, 111=NOTUSED, 233=NOTUSED, 112=NOTUSED, 234=NOTUSED, 113=NOTUSED, 235=NOTUSED, 114=NOTUSED, 236=NOTUSED, 115=NOTUSED, 237=NOTUSED, 116=NOTUSED, 238=NOTUSED, 117=NOTUSED, 239=NOTUSED, 118=NOTUSED, 119=NOTUSED, 10..19=NOTUSED, 240=NOTUSED, 241=NOTUSED, 120=NOTUSED, 242=NOTUSED, 121=NOTUSED, 0=USERDATAFORCURRENTVEHICLE, 243=NOTUSED, 122=NOTUSED, 1=NOTUSED, 244=NOTUSED, 123=NOTUSED, 2=NOTUSED, 245=NOTUSED, 124=NOTUSED, 3=NOTUSED, 246=NOTUSED, 125=NOTUSED, 4=NOTUSED, 247=NOTUSED, 126=NOTUSED, 5=NOTUSED, 248=NOTUSED, 127=NOTUSED, 6=NOTUSED, 249=NOTUSED, 128=NOTUSED, 7=NOTUSED, 129=NOTUSED, 8=NOTUSED, 9=NOTUSED, 20..29=NOTUSED, 250=NOTUSED, 251=NOTUSED, 130=NOTUSED, 252=NOTUSED, 131=NOTUSED, 253=NOTUSED, 132=NOTUSED, 254=NOTUSED, 133=NOTUSED, 134=NOTUSED, 255=USERDATANOTUSED, 135..139=NOTUSED, 30..39=NOTUSED, 140..149=NOTUSED, 40..49=NOTUSED, 150..159=NOTUSED, 50..59=NOTUSED, 160..169=NOTUSED, 60..69=NOTUSED, 170..179=NOTUSED, 70..79=NOTUSED, 180..189=NOTUSED, 80..89=NOTUSED, 190..199=NOTUSED, 90..99=NOTUSED, 200..221=NOTUSED, 100=NOTUSED, 222=NOTUSED, 101=NOTUSED, 223=NOTUSED, 102=NOTUSED, 224=NOTUSED, 103=NOTUSED, 225=NOTUSED, 104=NOTUSED, 226=NOTUSED, 105=NOTUSED, 227=NOTUSED, 106=NOTUSED, 228=NOTUSED, 107=NOTUSED, 229=NOTUSED, 108=NOTUSED, 109=NOTUSED
  compu method CompuMethod_NMm_CDU_Reserved1_NMm_CDU: raw=phys for phys 0..127
  compu method CompuMethod_RMR_CDU_NMm_CDU: raw=phys for phys 0..1, 0=INACTIVE, 1=ACTIVE
  compu method CompuMethod_srcNodeID_CDU_NMm_CDU: raw=phys for phys 0..255
  compu method CompuMethod_usrData5_BMS: raw=phys for phys 0..255
  compu method CompuMethod_usrData4_BMS: raw=phys for phys 0..255
  compu method CompuMethod_usrData3_BMS: raw=phys for phys 0..255
  compu method CompuMethod_usrData2_BMS: raw=phys for phys 0..255
  compu method CompuMethod_ECUSPEC_AWAKE_BMS: raw=phys for phys 0..1, 0=INACTIVE, 1=ACTIVE
  compu method CompuMethod_DIAGNOSTIC_AWAKE_BMS: raw=phys for phys 0..1, 0=INACTIVE, 1=ACTIVE
  compu method CompuMethod_IGNITION_AWAKE_BMS: raw=phys for phys 0..1, 0=INACTIVE, 1=ACTIVE
  compu method CompuMethod_NETWORK_AWAKE_BMS: raw=phys for phys 0..1, 0=INACTIVE, 1=ACTIVE
  compu method CompuMethod_ECUSPEC_WAKEUP_BMS: raw=phys for phys 0..1, 0=INACTIVE, 1=ACTIVE
  compu method CompuMethod_NETWORK_WAKEUP_BMS: raw=phys for phys 0..1, 0=INACTIVE, 1=ACTIVE
  compu method CompuMethod_RESET_WAKEUP_BMS: raw=phys for phys 0..1, 0=INACTIVE, 1=ACTIVE
  compu method CompuMethod_IGNITION_WAKEUP_BMS: raw=phys for phys 0..1, 0=INACTIVE, 1=ACTIVE
  compu method CompuMethod_usrData0_BMS: raw=phys for phys 0..255, 230=NOTUSED, 231=NOTUSED, 110=NOTUSED, 232=NOTUSED, 111=NOTUSED, 233=NOTUSED, 112=NOTUSED, 234=NOTUSED, 113=NOTUSED, 235=NOTUSED, 114=NOTUSED, 236=NOTUSED, 115=NOTUSED, 237=NOTUSED, 116=NOTUSED, 238=NOTUSED, 117=NOTUSED, 239=NOTUSED, 118=NOTUSED, 119=NOTUSED, 10..19=NOTUSED, 240=NOTUSED, 241=NOTUSED, 120=NOTUSED, 242=NOTUSED, 121=NOTUSED, 0=USERDATAFORCURRENTVEHICLE, 243=NOTUSED, 122=NOTUSED, 1=NOTUSED, 244=NOTUSED, 123=NOTUSED, 2=NOTUSED, 245=NOTUSED, 124=NOTUSED, 3=NOTUSED, 246=NOTUSED, 125=NOTUSED, 4=NOTUSED, 247=NOTUSED, 126=NOTUSED, 5=NOTUSED, 248=NOTUSED, 127=NOTUSED, 6=NOTUSED, 249=NOTUSED, 128=NOTUSED, 7=NOTUSED, 129=NOTUSED, 8=NOTUSED, 9=NOTUSED, 20..29=NOTUSED, 250=NOTUSED, 251=NOTUSED, 130=NOTUSED, 252=NOTUSED, 131=NOTUSED, 253=NOTUSED, 132=NOTUSED, 254=NOTUSED, 133=NOTUSED, 134=NOTUSED, 255=USERDATANOTUSED, 135..139=NOTUSED, 30..39=NOTUSED, 140..149=NOTUSED, 40..49=NOTUSED, 150..159=NOTUSED, 50..59=NOTUSED, 160..169=NOTUSED, 60..69=NOTUSED, 170..179=NOTUSED, 70..79=NOTUSED, 180..189=NOTUSED, 80..89=NOTUSED, 190..199=NOTUSED, 90..99=NOTUSED, 200..221=NOTUSED, 100=NOTUSED, 222=NOTUSED, 101=NOTUSED, 223=NOTUSED, 102=NOTUSED, 224=NOTUSED, 103=NOTUSED, 225=NOTUSED, 104=NOTUSED, 226=NOTUSED, 105=NOTUSED, 227=NOTUSED, 106=NOTUSED, 228=NOTUSED, 107=NOTUSED, 229=NOTUSED, 108=NOTUSED, 109=NOTUSED
  compu method CompuMethod_NMm_BMS_Reserved1: raw=phys for phys 0..127
  compu method CompuMethod_RMR_BMS: raw=phys for phys 0..1, 0=INACTIVE, 1=ACTIVE
  compu method CompuMethod_srcNodeID_BMS: raw=phys for phys 0..255
