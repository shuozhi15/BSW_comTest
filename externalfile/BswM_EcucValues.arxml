AUTOSAR XML (schema 4-2-2)
package /ETAS_Project/EcucModuleConfigurationValuess
  module config BswM
    BswMConfig_0 (BswMConfig)
      BswMArbitration_0 (BswMArbitration)
      BswMModeControl_0 (BswMModeControl)
    BswMGeneral_0 (BswMGeneral):
      BswMCanSMEnabled = true
      BswMRbComEnabled = 0
      BswMComMEnabled = true
      BswMDcmEnabled = 0
      BswMDevErrorDetect = 0
      BswMEcuMEnabled = true
      BswMEthIfEnabled = 0
      BswMEthSMEnabled = 0
      BswMFrSMEnabled = 0
      BswMGenericRequestEnabled = 0
      BswMJ1939DcmEnabled = 0
      BswMJ1939NmEnabled = 0
      BswMLinSMEnabled = 0
      BswMLinTPEnabled = 0
      BswMNmEnabled = 0
      BswMNvMEnabled = 0
      BswMRbDebugEnable = 0
      BswMRbIntrptQueueMaxSize = 1
      BswMSchMEnabled = 0
      BswMSdEnabled = 0
      BswMVersionInfoApi = 1
      BswMMainFunctionPeriod = 0.01
