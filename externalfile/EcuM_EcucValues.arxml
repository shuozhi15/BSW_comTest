AUTOSAR XML (schema 4-2-2)
package /ETAS_Project/EcucModuleConfigurationValuess
  module config EcuM
    EcuMConfiguration_0 (EcuMConfiguration)
      EcuMCommonConfiguration: EcuMDefaultAppMode=OSDEFAULTAPPMODE
        EcuMDefaultShutdownTarget: EcuMDefaultState=EcuMStateOff, EcuMDefaultResetModeRef=ECUM_RESET_MCU
        EcuMDriverInitListOne
          5 x EcuMDriverInitItem, all with EcuMRbServiceIsNonAutosar=true:
            Mcu_Init: EcuMModuleID=Mcu, EcuMModuleService=Init, EcuMRbModuleIsPbCapable=true, EcuMRbModuleConfigDataSetName=Mcu_ConfigRoot, EcuMModuleParameter=POSTBUILD_PTR
            McuFunc_InitializeClock: EcuMModuleID=McuFunc, EcuMModuleService=InitializeClock, EcuMRbModuleIsPbCapable=false, EcuMModuleParameter=VOID
            Port_Init: EcuMModuleID=Port, EcuMModuleService=Init, EcuMRbModuleIsPbCapable=true, EcuMRbModuleConfigDataSetName=Port_ConfigRoot, EcuMModuleParameter=POSTBUILD_PTR
            Gpt_Init: EcuMModuleID=Gpt, EcuMModuleService=Init, EcuMRbModuleIsPbCapable=true, EcuMRbModuleConfigDataSetName=Gpt_ConfigRoot, EcuMModuleParameter=POSTBUILD_PTR
            Wdg_17_Scu_Init: EcuMModuleID=Wdg_17_Scu, EcuMModuleService=Init, EcuMRbModuleIsPbCapable=true, EcuMRbModuleConfigDataSetName=Wdg_ConfigRoot, EcuMModuleParameter=POSTBUILD_PTR
        EcuMDriverInitListZero
          Det_Init (EcuMDriverInitItem): EcuMModuleID=Det, EcuMModuleService=Init, EcuMRbDriverInitCoreId=0
          Dem_PreInit (EcuMDriverInitItem): EcuMModuleID=Dem, EcuMModuleService=PreInit, EcuMRbServiceIsNonAutosar=false, EcuMRbDriverInitCoreId=0
        5 x EcuMWakeupSource, all with EcuMValidationTimeout=0.0:
          ECUM_WKSOURCE_POWER: EcuMWakeupSourceId=0
          ECUM_WKSOURCE_RESET: EcuMWakeupSourceId=1
          ECUM_WKSOURCE_INTERNAL_RESET: EcuMWakeupSourceId=2
          ECUM_WKSOURCE_INTERNAL_WDG: EcuMWakeupSourceId=3
          ECUM_WKSOURCE_EXTERNAL_WDG: EcuMWakeupSourceId=4
      EcuMFlexConfiguration
        EcuMFlexUserConfig_0 (EcuMFlexUserConfig): EcuMFlexUser=42
        EcuMGoDownAllowedUsers: EcuMGoDownAllowedUserRef=EcuMFlexUserConfig_0
        3 x EcuMResetMode:
          ECUM_RESET_MCU: EcuMResetModeId=0
          ECUM_RESET_WDGM: EcuMResetModeId=1
          ECUM_RESET_IO: EcuMResetModeId=2
        3 x EcuMShutdownCause:
          ECUM_CAUSE_ECU_STATE: EcuMShutdownCauseId=1
          ECUM_CAUSE_WDGM: EcuMShutdownCauseId=2
          ECUM_CAUSE_DCM: EcuMShutdownCauseId=3
    EcuMGeneral: EcuMDevErrorDetect=true, EcuMEnableDefBehaviour=false, EcuMIncludeDet=true, EcuMMainFunctionPeriod=0.01, EcuMVersionInfoApi=true
