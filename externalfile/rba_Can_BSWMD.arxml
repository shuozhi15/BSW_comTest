AUTOSAR XML (schema 4-2-2)
package /AUTOSAR_Can/BswModuleDescriptions
  bsw module description Can: category=BSW_MODULE, module-id=80, provided-entrys=[Can_Init, Can_GetVersionInfo, Can_SetBaudrate, Can_SetControllerMode]  # CAN Driver
package /AUTOSAR_Can/BswModuleEntrys
  4 x bsw module entry, all with call-type=REGULAR, execution-context=UNSPECIFIED, sw-service-impl-policy=STANDARD:
    Can_Init: service-id=0x00, is-reentrant=false, is-synchronous=true  # Can service to initialize the module
      sw service arg Config: category=DATA_REFERENCE, direction=IN, sw-pointer-target-props={target-category=STRUCTURE, implementation-data-type=Can_ConfigType, sw-impl-policy=CONST}  # Pointer to driver configuration.
    Can_GetVersionInfo: service-id=0x07, is-reentrant=true, is-synchronous=true  # Can service to return the version information of the module
      sw service arg versioninfo: category=DATA_REFERENCE, direction=OUT, sw-pointer-target-props={target-category=STRUCTURE, implementation-data-type=Std_VersionInfoType}  # Pointer to where to store the version information of this module.
    Can_SetBaudrate: service-id=0x0f, is-reentrant=false, is-synchronous=true  # This service shall set the baud rate configuration of the CAN controller
      return type ReturnValue: implementation-data-type=Std_ReturnType  # E_OK: Baudrate supported by the CAN Controller E_NOT_OK: Baudrate not supported / invalid CAN controller
      sw service arg Controller: category=DATA_REFERENCE, direction=IN, implementation-data-type=uint8  # CAN controller, whose baud rate shall be set
      sw service arg BaudRateConfigID: category=DATA_REFERENCE, direction=IN, implementation-data-type=uint16  # references a baud rate configuration by ID
    Can_SetControllerMode: service-id=0x03, is-reentrant=false, is-synchronous=false  # This function performs software triggered state transitions of the CAN controller State machine
      return type ReturnValue: implementation-data-type=Can_ReturnType  # CAN_OK: request accepted CAN_NOT_OK: request not accepted, a development error occurred
      sw service arg Controller: direction=IN, implementation-data-type=uint8  # CAN controller for which the status shall be changed
      sw service arg Transition: direction=IN, implementation-data-type=Can_StateTransitionType  # Transition value to request new CAN controller state
package /AUTOSAR_Can/ImplementationDataTypes
  7 x impl type, all with type-emitter=HEADER_FILE:
    Can_ConfigType: category=STRUCTURE  # This is the type of the external data structure containing the overall initialization data for the CAN driver and SFR settings affecting all controllers. Furthermore it contains pointers to controller configuration structures. The contents of the initialization data structure are CAN hardware specific.
      5 x element:
        WakeupSource: category=DATA_REFERENCE, sw-pointer-target-props={target-category=VALUE, base-type=uint32}
        Controller: implementation-data-type=uint8
        ControllerConfig: category=DATA_REFERENCE, sw-pointer-target-props={target-category=VALUE, base-type=uint32, sw-impl-policy=CONST}
        Controller_Baud_Rate_Parameters: category=DATA_REFERENCE, sw-pointer-target-props={target-category=VALUE, base-type=uint32, sw-impl-policy=CONST}
        Controller_PB_Parameters: category=DATA_REFERENCE, sw-pointer-target-props={target-category=VALUE, base-type=uint32, sw-impl-policy=CONST}
    Can_PduType: category=STRUCTURE  # This type unites PduId (swPduHandle), SduLength (length), SduData (sdu), and CanId (id) for any CAN L-SDU.
      4 x element:
        sdu: category=DATA_REFERENCE, sw-pointer-target-props={target-category=VALUE, base-type=uint8}
        id: implementation-data-type=Can_IdType
        swPduHandle: implementation-data-type=PduIdType
        length: implementation-data-type=uint8
    Can_StateTransitionType: category=VALUE, base-type=uint8, compu {0=CAN_T_START (CAN controller transition value to request state STARTED.), 1=CAN_T_STOP (CAN controller transition value to request state STOPPED.), 2..0=CAN_T_SLEEP (CAN controller transition value to request state SLEEP.), 3=CAN_T_WAKEUP (CAN controller transition value to request state STOPPED from state SLEEP.)}  # State transitions that are used by the function CAN_SetControllerMode
    Can_ReturnType: category=VALUE, base-type=uint8, compu {0=CAN_OK (success.), 1=CAN_NOT_OK (error occurred or wakeup event occurred during sleep transition.), 2=CAN_BUSY (transmit request could not be processed because no transmit object was available.)}  # Return values of CAN driver API .
    Can_HwHandleType: category=VALUE, base-type=uint32, compu {0..0x0FF=Standard, 0..0xFFFF=Extended}  # Represents the hardware object handles of a CAN hardware unit. For CAN hardware units with more than 255 HW objects use extended range.
    Can_IdType: category=VALUE, base-type=uint32, compu {0..0x400007FF=Standard32Bit, 0..0xDFFFFFFF=Extended32Bit}  # Represents the Identifier of an L-PDU. The two most significant bits specify the frame type: 00 CAN message with Standard CAN ID 01 CAN FD frame with Standard CAN ID 10 CAN message with Extended CAN ID 11 CAN FD frame with Extended CAN ID
    Can_HwType: category=STRUCTURE  # This type defines a data structure which clearly provides an Hardware Object Handle including its corresponding CAN Controller and therefore CanDrv as well as the specific CanId.
      element CanId: implementation-data-type=Can_IdType
      element Hoh: implementation-data-type=Can_HwHandleType
      element ControllerId: implementation-data-type=uint8
package /AUTOSAR_Can/DataConstraints
  range DC_Can_CanId: phys 0..536870911  # Data Constraints for Can_CanId
