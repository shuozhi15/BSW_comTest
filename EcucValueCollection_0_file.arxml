AUTOSAR XML (schema 4-2-2)
package /EcucValueCollection_ARPackage_0
  ecuc value collection EcucValueCollection_0: ecu-extract=EXTR_BMS, ecuc-values=[Os, Rte, EcuC, CanNm, Com, CanSM, ComM]
