AUTOSAR XML (schema 4-2-2)
package /ARPackage_1
  sender receiver interface soc
    data DataElements_VariableDataPrototype_0: type=uint16
