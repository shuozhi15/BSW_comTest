[part 2 of 2: package /ETAS_Project/EcucModuleConfigurationValuess]
AUTOSAR XML (schema 4-2-2)
package /ETAS_Project/EcucModuleConfigurationValuess  (continued)
  module config Com: implementation-config-variant=VARIANT-PRE-COMPILE
    ComConfig_0 (ComConfig)
      ComTimeBase: ComGwTimeBase=0.005, ComRxTimeBase=0.01, ComTxTimeBase=0.01
      ComIPduGroup_Rx (ComIPduGroup)
      TMR_3_Can_Network_CANNODE_0 (ComIPdu):
        ComIPduSignalProcessing = IMMEDIATE
        ComIPduType = NORMAL
        ComIPduDirection = RECEIVE
        ComIPduGroupRef = ComIPduGroup_Rx
        ComPduIdRef = PduCollection/TMR_3_Can_Network_CANNODE_0_PduR2Com
        ComIPduSignalRef = TMR_VoltageHV
        ComIPduSignalRef = TMR_CurrentHV
      TMR_VoltageHV (ComSignal):
        ComSignalInitValue = 0
        ComSignalType = UINT16
        ComSignalEndianness = BIG_ENDIAN
        ComBitSize = 10
        ComBitPosition = 12
        ComUpdateBitPosition = -1
        ComTransferProperty = TRIGGERED
        ComSystemTemplateSystemSignalRef = TMR_VoltageHV
      TMR_CurrentHV (ComSignal):
        ComSignalInitValue = 1023
        ComSignalType = UINT16
        ComSignalEndianness = BIG_ENDIAN
        ComBitSize = 11
        ComBitPosition = 7
        ComUpdateBitPosition = -1
        ComTransferProperty = TRIGGERED
        ComSystemTemplateSystemSignalRef = TMR_CurrentHV
      EMS_4_G_Can_Network_CANNODE_0 (ComIPdu):
        ComIPduSignalProcessing = IMMEDIATE
        ComIPduType = NORMAL
        ComIPduDirection = RECEIVE
        ComIPduGroupRef = ComIPduGroup_Rx
        ComPduIdRef = PduCollection/EMS_4_G_Can_Network_CANNODE_0_PduR2Com
        ComIPduSignalRef = EMS_4_G_EngineSpeed_Actual
      EMS_4_G_EngineSpeed_Actual (ComSignal):
        ComSignalInitValue = 0
        ComSignalType = UINT16
        ComSignalEndianness = BIG_ENDIAN
        ComBitSize = 16
        ComBitPosition = 7
        ComUpdateBitPosition = -1
        ComTransferProperty = TRIGGERED
        ComSystemTemplateSystemSignalRef = EMS_4_G_EngineSpeed_Actual
      OBC_2_Can_Network_CANNODE_0 (ComIPdu):
        ComIPduSignalProcessing = IMMEDIATE
        ComIPduType = NORMAL
        ComIPduDirection = RECEIVE
        ComIPduGroupRef = ComIPduGroup_Rx
        ComPduIdRef = PduCollection/OBC_2_Can_Network_CANNODE_0_PduR2Com
        ComIPduSignalRef = OBC_KL30_UnderVolt
        ComIPduSignalRef = OBC_InputVolt
        ComIPduSignalRef = OBC_InputCurr
      3 x ComSignal, all with ComSignalInitValue=0, ComSignalEndianness=BIG_ENDIAN, ComUpdateBitPosition=-1, ComTransferProperty=TRIGGERED:
        OBC_KL30_UnderVolt: ComSignalType=BOOLEAN, ComBitSize=1, ComBitPosition=55, ComSystemTemplateSystemSignalRef=OBC_KL30_UnderVolt
        OBC_InputVolt: ComSignalType=UINT16, ComBitSize=16, ComBitPosition=23, ComSystemTemplateSystemSignalRef=OBC_InputVolt
        OBC_InputCurr: ComSignalType=UINT16, ComBitSize=16, ComBitPosition=7, ComSystemTemplateSystemSignalRef=OBC_InputCurr
      OBC_4_Can_Network_CANNODE_0 (ComIPdu):
        ComIPduSignalProcessing = IMMEDIATE
        ComIPduType = NORMAL
        ComIPduDirection = RECEIVE
        ComIPduGroupRef = ComIPduGroup_Rx
        ComPduIdRef = PduCollection/OBC_4_Can_Network_CANNODE_0_PduR2Com
        ComIPduSignalRef = OBC_ChargeSourceMode
        ComIPduSignalRef = OBC_FaultCode
        ComIPduSignalRef = OBC_MaxOutputVoltage
        ComIPduSignalRef = OBC_MaxOutputCurrent
      4 x ComSignal, all with ComSignalInitValue=0, ComSignalEndianness=BIG_ENDIAN, ComUpdateBitPosition=-1, ComTransferProperty=TRIGGERED:
        OBC_ChargeSourceMode: ComSignalType=UINT8, ComBitSize=2, ComBitPosition=53, ComSystemTemplateSystemSignalRef=OBC_ChargeSourceMode
        OBC_FaultCode: ComSignalType=UINT8, ComBitSize=8, ComBitPosition=39, ComSystemTemplateSystemSignalRef=OBC_FaultCode
        OBC_MaxOutputVoltage: ComSignalType=UINT16, ComBitSize=16, ComBitPosition=23, ComSystemTemplateSystemSignalRef=OBC_MaxOutputVoltage
        OBC_MaxOutputCurrent: ComSignalType=UINT16, ComBitSize=16, ComBitPosition=7, ComSystemTemplateSystemSignalRef=OBC_MaxOutputCurrent
      ABS_ESP_G_Can_Network_CANNODE_0 (ComIPdu):
        ComIPduSignalProcessing = IMMEDIATE
        ComIPduType = NORMAL
        ComIPduDirection = RECEIVE
        ComIPduGroupRef = ComIPduGroup_Rx
        ComPduIdRef = PduCollection/ABS_ESP_G_Can_Network_CANNODE_0_PduR2Com
        ComIPduSignalRef = VehicleSpeedVSOSigValidData
        ComIPduSignalRef = VehicleSpeedVSOSig
      VehicleSpeedVSOSigValidData (ComSignal):
        ComSignalInitValue = 1
        ComSignalType = BOOLEAN
        ComSignalEndianness = BIG_ENDIAN
        ComBitSize = 1
        ComBitPosition = 31
        ComUpdateBitPosition = -1
        ComTransferProperty = TRIGGERED
        ComSystemTemplateSystemSignalRef = VehicleSpeedVSOSigValidData
      VehicleSpeedVSOSig (ComSignal):
        ComSignalInitValue = 0
        ComSignalType = UINT16
        ComSignalEndianness = BIG_ENDIAN
        ComBitSize = 13
        ComBitPosition = 12
        ComUpdateBitPosition = -1
        ComTransferProperty = TRIGGERED
        ComSystemTemplateSystemSignalRef = VehicleSpeedVSOSig
      TMR_1_Can_Network_CANNODE_0 (ComIPdu):
        ComIPduSignalProcessing = IMMEDIATE
        ComIPduType = NORMAL
        ComIPduDirection = RECEIVE
        ComIPduGroupRef = ComIPduGroup_Rx
        ComPduIdRef = PduCollection/TMR_1_Can_Network_CANNODE_0_PduR2Com
        ComIPduSignalRef = TMR_State
      TMR_State (ComSignal):
        ComSignalInitValue = 0
        ComSignalType = UINT8
        ComSignalEndianness = BIG_ENDIAN
        ComBitSize = 4
        ComBitPosition = 55
        ComUpdateBitPosition = -1
        ComTransferProperty = TRIGGERED
        ComSystemTemplateSystemSignalRef = TMR_State
      OBC_1_Can_Network_CANNODE_0 (ComIPdu):
        ComIPduSignalProcessing = IMMEDIATE
        ComIPduType = NORMAL
        ComIPduDirection = RECEIVE
        ComIPduGroupRef = ComIPduGroup_Rx
        ComPduIdRef = PduCollection/OBC_1_Can_Network_CANNODE_0_PduR2Com
        ComIPduSignalRef = OBC_FaultLevelSts
        ComIPduSignalRef = OBC_OutputPowerLimt
        ComIPduSignalRef = OBC_ChgVolt
        ComIPduSignalRef = OBC_ChgCurr
      4 x ComSignal, all with ComSignalInitValue=0, ComSignalEndianness=BIG_ENDIAN, ComUpdateBitPosition=-1, ComTransferProperty=TRIGGERED:
        OBC_FaultLevelSts: ComSignalType=UINT8, ComBitSize=3, ComBitPosition=41, ComSystemTemplateSystemSignalRef=OBC_FaultLevelSts
        OBC_OutputPowerLimt: ComSignalType=UINT16, ComBitSize=12, ComBitPosition=39, ComSystemTemplateSystemSignalRef=OBC_OutputPowerLimt
        OBC_ChgVolt: ComSignalType=UINT16, ComBitSize=16, ComBitPosition=23, ComSystemTemplateSystemSignalRef=OBC_ChgVolt
        OBC_ChgCurr: ComSignalType=UINT16, ComBitSize=16, ComBitPosition=7, ComSystemTemplateSystemSignalRef=OBC_ChgCurr
      TMF_3_Can_Network_CANNODE_0 (ComIPdu):
        ComIPduSignalProcessing = IMMEDIATE
        ComIPduType = NORMAL
        ComIPduDirection = RECEIVE
        ComIPduGroupRef = ComIPduGroup_Rx
        ComPduIdRef = PduCollection/TMF_3_Can_Network_CANNODE_0_PduR2Com
        ComIPduSignalRef = TMF_UdcAct
        ComIPduSignalRef = TMF_IdcAct
      TMF_UdcAct (ComSignal):
        ComSignalInitValue = 0
        ComSignalType = UINT16
        ComSignalEndianness = BIG_ENDIAN
        ComBitSize = 10
        ComBitPosition = 12
        ComUpdateBitPosition = -1
        ComTransferProperty = TRIGGERED
        ComSystemTemplateSystemSignalRef = TMF_UdcAct
      TMF_IdcAct (ComSignal):
        ComSignalInitValue = 1023
        ComSignalType = UINT16
        ComSignalEndianness = BIG_ENDIAN
        ComBitSize = 11
        ComBitPosition = 7
        ComUpdateBitPosition = -1
        ComTransferProperty = TRIGGERED
        ComSystemTemplateSystemSignalRef = TMF_IdcAct
      EMS_28_Can_Network_CANNODE_0 (ComIPdu):
        ComIPduSignalProcessing = IMMEDIATE
        ComIPduType = NORMAL
        ComIPduDirection = RECEIVE
        ComIPduGroupRef = ComIPduGroup_Rx
        ComPduIdRef = PduCollection/EMS_28_Can_Network_CANNODE_0_PduR2Com
        ComIPduSignalRef = OBD_GeneralDenomiantorFreeze
        ComIPduSignalRef = OBD_GeneralDenomiantor
        ComIPduSignalRef = PID11_AbsoluteThrottlePos
        ComIPduSignalRef = OBD_PermanentFailureCycle
        ComIPduSignalRef = OBD_WarmupCycle
        ComIPduSignalRef = OBD_DrivingCycle
        ComIPduSignalRef = AbsoluteThrottlePosValidData
        ComIPduSignalRef = LoadValueCalculatedValidData
        ComIPduSignalRef = PID04_LoadValueCalculated
      9 x ComSignal, all with ComSignalInitValue=0, ComSignalEndianness=BIG_ENDIAN, ComUpdateBitPosition=-1, ComTransferProperty=TRIGGERED:
        OBD_GeneralDenomiantorFreeze: ComSignalType=BOOLEAN, ComBitSize=1, ComBitPosition=29, ComSystemTemplateSystemSignalRef=OBD_GeneralDenomiantorFreeze
        OBD_GeneralDenomiantor: ComSignalType=BOOLEAN, ComBitSize=1, ComBitPosition=30, ComSystemTemplateSystemSignalRef=OBD_GeneralDenomiantor
        PID11_AbsoluteThrottlePos: ComSignalType=UINT8, ComBitSize=8, ComBitPosition=23, ComSystemTemplateSystemSignalRef=PID11_AbsoluteThrottlePos
        OBD_PermanentFailureCycle: ComSignalType=BOOLEAN, ComBitSize=1, ComBitPosition=11, ComSystemTemplateSystemSignalRef=OBD_PermanentFailureCycle
        OBD_WarmupCycle: ComSignalType=BOOLEAN, ComBitSize=1, ComBitPosition=12, ComSystemTemplateSystemSignalRef=OBD_WarmupCycle
        OBD_DrivingCycle: ComSignalType=BOOLEAN, ComBitSize=1, ComBitPosition=13, ComSystemTemplateSystemSignalRef=OBD_DrivingCycle
        AbsoluteThrottlePosValidData: ComSignalType=BOOLEAN, ComBitSize=1, ComBitPosition=14, ComSystemTemplateSystemSignalRef=AbsoluteThrottlePosValidData
        LoadValueCalculatedValidData: ComSignalType=BOOLEAN, ComBitSize=1, ComBitPosition=15, ComSystemTemplateSystemSignalRef=LoadValueCalculatedValidData
        PID04_LoadValueCalculated: ComSignalType=UINT8, ComBitSize=8, ComBitPosition=7, ComSystemTemplateSystemSignalRef=PID04_LoadValueCalculated
      CLM_2_Can_Network_CANNODE_0 (ComIPdu):
        ComIPduSignalProcessing = IMMEDIATE
        ComIPduType = NORMAL
        ComIPduDirection = RECEIVE
        ComIPduGroupRef = ComIPduGroup_Rx
        ComPduIdRef = PduCollection/CLM_2_Can_Network_CANNODE_0_PduR2Com
        ComIPduSignalRef = ExternalTemperatureRaw_C
        ComIPduSignalRef = ExternalTemperatureFailSts_GS
      ExternalTemperatureRaw_C (ComSignal):
        ComSignalInitValue = 254
        ComSignalType = UINT8
        ComSignalEndianness = BIG_ENDIAN
        ComBitSize = 8
        ComBitPosition = 55
        ComUpdateBitPosition = -1
        ComTransferProperty = TRIGGERED
        ComSystemTemplateSystemSignalRef = ExternalTemperatureRaw_C
      ExternalTemperatureFailSts_GS (ComSignal):
        ComSignalInitValue = 0
        ComSignalType = UINT8
        ComSignalEndianness = BIG_ENDIAN
        ComBitSize = 2
        ComBitPosition = 33
        ComUpdateBitPosition = -1
        ComTransferProperty = TRIGGERED
        ComSystemTemplateSystemSignalRef = ExternalTemperatureFailSts_GS
      HCU_1_G_Can_Network_CANNODE_0 (ComIPdu):
        ComIPduSignalProcessing = IMMEDIATE
        ComIPduType = NORMAL
        ComIPduDirection = RECEIVE
        ComIPduGroupRef = ComIPduGroup_Rx
        ComPduIdRef = PduCollection/HCU_1_G_Can_Network_CANNODE_0_PduR2Com
        ComIPduSignalRef = HCU_PTReady
        ComIPduSignalRef = HCU_HVReady
      HCU_PTReady (ComSignal):
        ComSignalInitValue = 0
        ComSignalType = BOOLEAN
        ComSignalEndianness = BIG_ENDIAN
        ComBitSize = 1
        ComBitPosition = 49
        ComUpdateBitPosition = -1
        ComTransferProperty = TRIGGERED
        ComSystemTemplateSystemSignalRef = HCU_PTReady
      HCU_HVReady (ComSignal):
        ComSignalInitValue = 0
        ComSignalType = BOOLEAN
        ComSignalEndianness = BIG_ENDIAN
        ComBitSize = 1
        ComBitPosition = 48
        ComUpdateBitPosition = -1
        ComTransferProperty = TRIGGERED
        ComSystemTemplateSystemSignalRef = HCU_HVReady
      TBOX_3_Can_Network_CANNODE_0 (ComIPdu):
        ComIPduSignalProcessing = IMMEDIATE
        ComIPduType = NORMAL
        ComIPduDirection = RECEIVE
        ComIPduGroupRef = ComIPduGroup_Rx
        ComPduIdRef = PduCollection/TBOX_3_Can_Network_CANNODE_0_PduR2Com
        ComIPduSignalRef = TBOX_ChargeAllow
      TBOX_ChargeAllow (ComSignal):
        ComSignalInitValue = 0
        ComSignalType = BOOLEAN
        ComSignalEndianness = BIG_ENDIAN
        ComBitSize = 1
        ComBitPosition = 53
        ComUpdateBitPosition = -1
        ComTransferProperty = TRIGGERED
        ComSystemTemplateSystemSignalRef = TBOX_ChargeAllow
      DCDC_2_Can_Network_CANNODE_0 (ComIPdu):
        ComIPduSignalProcessing = IMMEDIATE
        ComIPduType = NORMAL
        ComIPduDirection = RECEIVE
        ComIPduGroupRef = ComIPduGroup_Rx
        ComPduIdRef = PduCollection/DCDC_2_Can_Network_CANNODE_0_PduR2Com
        ComIPduSignalRef = DCDC_HvCurr
        ComIPduSignalRef = DCDC_HvVolt
      DCDC_HvCurr (ComSignal):
        ComSignalInitValue = 0
        ComSignalType = UINT16
        ComSignalEndianness = BIG_ENDIAN
        ComBitSize = 16
        ComBitPosition = 23
        ComUpdateBitPosition = -1
        ComTransferProperty = TRIGGERED
        ComSystemTemplateSystemSignalRef = DCDC_HvCurr
      DCDC_HvVolt (ComSignal):
        ComSignalInitValue = 0
        ComSignalType = UINT16
        ComSignalEndianness = BIG_ENDIAN
        ComBitSize = 16
        ComBitPosition = 7
        ComUpdateBitPosition = -1
        ComTransferProperty = TRIGGERED
        ComSystemTemplateSystemSignalRef = DCDC_HvVolt
      ICM_1_Can_Network_CANNODE_0 (ComIPdu):
        ComIPduSignalProcessing = IMMEDIATE
        ComIPduType = NORMAL
        ComIPduDirection = RECEIVE
        ComIPduGroupRef = ComIPduGroup_Rx
        ComPduIdRef = PduCollection/ICM_1_Can_Network_CANNODE_0_PduR2Com
        ComIPduSignalRef = TotalOdometer_km
        ComIPduSignalRef = BatteryVoltage
      TotalOdometer_km (ComSignal):
        ComSignalInitValue = 0
        ComSignalType = UINT32
        ComSignalEndianness = BIG_ENDIAN
        ComBitSize = 20
        ComBitPosition = 43
        ComUpdateBitPosition = -1
        ComTransferProperty = TRIGGERED
        ComSystemTemplateSystemSignalRef = TotalOdometer_km
      BatteryVoltage (ComSignal):
        ComSignalInitValue = 0
        ComSignalType = UINT8
        ComSignalEndianness = BIG_ENDIAN
        ComBitSize = 8
        ComBitPosition = 23
        ComUpdateBitPosition = -1
        ComTransferProperty = TRIGGERED
        ComSystemTemplateSystemSignalRef = BatteryVoltage
      HCU_7_Can_Network_CANNODE_0 (ComIPdu):
        ComIPduSignalProcessing = IMMEDIATE
        ComIPduType = NORMAL
        ComIPduDirection = RECEIVE
        ComIPduGroupRef = ComIPduGroup_Rx
        ComPduIdRef = PduCollection/HCU_7_Can_Network_CANNODE_0_PduR2Com
        ComIPduSignalRef = HCU_BattHeatAllow
        ComIPduSignalRef = HCU_VehicleAllowToCharge
        ComIPduSignalRef = HCU_BMS_stModeReq
        ComIPduSignalRef = HCU_BattHVHAllow
        ComIPduSignalRef = HCU_SleepAllow
        ComIPduSignalRef = HCU_EngineSts
        ComIPduSignalRef = HCU_AccessoriesCosumePower
      7 x ComSignal, all with ComSignalInitValue=0, ComSignalEndianness=BIG_ENDIAN, ComUpdateBitPosition=-1, ComTransferProperty=TRIGGERED:
        HCU_BattHeatAllow: ComSignalType=BOOLEAN, ComBitSize=1, ComBitPosition=55, ComSystemTemplateSystemSignalRef=HCU_BattHeatAllow
        HCU_VehicleAllowToCharge: ComSignalType=BOOLEAN, ComBitSize=1, ComBitPosition=46, ComSystemTemplateSystemSignalRef=HCU_VehicleAllowToCharge
        HCU_BMS_stModeReq: ComSignalType=UINT8, ComBitSize=3, ComBitPosition=45, ComSystemTemplateSystemSignalRef=HCU_BMS_stModeReq
        HCU_BattHVHAllow: ComSignalType=BOOLEAN, ComBitSize=1, ComBitPosition=42, ComSystemTemplateSystemSignalRef=HCU_BattHVHAllow
        HCU_SleepAllow: ComSignalType=BOOLEAN, ComBitSize=1, ComBitPosition=40, ComSystemTemplateSystemSignalRef=HCU_SleepAllow
        HCU_EngineSts: ComSignalType=BOOLEAN, ComBitSize=1, ComBitPosition=34, ComSystemTemplateSystemSignalRef=HCU_EngineSts
        HCU_AccessoriesCosumePower: ComSignalType=UINT8, ComBitSize=8, ComBitPosition=7, ComSystemTemplateSystemSignalRef=HCU_AccessoriesCosumePower
      EMS_1_G_Can_Network_CANNODE_0 (ComIPdu):
        ComIPduSignalProcessing = IMMEDIATE
        ComIPduType = NORMAL
        ComIPduDirection = RECEIVE
        ComIPduGroupRef = ComIPduGroup_Rx
        ComPduIdRef = PduCollection/EMS_1_G_Can_Network_CANNODE_0_PduR2Com
        ComIPduSignalRef = EngineCoolantTemperture
        ComIPduSignalRef = EngineCoolantTempertureFailSts
      EngineCoolantTemperture (ComSignal):
        ComSignalInitValue = 91
        ComSignalType = UINT8
        ComSignalEndianness = BIG_ENDIAN
        ComBitSize = 8
        ComBitPosition = 23
        ComUpdateBitPosition = -1
        ComTransferProperty = TRIGGERED
        ComSystemTemplateSystemSignalRef = EngineCoolantTemperture
      EngineCoolantTempertureFailSts (ComSignal):
        ComSignalInitValue = 91
        ComSignalType = BOOLEAN
        ComSignalEndianness = BIG_ENDIAN
        ComBitSize = 1
        ComBitPosition = 11
        ComUpdateBitPosition = -1
        ComTransferProperty = TRIGGERED
        ComSystemTemplateSystemSignalRef = EngineCoolantTempertureFailSts
      DCDC_1_Can_Network_CANNODE_0 (ComIPdu):
        ComIPduSignalProcessing = IMMEDIATE
        ComIPduType = NORMAL
        ComIPduDirection = RECEIVE
        ComIPduGroupRef = ComIPduGroup_Rx
        ComPduIdRef = PduCollection/DCDC_1_Can_Network_CANNODE_0_PduR2Com
        ComIPduSignalRef = DCDC_LvSideCurr
        ComIPduSignalRef = DCDC_LvSideVolt
      DCDC_LvSideCurr (ComSignal):
        ComSignalInitValue = 0
        ComSignalType = UINT16
        ComSignalEndianness = BIG_ENDIAN
        ComBitSize = 9
        ComBitPosition = 31
        ComUpdateBitPosition = -1
        ComTransferProperty = TRIGGERED
        ComSystemTemplateSystemSignalRef = DCDC_LvSideCurr
      DCDC_LvSideVolt (ComSignal):
        ComSignalInitValue = 0
        ComSignalType = UINT8
        ComSignalEndianness = BIG_ENDIAN
        ComBitSize = 8
        ComBitPosition = 7
        ComUpdateBitPosition = -1
        ComTransferProperty = TRIGGERED
        ComSystemTemplateSystemSignalRef = DCDC_LvSideVolt
      ISGF_3_Can_Network_CANNODE_0 (ComIPdu):
        ComIPduSignalProcessing = IMMEDIATE
        ComIPduType = NORMAL
        ComIPduDirection = RECEIVE
        ComIPduGroupRef = ComIPduGroup_Rx
        ComPduIdRef = PduCollection/ISGF_3_Can_Network_CANNODE_0_PduR2Com
        ComIPduSignalRef = ISGF_UdcAct
        ComIPduSignalRef = ISGF_IdcAct
      ISGF_UdcAct (ComSignal):
        ComSignalInitValue = 0
        ComSignalType = UINT16
        ComSignalEndianness = BIG_ENDIAN
        ComBitSize = 10
        ComBitPosition = 12
        ComUpdateBitPosition = -1
        ComTransferProperty = TRIGGERED
        ComSystemTemplateSystemSignalRef = ISGF_UdcAct
      ISGF_IdcAct (ComSignal):
        ComSignalInitValue = 1023
        ComSignalType = UINT16
        ComSignalEndianness = BIG_ENDIAN
        ComBitSize = 11
        ComBitPosition = 7
        ComUpdateBitPosition = -1
        ComTransferProperty = TRIGGERED
        ComSystemTemplateSystemSignalRef = ISGF_IdcAct
      TBOX_2_Can_Network_CANNODE_0 (ComIPdu):
        ComIPduSignalProcessing = IMMEDIATE
        ComIPduType = NORMAL
        ComIPduDirection = RECEIVE
        ComIPduGroupRef = ComIPduGroup_Rx
        ComPduIdRef = PduCollection/TBOX_2_Can_Network_CANNODE_0_PduR2Com
        ComIPduSignalRef = TBOX_BattHeatReq
      TBOX_BattHeatReq (ComSignal):
        ComSignalInitValue = 0
        ComSignalType = UINT8
        ComSignalEndianness = BIG_ENDIAN
        ComBitSize = 2
        ComBitPosition = 41
        ComUpdateBitPosition = -1
        ComTransferProperty = TRIGGERED
        ComSystemTemplateSystemSignalRef = TBOX_BattHeatReq
      ISGF_1_Can_Network_CANNODE_0 (ComIPdu):
        ComIPduSignalProcessing = IMMEDIATE
        ComIPduType = NORMAL
        ComIPduDirection = RECEIVE
        ComIPduGroupRef = ComIPduGroup_Rx
        ComPduIdRef = PduCollection/ISGF_1_Can_Network_CANNODE_0_PduR2Com
        ComIPduSignalRef = ISGF_ModeSt
      ISGF_ModeSt (ComSignal):
        ComSignalInitValue = 0
        ComSignalType = UINT8
        ComSignalEndianness = BIG_ENDIAN
        ComBitSize = 4
        ComBitPosition = 55
        ComUpdateBitPosition = -1
        ComTransferProperty = TRIGGERED
        ComSystemTemplateSystemSignalRef = ISGF_ModeSt
      OBC_3_Can_Network_CANNODE_0 (ComIPdu):
        ComIPduSignalProcessing = IMMEDIATE
        ComIPduType = NORMAL
        ComIPduDirection = RECEIVE
        ComIPduGroupRef = ComIPduGroup_Rx
        ComPduIdRef = PduCollection/OBC_3_Can_Network_CANNODE_0_PduR2Com
        ComIPduSignalRef = OBC_ChgSts
        ComIPduSignalRef = OBC_WorkingMode
        ComIPduSignalRef = OBC_ElectronicLockSts
        ComIPduSignalRef = OBC_CC_ConnectSts
        ComIPduSignalRef = OBC_CP_DutyCycleFault
        ComIPduSignalRef = OBC_CP_DutyCycleValue
      6 x ComSignal, all with ComSignalInitValue=0, ComSignalEndianness=BIG_ENDIAN, ComUpdateBitPosition=-1, ComTransferProperty=TRIGGERED:
        OBC_ChgSts: ComSignalType=UINT8, ComBitSize=3, ComBitPosition=54, ComSystemTemplateSystemSignalRef=OBC_ChgSts
        OBC_WorkingMode: ComSignalType=UINT8, ComBitSize=3, ComBitPosition=47, ComSystemTemplateSystemSignalRef=OBC_WorkingMode
        OBC_ElectronicLockSts: ComSignalType=BOOLEAN, ComBitSize=1, ComBitPosition=35, ComSystemTemplateSystemSignalRef=OBC_ElectronicLockSts
        OBC_CC_ConnectSts: ComSignalType=UINT8, ComBitSize=2, ComBitPosition=34, ComSystemTemplateSystemSignalRef=OBC_CC_ConnectSts
        OBC_CP_DutyCycleFault: ComSignalType=BOOLEAN, ComBitSize=1, ComBitPosition=32, ComSystemTemplateSystemSignalRef=OBC_CP_DutyCycleFault
        OBC_CP_DutyCycleValue: ComSignalType=UINT8, ComBitSize=8, ComBitPosition=7, ComSystemTemplateSystemSignalRef=OBC_CP_DutyCycleValue
      TMF_1_Can_Network_CANNODE_0 (ComIPdu):
        ComIPduSignalProcessing = IMMEDIATE
        ComIPduType = NORMAL
        ComIPduDirection = RECEIVE
        ComIPduGroupRef = ComIPduGroup_Rx
        ComPduIdRef = PduCollection/TMF_1_Can_Network_CANNODE_0_PduR2Com
        ComIPduSignalRef = TMF_ModeSt
      TMF_ModeSt (ComSignal):
        ComSignalInitValue = 0
        ComSignalType = UINT8
        ComSignalEndianness = BIG_ENDIAN
        ComBitSize = 4
        ComBitPosition = 55
        ComUpdateBitPosition = -1
        ComTransferProperty = TRIGGERED
        ComSystemTemplateSystemSignalRef = TMF_ModeSt
      ABM_1_Can_Network_CANNODE_0 (ComIPdu):
        ComIPduSignalProcessing = IMMEDIATE
        ComIPduType = NORMAL
        ComIPduDirection = RECEIVE
        ComIPduGroupRef = ComIPduGroup_Rx
        ComPduIdRef = PduCollection/ABM_1_Can_Network_CANNODE_0_PduR2Com
        ComIPduSignalRef = CrashOutputSts
        ComIPduSignalRef = ABM_1_CheckSum
        ComIPduSignalRef = ABM_1_MessageCounter
      3 x ComSignal, all with ComSignalInitValue=0, ComSignalType=UINT8, ComSignalEndianness=BIG_ENDIAN, ComUpdateBitPosition=-1, ComTransferProperty=TRIGGERED:
        CrashOutputSts: ComBitSize=8, ComBitPosition=31, ComSystemTemplateSystemSignalRef=CrashOutputSts
        ABM_1_CheckSum: ComBitSize=8, ComBitPosition=23, ComSystemTemplateSystemSignalRef=ABM_1_CheckSum
        ABM_1_MessageCounter: ComBitSize=4, ComBitPosition=15, ComSystemTemplateSystemSignalRef=ABM_1_MessageCounter
      ComIPduGroup_Tx (ComIPduGroup)
      BMS_24_Can_Network_CANNODE_0 (ComIPdu):
        ComIPduSignalProcessing = IMMEDIATE
        ComIPduType = NORMAL
        ComIPduDirection = SEND
        ComFirstTimeout = 0.1
        ComTimeout = 0.1
        ComIPduGroupRef = ComIPduGroup_Tx
        ComPduIdRef = PduCollection/BMS_24_Can_Network_CANNODE_0_Com2PduR
        ComIPduSignalRef = BMS_24_Reserved1
        ComIPduSignalRef = BMSH_PackChargingThermalSt
        ComIPduSignalRef = BMS_24_Reserved2
        ComIPduSignalRef = BMSH_PosSideWeldSts
        ComIPduSignalRef = BMSH_InsulationSts
        ComIPduSignalRef = BMSH_InterHVILSts
        ComIPduSignalRef = BMSH_stMode
        ComIPduSignalRef = BMSH_BattVolt
        ComIPduSignalRef = BMSH_BatteryCurrent
        ComIPduSignalRef = BMSH_SOC
        ComTxIPdu: ComMinimumDelayTime=0.0, ComTxIPduUnusedAreasDefault=255
          ComTxModeTrue
            ComTxMode: ComTxModeTimePeriod=0.1, ComTxModeMode=PERIODIC, ComTxModeNumberOfRepetitions=0, ComTxModeRepetitionPeriod=0, ComTxModeTimeOffset=0.0
          ComTxModeFalse
            ComTxMode: ComTxModeTimePeriod=0.1, ComTxModeMode=PERIODIC, ComTxModeNumberOfRepetitions=0, ComTxModeRepetitionPeriod=0, ComTxModeTimeOffset=0.0
      10 x ComSignal, all with ComSignalEndianness=BIG_ENDIAN, ComUpdateBitPosition=-1, ComTransferProperty=TRIGGERED:
        BMS_24_Reserved1: ComSignalInitValue=0, ComSignalType=UINT8, ComBitSize=3, ComBitPosition=63, ComSystemTemplateSystemSignalRef=BMS_24_Reserved1
        BMSH_PackChargingThermalSt: ComSignalInitValue=0, ComSignalType=UINT8, ComBitSize=3, ComBitPosition=60, ComSystemTemplateSystemSignalRef=BMSH_PackChargingThermalSt
        BMS_24_Reserved2: ComSignalInitValue=0, ComSignalType=BOOLEAN, ComBitSize=1, ComBitPosition=57, ComSystemTemplateSystemSignalRef=BMS_24_Reserved2
        BMSH_PosSideWeldSts: ComSignalInitValue=0, ComSignalType=BOOLEAN, ComBitSize=1, ComBitPosition=56, ComSystemTemplateSystemSignalRef=BMSH_PosSideWeldSts
        BMSH_InsulationSts: ComSignalInitValue=0, ComSignalType=UINT8, ComBitSize=2, ComBitPosition=55, ComSystemTemplateSystemSignalRef=BMSH_InsulationSts
        BMSH_InterHVILSts: ComSignalInitValue=0, ComSignalType=UINT8, ComBitSize=2, ComBitPosition=53, ComSystemTemplateSystemSignalRef=BMSH_InterHVILSts
        BMSH_stMode: ComSignalInitValue=0, ComSignalType=UINT8, ComBitSize=4, ComBitPosition=51, ComSystemTemplateSystemSignalRef=BMSH_stMode
        BMSH_BattVolt: ComSignalInitValue=0, ComSignalType=UINT16, ComBitSize=16, ComBitPosition=39, ComSystemTemplateSystemSignalRef=BMSH_BattVolt
        BMSH_BatteryCurrent: ComSignalInitValue=32000, ComSignalType=UINT16, ComBitSize=16, ComBitPosition=23, ComSystemTemplateSystemSignalRef=BMSH_BatteryCurrent
        BMSH_SOC: ComSignalInitValue=0, ComSignalType=UINT16, ComBitSize=16, ComBitPosition=7, ComSystemTemplateSystemSignalRef=BMSH_SOC
      BMS_Tem_6_Can_Network_CANNODE_0 (ComIPdu):
        ComIPduSignalProcessing = IMMEDIATE
        ComIPduType = NORMAL
        ComIPduDirection = SEND
        ComFirstTimeout = 1.0
        ComTimeout = 1.0
        ComIPduGroupRef = ComIPduGroup_Tx
        ComPduIdRef = PduCollection/BMS_Tem_6_Can_Network_CANNODE_0_Com2PduR
        ComIPduSignalRef = BMS_BattTempSensorOrder48
        ComIPduSignalRef = BMS_BattTempSensorOrder47
        ComIPduSignalRef = BMS_BattTempSensorOrder46
        ComIPduSignalRef = BMS_BattTempSensorOrder45
        ComIPduSignalRef = BMS_BattTempSensorOrder44
        ComIPduSignalRef = BMS_BattTempSensorOrder43
        ComIPduSignalRef = BMS_BattTempSensorOrder42
        ComIPduSignalRef = BMS_BattTempSensorOrder41
        ComTxIPdu: ComMinimumDelayTime=0.0, ComTxIPduUnusedAreasDefault=255
          ComTxModeTrue
            ComTxMode: ComTxModeTimePeriod=1.0, ComTxModeMode=PERIODIC, ComTxModeNumberOfRepetitions=0, ComTxModeRepetitionPeriod=0, ComTxModeTimeOffset=0.0
          ComTxModeFalse
            ComTxMode: ComTxModeTimePeriod=1.0, ComTxModeMode=PERIODIC, ComTxModeNumberOfRepetitions=0, ComTxModeRepetitionPeriod=0, ComTxModeTimeOffset=0.0
      8 x ComSignal, all with ComSignalInitValue=0, ComSignalType=UINT8, ComSignalEndianness=BIG_ENDIAN, ComBitSize=8, ComUpdateBitPosition=-1, ComTransferProperty=TRIGGERED:
        BMS_BattTempSensorOrder48: ComBitPosition=63, ComSystemTemplateSystemSignalRef=BMS_BattTempSensorOrder48
        BMS_BattTempSensorOrder47: ComBitPosition=55, ComSystemTemplateSystemSignalRef=BMS_BattTempSensorOrder47
        BMS_BattTempSensorOrder46: ComBitPosition=47, ComSystemTemplateSystemSignalRef=BMS_BattTempSensorOrder46
        BMS_BattTempSensorOrder45: ComBitPosition=39, ComSystemTemplateSystemSignalRef=BMS_BattTempSensorOrder45
        BMS_BattTempSensorOrder44: ComBitPosition=31, ComSystemTemplateSystemSignalRef=BMS_BattTempSensorOrder44
        BMS_BattTempSensorOrder43: ComBitPosition=23, ComSystemTemplateSystemSignalRef=BMS_BattTempSensorOrder43
        BMS_BattTempSensorOrder42: ComBitPosition=15, ComSystemTemplateSystemSignalRef=BMS_BattTempSensorOrder42
        BMS_BattTempSensorOrder41: ComBitPosition=7, ComSystemTemplateSystemSignalRef=BMS_BattTempSensorOrder41
      BMS_Tem_5_Can_Network_CANNODE_0 (ComIPdu):
        ComIPduSignalProcessing = IMMEDIATE
        ComIPduType = NORMAL
        ComIPduDirection = SEND
        ComFirstTimeout = 1.0
        ComTimeout = 1.0
        ComIPduGroupRef = ComIPduGroup_Tx
        ComPduIdRef = PduCollection/BMS_Tem_5_Can_Network_CANNODE_0_Com2PduR
        ComIPduSignalRef = BMS_BattTempSensorOrder40
        ComIPduSignalRef = BMS_BattTempSensorOrder39
        ComIPduSignalRef = BMS_BattTempSensorOrder38
        ComIPduSignalRef = BMS_BattTempSensorOrder37
        ComIPduSignalRef = BMS_BattTempSensorOrder36
        ComIPduSignalRef = BMS_BattTempSensorOrder35
        ComIPduSignalRef = BMS_BattTempSensorOrder34
        ComIPduSignalRef = BMS_BattTempSensorOrder33
        ComTxIPdu: ComMinimumDelayTime=0.0, ComTxIPduUnusedAreasDefault=255
          ComTxModeTrue
            ComTxMode: ComTxModeTimePeriod=1.0, ComTxModeMode=PERIODIC, ComTxModeNumberOfRepetitions=0, ComTxModeRepetitionPeriod=0, ComTxModeTimeOffset=0.0
          ComTxModeFalse
            ComTxMode: ComTxModeTimePeriod=1.0, ComTxModeMode=PERIODIC, ComTxModeNumberOfRepetitions=0, ComTxModeRepetitionPeriod=0, ComTxModeTimeOffset=0.0
      8 x ComSignal, all with ComSignalInitValue=0, ComSignalType=UINT8, ComSignalEndianness=BIG_ENDIAN, ComBitSize=8, ComUpdateBitPosition=-1, ComTransferProperty=TRIGGERED:
        BMS_BattTempSensorOrder40: ComBitPosition=63, ComSystemTemplateSystemSignalRef=BMS_BattTempSensorOrder40
        BMS_BattTempSensorOrder39: ComBitPosition=55, ComSystemTemplateSystemSignalRef=BMS_BattTempSensorOrder39
        BMS_BattTempSensorOrder38: ComBitPosition=47, ComSystemTemplateSystemSignalRef=BMS_BattTempSensorOrder38
        BMS_BattTempSensorOrder37: ComBitPosition=39, ComSystemTemplateSystemSignalRef=BMS_BattTempSensorOrder37
        BMS_BattTempSensorOrder36: ComBitPosition=31, ComSystemTemplateSystemSignalRef=BMS_BattTempSensorOrder36
        BMS_BattTempSensorOrder35: ComBitPosition=23, ComSystemTemplateSystemSignalRef=BMS_BattTempSensorOrder35
        BMS_BattTempSensorOrder34: ComBitPosition=15, ComSystemTemplateSystemSignalRef=BMS_BattTempSensorOrder34
        BMS_BattTempSensorOrder33: ComBitPosition=7, ComSystemTemplateSystemSignalRef=BMS_BattTempSensorOrder33
      BMS_19_Can_Network_CANNODE_0 (ComIPdu):
        ComIPduSignalProcessing = IMMEDIATE
        ComIPduType = NORMAL
        ComIPduDirection = SEND
        ComFirstTimeout = 1.0
        ComTimeout = 1.0
        ComIPduGroupRef = ComIPduGroup_Tx
        ComPduIdRef = PduCollection/BMS_19_Can_Network_CANNODE_0_Com2PduR
        ComIPduSignalRef = BMS_DTCOrder6
        ComIPduSignalRef = BMS_DTCOrder5
        ComTxIPdu: ComMinimumDelayTime=0.0, ComTxIPduUnusedAreasDefault=255
          ComTxModeTrue
            ComTxMode: ComTxModeTimePeriod=1.0, ComTxModeMode=PERIODIC, ComTxModeNumberOfRepetitions=0, ComTxModeRepetitionPeriod=0, ComTxModeTimeOffset=0.0
          ComTxModeFalse
            ComTxMode: ComTxModeTimePeriod=1.0, ComTxModeMode=PERIODIC, ComTxModeNumberOfRepetitions=0, ComTxModeRepetitionPeriod=0, ComTxModeTimeOffset=0.0
      BMS_DTCOrder6 (ComSignal):
        ComSignalInitValue = 0
        ComSignalType = UINT32
        ComSignalEndianness = BIG_ENDIAN
        ComBitSize = 24
        ComBitPosition = 39
        ComUpdateBitPosition = -1
        ComTransferProperty = TRIGGERED
        ComSystemTemplateSystemSignalRef = BMS_DTCOrder6
      BMS_DTCOrder5 (ComSignal):
        ComSignalInitValue = 0
        ComSignalType = UINT32
        ComSignalEndianness = BIG_ENDIAN
        ComBitSize = 24
        ComBitPosition = 7
        ComUpdateBitPosition = -1
        ComTransferProperty = TRIGGERED
        ComSystemTemplateSystemSignalRef = BMS_DTCOrder5
      BMS_18_Can_Network_CANNODE_0 (ComIPdu):
        ComIPduSignalProcessing = IMMEDIATE
        ComIPduType = NORMAL
        ComIPduDirection = SEND
        ComFirstTimeout = 1.0
        ComTimeout = 1.0
        ComIPduGroupRef = ComIPduGroup_Tx
        ComPduIdRef = PduCollection/BMS_18_Can_Network_CANNODE_0_Com2PduR
        ComIPduSignalRef = BMS_DTCOrder4
        ComIPduSignalRef = BMS_DTCOrder3
        ComTxIPdu: ComMinimumDelayTime=0.0, ComTxIPduUnusedAreasDefault=255
          ComTxModeTrue
            ComTxMode: ComTxModeTimePeriod=1.0, ComTxModeMode=PERIODIC, ComTxModeNumberOfRepetitions=0, ComTxModeRepetitionPeriod=0, ComTxModeTimeOffset=0.0
          ComTxModeFalse
            ComTxMode: ComTxModeTimePeriod=1.0, ComTxModeMode=PERIODIC, ComTxModeNumberOfRepetitions=0, ComTxModeRepetitionPeriod=0, ComTxModeTimeOffset=0.0
      BMS_DTCOrder4 (ComSignal):
        ComSignalInitValue = 0
        ComSignalType = UINT32
        ComSignalEndianness = BIG_ENDIAN
        ComBitSize = 24
        ComBitPosition = 39
        ComUpdateBitPosition = -1
        ComTransferProperty = TRIGGERED
        ComSystemTemplateSystemSignalRef = BMS_DTCOrder4
      BMS_DTCOrder3 (ComSignal):
        ComSignalInitValue = 0
        ComSignalType = UINT32
        ComSignalEndianness = BIG_ENDIAN
        ComBitSize = 24
        ComBitPosition = 7
        ComUpdateBitPosition = -1
        ComTransferProperty = TRIGGERED
        ComSystemTemplateSystemSignalRef = BMS_DTCOrder3
      BMS_17_Can_Network_CANNODE_0 (ComIPdu):
        ComIPduSignalProcessing = IMMEDIATE
        ComIPduType = NORMAL
        ComIPduDirection = SEND
        ComFirstTimeout = 1.0
        ComTimeout = 1.0
        ComIPduGroupRef = ComIPduGroup_Tx
        ComPduIdRef = PduCollection/BMS_17_Can_Network_CANNODE_0_Com2PduR
        ComIPduSignalRef = BMS_DTCTotalNum
        ComIPduSignalRef = BMS_DTCOrder2
        ComIPduSignalRef = BMS_DTCOrder1
        ComTxIPdu: ComMinimumDelayTime=0.0, ComTxIPduUnusedAreasDefault=255
          ComTxModeTrue
            ComTxMode: ComTxModeTimePeriod=1.0, ComTxModeMode=PERIODIC, ComTxModeNumberOfRepetitions=0, ComTxModeRepetitionPeriod=0, ComTxModeTimeOffset=0.0
          ComTxModeFalse
            ComTxMode: ComTxModeTimePeriod=1.0, ComTxModeMode=PERIODIC, ComTxModeNumberOfRepetitions=0, ComTxModeRepetitionPeriod=0, ComTxModeTimeOffset=0.0
      3 x ComSignal, all with ComSignalInitValue=0, ComSignalEndianness=BIG_ENDIAN, ComUpdateBitPosition=-1, ComTransferProperty=TRIGGERED:
        BMS_DTCTotalNum: ComSignalType=UINT8, ComBitSize=8, ComBitPosition=63, ComSystemTemplateSystemSignalRef=BMS_DTCTotalNum
        BMS_DTCOrder2: ComSignalType=UINT32, ComBitSize=24, ComBitPosition=39, ComSystemTemplateSystemSignalRef=BMS_DTCOrder2
        BMS_DTCOrder1: ComSignalType=UINT32, ComBitSize=24, ComBitPosition=7, ComSystemTemplateSystemSignalRef=BMS_DTCOrder1
      BMS_Tem_4_Can_Network_CANNODE_0 (ComIPdu):
        ComIPduSignalProcessing = IMMEDIATE
        ComIPduType = NORMAL
        ComIPduDirection = SEND
        ComFirstTimeout = 1.0
        ComTimeout = 1.0
        ComIPduGroupRef = ComIPduGroup_Tx
        ComPduIdRef = PduCollection/BMS_Tem_4_Can_Network_CANNODE_0_Com2PduR
        ComIPduSignalRef = BMS_BattTempSensorOrder32
        ComIPduSignalRef = BMS_BattTempSensorOrder31
        ComIPduSignalRef = BMS_BattTempSensorOrder30
        ComIPduSignalRef = BMS_BattTempSensorOrder29
        ComIPduSignalRef = BMS_BattTempSensorOrder28
        ComIPduSignalRef = BMS_BattTempSensorOrder27
        ComIPduSignalRef = BMS_BattTempSensorOrder26
        ComIPduSignalRef = BMS_BattTempSensorOrder25
        ComTxIPdu: ComMinimumDelayTime=0.0, ComTxIPduUnusedAreasDefault=255
          ComTxModeTrue
            ComTxMode: ComTxModeTimePeriod=1.0, ComTxModeMode=PERIODIC, ComTxModeNumberOfRepetitions=0, ComTxModeRepetitionPeriod=0, ComTxModeTimeOffset=0.0
          ComTxModeFalse
            ComTxMode: ComTxModeTimePeriod=1.0, ComTxModeMode=PERIODIC, ComTxModeNumberOfRepetitions=0, ComTxModeRepetitionPeriod=0, ComTxModeTimeOffset=0.0
      8 x ComSignal, all with ComSignalInitValue=0, ComSignalType=UINT8, ComSignalEndianness=BIG_ENDIAN, ComBitSize=8, ComUpdateBitPosition=-1, ComTransferProperty=TRIGGERED:
        BMS_BattTempSensorOrder32: ComBitPosition=63, ComSystemTemplateSystemSignalRef=BMS_BattTempSensorOrder32
        BMS_BattTempSensorOrder31: ComBitPosition=55, ComSystemTemplateSystemSignalRef=BMS_BattTempSensorOrder31
        BMS_BattTempSensorOrder30: ComBitPosition=47, ComSystemTemplateSystemSignalRef=BMS_BattTempSensorOrder30
        BMS_BattTempSensorOrder29: ComBitPosition=39, ComSystemTemplateSystemSignalRef=BMS_BattTempSensorOrder29
        BMS_BattTempSensorOrder28: ComBitPosition=31, ComSystemTemplateSystemSignalRef=BMS_BattTempSensorOrder28
        BMS_BattTempSensorOrder27: ComBitPosition=23, ComSystemTemplateSystemSignalRef=BMS_BattTempSensorOrder27
        BMS_BattTempSensorOrder26: ComBitPosition=15, ComSystemTemplateSystemSignalRef=BMS_BattTempSensorOrder26
        BMS_BattTempSensorOrder25: ComBitPosition=7, ComSystemTemplateSystemSignalRef=BMS_BattTempSensorOrder25
      BMS_Tem_3_Can_Network_CANNODE_0 (ComIPdu):
        ComIPduSignalProcessing = IMMEDIATE
        ComIPduType = NORMAL
        ComIPduDirection = SEND
        ComFirstTimeout = 1.0
        ComTimeout = 1.0
        ComIPduGroupRef = ComIPduGroup_Tx
        ComPduIdRef = PduCollection/BMS_Tem_3_Can_Network_CANNODE_0_Com2PduR
        ComIPduSignalRef = BMS_BattTempSensorOrder24
        ComIPduSignalRef = BMS_BattTempSensorOrder23
        ComIPduSignalRef = BMS_BattTempSensorOrder22
        ComIPduSignalRef = BMS_BattTempSensorOrder21
        ComIPduSignalRef = BMS_BattTempSensorOrder20
        ComIPduSignalRef = BMS_BattTempSensorOrder19
        ComIPduSignalRef = BMS_BattTempSensorOrder18
        ComIPduSignalRef = BMS_BattTempSensorOrder17
        ComTxIPdu: ComMinimumDelayTime=0.0, ComTxIPduUnusedAreasDefault=255
          ComTxModeTrue
            ComTxMode: ComTxModeTimePeriod=1.0, ComTxModeMode=PERIODIC, ComTxModeNumberOfRepetitions=0, ComTxModeRepetitionPeriod=0, ComTxModeTimeOffset=0.0
          ComTxModeFalse
            ComTxMode: ComTxModeTimePeriod=1.0, ComTxModeMode=PERIODIC, ComTxModeNumberOfRepetitions=0, ComTxModeRepetitionPeriod=0, ComTxModeTimeOffset=0.0
      8 x ComSignal, all with ComSignalInitValue=0, ComSignalType=UINT8, ComSignalEndianness=BIG_ENDIAN, ComBitSize=8, ComUpdateBitPosition=-1, ComTransferProperty=TRIGGERED:
        BMS_BattTempSensorOrder24: ComBitPosition=63, ComSystemTemplateSystemSignalRef=BMS_BattTempSensorOrder24
        BMS_BattTempSensorOrder23: ComBitPosition=55, ComSystemTemplateSystemSignalRef=BMS_BattTempSensorOrder23
        BMS_BattTempSensorOrder22: ComBitPosition=47, ComSystemTemplateSystemSignalRef=BMS_BattTempSensorOrder22
        BMS_BattTempSensorOrder21: ComBitPosition=39, ComSystemTemplateSystemSignalRef=BMS_BattTempSensorOrder21
        BMS_BattTempSensorOrder20: ComBitPosition=31, ComSystemTemplateSystemSignalRef=BMS_BattTempSensorOrder20
        BMS_BattTempSensorOrder19: ComBitPosition=23, ComSystemTemplateSystemSignalRef=BMS_BattTempSensorOrder19
        BMS_BattTempSensorOrder18: ComBitPosition=15, ComSystemTemplateSystemSignalRef=BMS_BattTempSensorOrder18
        BMS_BattTempSensorOrder17: ComBitPosition=7, ComSystemTemplateSystemSignalRef=BMS_BattTempSensorOrder17
      BMS_16_Can_Network_CANNODE_0 (ComIPdu):
        ComIPduSignalProcessing = IMMEDIATE
        ComIPduType = NORMAL
        ComIPduDirection = SEND
        ComFirstTimeout = 1.0
        ComTimeout = 1.0
        ComIPduGroupRef = ComIPduGroup_Tx
        ComPduIdRef = PduCollection/BMS_16_Can_Network_CANNODE_0_Com2PduR
        ComIPduSignalRef = BMS_SubsymCodeOrder24
        ComIPduSignalRef = BMS_SubsymCodeOrder23
        ComIPduSignalRef = BMS_SubsymCodeOrder22
        ComIPduSignalRef = BMS_SubsymCodeOrder21
        ComIPduSignalRef = BMS_SubsymCodeOrder20
        ComIPduSignalRef = BMS_SubsymCodeOrder19
        ComIPduSignalRef = BMS_SubsymCodeFrameTotalNum
        ComIPduSignalRef = BMS_SubsymCodeFrameOrder4
        ComTxIPdu: ComMinimumDelayTime=0.0, ComTxIPduUnusedAreasDefault=255
          ComTxModeTrue
            ComTxMode: ComTxModeTimePeriod=1.0, ComTxModeMode=PERIODIC, ComTxModeNumberOfRepetitions=0, ComTxModeRepetitionPeriod=0, ComTxModeTimeOffset=0.0
          ComTxModeFalse
            ComTxMode: ComTxModeTimePeriod=1.0, ComTxModeMode=PERIODIC, ComTxModeNumberOfRepetitions=0, ComTxModeRepetitionPeriod=0, ComTxModeTimeOffset=0.0
      8 x ComSignal, all with ComSignalInitValue=0, ComSignalType=UINT8, ComSignalEndianness=BIG_ENDIAN, ComBitSize=8, ComUpdateBitPosition=-1, ComTransferProperty=TRIGGERED:
        BMS_SubsymCodeOrder24: ComBitPosition=63, ComSystemTemplateSystemSignalRef=BMS_SubsymCodeOrder24
        BMS_SubsymCodeOrder23: ComBitPosition=55, ComSystemTemplateSystemSignalRef=BMS_SubsymCodeOrder23
        BMS_SubsymCodeOrder22: ComBitPosition=47, ComSystemTemplateSystemSignalRef=BMS_SubsymCodeOrder22
        BMS_SubsymCodeOrder21: ComBitPosition=39, ComSystemTemplateSystemSignalRef=BMS_SubsymCodeOrder21
        BMS_SubsymCodeOrder20: ComBitPosition=31, ComSystemTemplateSystemSignalRef=BMS_SubsymCodeOrder20
        BMS_SubsymCodeOrder19: ComBitPosition=23, ComSystemTemplateSystemSignalRef=BMS_SubsymCodeOrder19
        BMS_SubsymCodeFrameTotalNum: ComBitPosition=15, ComSystemTemplateSystemSignalRef=BMS_SubsymCodeFrameTotalNum
        BMS_SubsymCodeFrameOrder4: ComBitPosition=7, ComSystemTemplateSystemSignalRef=BMS_SubsymCodeFrameOrder4
      BMS_Tem_2_Can_Network_CANNODE_0 (ComIPdu):
        ComIPduSignalProcessing = IMMEDIATE
        ComIPduType = NORMAL
        ComIPduDirection = SEND
        ComFirstTimeout = 1.0
        ComTimeout = 1.0
        ComIPduGroupRef = ComIPduGroup_Tx
        ComPduIdRef = PduCollection/BMS_Tem_2_Can_Network_CANNODE_0_Com2PduR
        ComIPduSignalRef = BMS_BattTempSensorOrder16
        ComIPduSignalRef = BMS_BattTempSensorOrder15
        ComIPduSignalRef = BMS_BattTempSensorOrder14
        ComIPduSignalRef = BMS_BattTempSensorOrder13
        ComIPduSignalRef = BMS_BattTempSensorOrder12
        ComIPduSignalRef = BMS_BattTempSensorOrder11
        ComIPduSignalRef = BMS_BattTempSensorOrder10
        ComIPduSignalRef = BMS_BattTempSensorOrder9
        ComTxIPdu: ComMinimumDelayTime=0.0, ComTxIPduUnusedAreasDefault=255
          ComTxModeTrue
            ComTxMode: ComTxModeTimePeriod=1.0, ComTxModeMode=PERIODIC, ComTxModeNumberOfRepetitions=0, ComTxModeRepetitionPeriod=0, ComTxModeTimeOffset=0.0
          ComTxModeFalse
            ComTxMode: ComTxModeTimePeriod=1.0, ComTxModeMode=PERIODIC, ComTxModeNumberOfRepetitions=0, ComTxModeRepetitionPeriod=0, ComTxModeTimeOffset=0.0
      8 x ComSignal, all with ComSignalInitValue=0, ComSignalType=UINT8, ComSignalEndianness=BIG_ENDIAN, ComBitSize=8, ComUpdateBitPosition=-1, ComTransferProperty=TRIGGERED:
        BMS_BattTempSensorOrder16: ComBitPosition=63, ComSystemTemplateSystemSignalRef=BMS_BattTempSensorOrder16
        BMS_BattTempSensorOrder15: ComBitPosition=55, ComSystemTemplateSystemSignalRef=BMS_BattTempSensorOrder15
        BMS_BattTempSensorOrder14: ComBitPosition=47, ComSystemTemplateSystemSignalRef=BMS_BattTempSensorOrder14
        BMS_BattTempSensorOrder13: ComBitPosition=39, ComSystemTemplateSystemSignalRef=BMS_BattTempSensorOrder13
        BMS_BattTempSensorOrder12: ComBitPosition=31, ComSystemTemplateSystemSignalRef=BMS_BattTempSensorOrder12
        BMS_BattTempSensorOrder11: ComBitPosition=23, ComSystemTemplateSystemSignalRef=BMS_BattTempSensorOrder11
        BMS_BattTempSensorOrder10: ComBitPosition=15, ComSystemTemplateSystemSignalRef=BMS_BattTempSensorOrder10
        BMS_BattTempSensorOrder9: ComBitPosition=7, ComSystemTemplateSystemSignalRef=BMS_BattTempSensorOrder9
      BMS_15_Can_Network_CANNODE_0 (ComIPdu):
        ComIPduSignalProcessing = IMMEDIATE
        ComIPduType = NORMAL
        ComIPduDirection = SEND
        ComFirstTimeout = 1.0
        ComTimeout = 1.0
        ComIPduGroupRef = ComIPduGroup_Tx
        ComPduIdRef = PduCollection/BMS_15_Can_Network_CANNODE_0_Com2PduR
        ComIPduSignalRef = BMS_SubsymCodeOrder18
        ComIPduSignalRef = BMS_SubsymCodeOrder17
        ComIPduSignalRef = BMS_SubsymCodeOrder16
        ComIPduSignalRef = BMS_SubsymCodeOrder15
        ComIPduSignalRef = BMS_SubsymCodeOrder14
        ComIPduSignalRef = BMS_SubsymCodeOrder13
        ComIPduSignalRef = BMS_SubsymCodeFrameTotalNum_BMS_15
        ComIPduSignalRef = BMS_SubsymCodeFrameOrder3
        ComTxIPdu: ComMinimumDelayTime=0.0, ComTxIPduUnusedAreasDefault=255
          ComTxModeTrue
            ComTxMode: ComTxModeTimePeriod=1.0, ComTxModeMode=PERIODIC, ComTxModeNumberOfRepetitions=0, ComTxModeRepetitionPeriod=0, ComTxModeTimeOffset=0.0
          ComTxModeFalse
            ComTxMode: ComTxModeTimePeriod=1.0, ComTxModeMode=PERIODIC, ComTxModeNumberOfRepetitions=0, ComTxModeRepetitionPeriod=0, ComTxModeTimeOffset=0.0
      8 x ComSignal, all with ComSignalInitValue=0, ComSignalType=UINT8, ComSignalEndianness=BIG_ENDIAN, ComBitSize=8, ComUpdateBitPosition=-1, ComTransferProperty=TRIGGERED:
        BMS_SubsymCodeOrder18: ComBitPosition=63, ComSystemTemplateSystemSignalRef=BMS_SubsymCodeOrder18
        BMS_SubsymCodeOrder17: ComBitPosition=55, ComSystemTemplateSystemSignalRef=BMS_SubsymCodeOrder17
        BMS_SubsymCodeOrder16: ComBitPosition=47, ComSystemTemplateSystemSignalRef=BMS_SubsymCodeOrder16
        BMS_SubsymCodeOrder15: ComBitPosition=39, ComSystemTemplateSystemSignalRef=BMS_SubsymCodeOrder15
        BMS_SubsymCodeOrder14: ComBitPosition=31, ComSystemTemplateSystemSignalRef=BMS_SubsymCodeOrder14
        BMS_SubsymCodeOrder13: ComBitPosition=23, ComSystemTemplateSystemSignalRef=BMS_SubsymCodeOrder13
        BMS_SubsymCodeFrameTotalNum_BMS_15: ComBitPosition=15, ComSystemTemplateSystemSignalRef=BMS_SubsymCodeFrameTotalNum
        BMS_SubsymCodeFrameOrder3: ComBitPosition=7, ComSystemTemplateSystemSignalRef=BMS_SubsymCodeFrameOrder3
      BMS_Tem_1_Can_Network_CANNODE_0 (ComIPdu):
        ComIPduSignalProcessing = IMMEDIATE
        ComIPduType = NORMAL
        ComIPduDirection = SEND
        ComFirstTimeout = 1.0
        ComTimeout = 1.0
        ComIPduGroupRef = ComIPduGroup_Tx
        ComPduIdRef = PduCollection/BMS_Tem_1_Can_Network_CANNODE_0_Com2PduR
        ComIPduSignalRef = BMS_BattTempSensorOrder8
        ComIPduSignalRef = BMS_BattTempSensorOrder7
        ComIPduSignalRef = BMS_BattTempSensorOrder6
        ComIPduSignalRef = BMS_BattTempSensorOrder5
        ComIPduSignalRef = BMS_BattTempSensorOrder4
        ComIPduSignalRef = BMS_BattTempSensorOrder3
        ComIPduSignalRef = BMS_BattTempSensorOrder2
        ComIPduSignalRef = BMS_BattTempSensorOrder1
        ComTxIPdu: ComMinimumDelayTime=0.0, ComTxIPduUnusedAreasDefault=255
          ComTxModeTrue
            ComTxMode: ComTxModeTimePeriod=1.0, ComTxModeMode=PERIODIC, ComTxModeNumberOfRepetitions=0, ComTxModeRepetitionPeriod=0, ComTxModeTimeOffset=0.0
          ComTxModeFalse
            ComTxMode: ComTxModeTimePeriod=1.0, ComTxModeMode=PERIODIC, ComTxModeNumberOfRepetitions=0, ComTxModeRepetitionPeriod=0, ComTxModeTimeOffset=0.0
      8 x ComSignal, all with ComSignalInitValue=0, ComSignalType=UINT8, ComSignalEndianness=BIG_ENDIAN, ComBitSize=8, ComUpdateBitPosition=-1, ComTransferProperty=TRIGGERED:
        BMS_BattTempSensorOrder8: ComBitPosition=63, ComSystemTemplateSystemSignalRef=BMS_BattTempSensorOrder8
        BMS_BattTempSensorOrder7: ComBitPosition=55, ComSystemTemplateSystemSignalRef=BMS_BattTempSensorOrder7
        BMS_BattTempSensorOrder6: ComBitPosition=47, ComSystemTemplateSystemSignalRef=BMS_BattTempSensorOrder6
        BMS_BattTempSensorOrder5: ComBitPosition=39, ComSystemTemplateSystemSignalRef=BMS_BattTempSensorOrder5
        BMS_BattTempSensorOrder4: ComBitPosition=31, ComSystemTemplateSystemSignalRef=BMS_BattTempSensorOrder4
        BMS_BattTempSensorOrder3: ComBitPosition=23, ComSystemTemplateSystemSignalRef=BMS_BattTempSensorOrder3
        BMS_BattTempSensorOrder2: ComBitPosition=15, ComSystemTemplateSystemSignalRef=BMS_BattTempSensorOrder2
        BMS_BattTempSensorOrder1: ComBitPosition=7, ComSystemTemplateSystemSignalRef=BMS_BattTempSensorOrder1
      BMS_14_Can_Network_CANNODE_0 (ComIPdu):
        ComIPduSignalProcessing = IMMEDIATE
        ComIPduType = NORMAL
        ComIPduDirection = SEND
        ComFirstTimeout = 1.0
        ComTimeout = 1.0
        ComIPduGroupRef = ComIPduGroup_Tx
        ComPduIdRef = PduCollection/BMS_14_Can_Network_CANNODE_0_Com2PduR
        ComIPduSignalRef = BMS_SubsymCodeOrder12
        ComIPduSignalRef = BMS_SubsymCodeOrder11
        ComIPduSignalRef = BMS_SubsymCodeOrder10
        ComIPduSignalRef = BMS_SubsymCodeOrder9
        ComIPduSignalRef = BMS_SubsymCodeOrder8
        ComIPduSignalRef = BMS_SubsymCodeOrder7
        ComIPduSignalRef = BMS_SubsymCodeFrameTotalNum_BMS_14
        ComIPduSignalRef = BMS_SubsymCodeFrameOrder2
        ComTxIPdu: ComMinimumDelayTime=0.0, ComTxIPduUnusedAreasDefault=255
          ComTxModeTrue
            ComTxMode: ComTxModeTimePeriod=1.0, ComTxModeMode=PERIODIC, ComTxModeNumberOfRepetitions=0, ComTxModeRepetitionPeriod=0, ComTxModeTimeOffset=0.0
          ComTxModeFalse
            ComTxMode: ComTxModeTimePeriod=1.0, ComTxModeMode=PERIODIC, ComTxModeNumberOfRepetitions=0, ComTxModeRepetitionPeriod=0, ComTxModeTimeOffset=0.0
      8 x ComSignal, all with ComSignalInitValue=0, ComSignalType=UINT8, ComSignalEndianness=BIG_ENDIAN, ComBitSize=8, ComUpdateBitPosition=-1, ComTransferProperty=TRIGGERED:
        BMS_SubsymCodeOrder12: ComBitPosition=63, ComSystemTemplateSystemSignalRef=BMS_SubsymCodeOrder12
        BMS_SubsymCodeOrder11: ComBitPosition=55, ComSystemTemplateSystemSignalRef=BMS_SubsymCodeOrder11
        BMS_SubsymCodeOrder10: ComBitPosition=47, ComSystemTemplateSystemSignalRef=BMS_SubsymCodeOrder10
        BMS_SubsymCodeOrder9: ComBitPosition=39, ComSystemTemplateSystemSignalRef=BMS_SubsymCodeOrder9
        BMS_SubsymCodeOrder8: ComBitPosition=31, ComSystemTemplateSystemSignalRef=BMS_SubsymCodeOrder8
        BMS_SubsymCodeOrder7: ComBitPosition=23, ComSystemTemplateSystemSignalRef=BMS_SubsymCodeOrder7
        BMS_SubsymCodeFrameTotalNum_BMS_14: ComBitPosition=15, ComSystemTemplateSystemSignalRef=BMS_SubsymCodeFrameTotalNum
        BMS_SubsymCodeFrameOrder2: ComBitPosition=7, ComSystemTemplateSystemSignalRef=BMS_SubsymCodeFrameOrder2
      BMS_Vol_9_Can_Network_CANNODE_0 (ComIPdu):
        ComIPduSignalProcessing = IMMEDIATE
        ComIPduType = NORMAL
        ComIPduDirection = SEND
        ComFirstTimeout = 1.0
        ComTimeout = 1.0
        ComIPduGroupRef = ComIPduGroup_Tx
        ComPduIdRef = PduCollection/BMS_Vol_9_Can_Network_CANNODE_0_Com2PduR
        ComIPduSignalRef = BMS_BattCellOrder36Vol
        ComIPduSignalRef = BMS_BattCellOrder35Vol
        ComIPduSignalRef = BMS_BattCellOrder34Vol
        ComIPduSignalRef = BMS_BattCellOrder33Vol
        ComTxIPdu: ComMinimumDelayTime=0.0, ComTxIPduUnusedAreasDefault=255
          ComTxModeTrue
            ComTxMode: ComTxModeTimePeriod=1.0, ComTxModeMode=PERIODIC, ComTxModeNumberOfRepetitions=0, ComTxModeRepetitionPeriod=0, ComTxModeTimeOffset=0.0
          ComTxModeFalse
            ComTxMode: ComTxModeTimePeriod=1.0, ComTxModeMode=PERIODIC, ComTxModeNumberOfRepetitions=0, ComTxModeRepetitionPeriod=0, ComTxModeTimeOffset=0.0
      4 x ComSignal, all with ComSignalInitValue=0, ComSignalType=UINT16, ComSignalEndianness=BIG_ENDIAN, ComBitSize=16, ComUpdateBitPosition=-1, ComTransferProperty=TRIGGERED:
        BMS_BattCellOrder36Vol: ComBitPosition=55, ComSystemTemplateSystemSignalRef=BMS_BattCellOrder36Vol
        BMS_BattCellOrder35Vol: ComBitPosition=39, ComSystemTemplateSystemSignalRef=BMS_BattCellOrder35Vol
        BMS_BattCellOrder34Vol: ComBitPosition=23, ComSystemTemplateSystemSignalRef=BMS_BattCellOrder34Vol
        BMS_BattCellOrder33Vol: ComBitPosition=7, ComSystemTemplateSystemSignalRef=BMS_BattCellOrder33Vol
      BMS_21_Can_Network_CANNODE_0 (ComIPdu):
        ComIPduSignalProcessing = IMMEDIATE
        ComIPduType = NORMAL
        ComIPduDirection = SEND
        ComFirstTimeout = 1.0
        ComTimeout = 1.0
        ComIPduGroupRef = ComIPduGroup_Tx
        ComPduIdRef = PduCollection/BMS_21_Can_Network_CANNODE_0_Com2PduR
        ComIPduSignalRef = BMSH_BPTotalDischargeEnergy
        ComIPduSignalRef = BMSH_TotalFeedbackEnergy
        ComIPduSignalRef = BMSH_TotalChargeEnergy
        ComTxIPdu: ComMinimumDelayTime=0.0, ComTxIPduUnusedAreasDefault=255
          ComTxModeTrue
            ComTxMode: ComTxModeTimePeriod=1.0, ComTxModeMode=PERIODIC, ComTxModeNumberOfRepetitions=0, ComTxModeRepetitionPeriod=0, ComTxModeTimeOffset=0.0
          ComTxModeFalse
            ComTxMode: ComTxModeTimePeriod=1.0, ComTxModeMode=PERIODIC, ComTxModeNumberOfRepetitions=0, ComTxModeRepetitionPeriod=0, ComTxModeTimeOffset=0.0
      3 x ComSignal, all with ComSignalInitValue=0, ComSignalType=UINT32, ComSignalEndianness=BIG_ENDIAN, ComUpdateBitPosition=-1, ComTransferProperty=TRIGGERED:
        BMSH_BPTotalDischargeEnergy: ComBitSize=24, ComBitPosition=47, ComSystemTemplateSystemSignalRef=BMSH_BPTotalDischargeEnergy
        BMSH_TotalFeedbackEnergy: ComBitSize=20, ComBitPosition=19, ComSystemTemplateSystemSignalRef=BMSH_TotalFeedbackEnergy
        BMSH_TotalChargeEnergy: ComBitSize=20, ComBitPosition=7, ComSystemTemplateSystemSignalRef=BMSH_TotalChargeEnergy
      BMS_Vol_8_Can_Network_CANNODE_0 (ComIPdu):
        ComIPduSignalProcessing = IMMEDIATE
        ComIPduType = NORMAL
        ComIPduDirection = SEND
        ComFirstTimeout = 1.0
        ComTimeout = 1.0
        ComIPduGroupRef = ComIPduGroup_Tx
        ComPduIdRef = PduCollection/BMS_Vol_8_Can_Network_CANNODE_0_Com2PduR
        ComIPduSignalRef = BMS_BattCellOrder32Vol
        ComIPduSignalRef = BMS_BattCellOrder31Vol
        ComIPduSignalRef = BMS_BattCellOrder30Vol
        ComIPduSignalRef = BMS_BattCellOrder29Vol
        ComTxIPdu: ComMinimumDelayTime=0.0, ComTxIPduUnusedAreasDefault=255
          ComTxModeTrue
            ComTxMode: ComTxModeTimePeriod=1.0, ComTxModeMode=PERIODIC, ComTxModeNumberOfRepetitions=0, ComTxModeRepetitionPeriod=0, ComTxModeTimeOffset=0.0
          ComTxModeFalse
            ComTxMode: ComTxModeTimePeriod=1.0, ComTxModeMode=PERIODIC, ComTxModeNumberOfRepetitions=0, ComTxModeRepetitionPeriod=0, ComTxModeTimeOffset=0.0
      4 x ComSignal, all with ComSignalInitValue=0, ComSignalType=UINT16, ComSignalEndianness=BIG_ENDIAN, ComBitSize=16, ComUpdateBitPosition=-1, ComTransferProperty=TRIGGERED:
        BMS_BattCellOrder32Vol: ComBitPosition=55, ComSystemTemplateSystemSignalRef=BMS_BattCellOrder32Vol
        BMS_BattCellOrder31Vol: ComBitPosition=39, ComSystemTemplateSystemSignalRef=BMS_BattCellOrder31Vol
        BMS_BattCellOrder30Vol: ComBitPosition=23, ComSystemTemplateSystemSignalRef=BMS_BattCellOrder30Vol
        BMS_BattCellOrder29Vol: ComBitPosition=7, ComSystemTemplateSystemSignalRef=BMS_BattCellOrder29Vol
      BMS_20_Can_Network_CANNODE_0 (ComIPdu):
        ComIPduSignalProcessing = IMMEDIATE
        ComIPduType = NORMAL
        ComIPduDirection = SEND
        ComFirstTimeout = 1.0
        ComTimeout = 1.0
        ComIPduGroupRef = ComIPduGroup_Tx
        ComPduIdRef = PduCollection/BMS_20_Can_Network_CANNODE_0_Com2PduR
        ComIPduSignalRef = BMSH_19_Reserved1
        ComIPduSignalRef = BMSH_CellSensor_TotalNum
        ComIPduSignalRef = BMSH_SingleFeedbackEnergy
        ComIPduSignalRef = BMSH_SingleDisChargeEnergy
        ComIPduSignalRef = BMSH_SingleChargeEnergy
        ComTxIPdu: ComMinimumDelayTime=0.0, ComTxIPduUnusedAreasDefault=255
          ComTxModeTrue
            ComTxMode: ComTxModeTimePeriod=1.0, ComTxModeMode=PERIODIC, ComTxModeNumberOfRepetitions=0, ComTxModeRepetitionPeriod=0, ComTxModeTimeOffset=0.0
          ComTxModeFalse
            ComTxMode: ComTxModeTimePeriod=1.0, ComTxModeMode=PERIODIC, ComTxModeNumberOfRepetitions=0, ComTxModeRepetitionPeriod=0, ComTxModeTimeOffset=0.0
      5 x ComSignal, all with ComSignalInitValue=0, ComSignalEndianness=BIG_ENDIAN, ComUpdateBitPosition=-1, ComTransferProperty=TRIGGERED:
        BMSH_19_Reserved1: ComSignalType=UINT8, ComBitSize=8, ComBitPosition=63, ComSystemTemplateSystemSignalRef=BMSH_19_Reserved1
        BMSH_CellSensor_TotalNum: ComSignalType=UINT8, ComBitSize=8, ComBitPosition=55, ComSystemTemplateSystemSignalRef=BMSH_CellSensor_TotalNum
        BMSH_SingleFeedbackEnergy: ComSignalType=UINT16, ComBitSize=16, ComBitPosition=39, ComSystemTemplateSystemSignalRef=BMSH_SingleFeedbackEnergy
        BMSH_SingleDisChargeEnergy: ComSignalType=UINT16, ComBitSize=16, ComBitPosition=23, ComSystemTemplateSystemSignalRef=BMSH_SingleDisChargeEnergy
        BMSH_SingleChargeEnergy: ComSignalType=UINT16, ComBitSize=16, ComBitPosition=7, ComSystemTemplateSystemSignalRef=BMSH_SingleChargeEnergy
      BMS_Vol_7_Can_Network_CANNODE_0 (ComIPdu):
        ComIPduSignalProcessing = IMMEDIATE
        ComIPduType = NORMAL
        ComIPduDirection = SEND
        ComFirstTimeout = 1.0
        ComTimeout = 1.0
        ComIPduGroupRef = ComIPduGroup_Tx
        ComPduIdRef = PduCollection/BMS_Vol_7_Can_Network_CANNODE_0_Com2PduR
        ComIPduSignalRef = BMS_BattCellOrder28Vol
        ComIPduSignalRef = BMS_BattCellOrder27Vol
        ComIPduSignalRef = BMS_BattCellOrder26Vol
        ComIPduSignalRef = BMS_BattCellOrder25Vol
        ComTxIPdu: ComMinimumDelayTime=0.0, ComTxIPduUnusedAreasDefault=255
          ComTxModeTrue
            ComTxMode: ComTxModeTimePeriod=1.0, ComTxModeMode=PERIODIC, ComTxModeNumberOfRepetitions=0, ComTxModeRepetitionPeriod=0, ComTxModeTimeOffset=0.0
          ComTxModeFalse
            ComTxMode: ComTxModeTimePeriod=1.0, ComTxModeMode=PERIODIC, ComTxModeNumberOfRepetitions=0, ComTxModeRepetitionPeriod=0, ComTxModeTimeOffset=0.0
      4 x ComSignal, all with ComSignalInitValue=0, ComSignalType=UINT16, ComSignalEndianness=BIG_ENDIAN, ComBitSize=16, ComUpdateBitPosition=-1, ComTransferProperty=TRIGGERED:
        BMS_BattCellOrder28Vol: ComBitPosition=55, ComSystemTemplateSystemSignalRef=BMS_BattCellOrder28Vol
        BMS_BattCellOrder27Vol: ComBitPosition=39, ComSystemTemplateSystemSignalRef=BMS_BattCellOrder27Vol
        BMS_BattCellOrder26Vol: ComBitPosition=23, ComSystemTemplateSystemSignalRef=BMS_BattCellOrder26Vol
        BMS_BattCellOrder25Vol: ComBitPosition=7, ComSystemTemplateSystemSignalRef=BMS_BattCellOrder25Vol
      BMS_Vol_6_Can_Network_CANNODE_0 (ComIPdu):
        ComIPduSignalProcessing = IMMEDIATE
        ComIPduType = NORMAL
        ComIPduDirection = SEND
        ComFirstTimeout = 1.0
        ComTimeout = 1.0
        ComIPduGroupRef = ComIPduGroup_Tx
        ComPduIdRef = PduCollection/BMS_Vol_6_Can_Network_CANNODE_0_Com2PduR
        ComIPduSignalRef = BMS_BattCellOrder24Vol
        ComIPduSignalRef = BMS_BattCellOrder23Vol
        ComIPduSignalRef = BMS_BattCellOrder22Vol
        ComIPduSignalRef = BMS_BattCellOrder21Vol
        ComTxIPdu: ComMinimumDelayTime=0.0, ComTxIPduUnusedAreasDefault=255
          ComTxModeTrue
            ComTxMode: ComTxModeTimePeriod=1.0, ComTxModeMode=PERIODIC, ComTxModeNumberOfRepetitions=0, ComTxModeRepetitionPeriod=0, ComTxModeTimeOffset=0.0
          ComTxModeFalse
            ComTxMode: ComTxModeTimePeriod=1.0, ComTxModeMode=PERIODIC, ComTxModeNumberOfRepetitions=0, ComTxModeRepetitionPeriod=0, ComTxModeTimeOffset=0.0
      4 x ComSignal, all with ComSignalInitValue=0, ComSignalType=UINT16, ComSignalEndianness=BIG_ENDIAN, ComBitSize=16, ComUpdateBitPosition=-1, ComTransferProperty=TRIGGERED:
        BMS_BattCellOrder24Vol: ComBitPosition=55, ComSystemTemplateSystemSignalRef=BMS_BattCellOrder24Vol
        BMS_BattCellOrder23Vol: ComBitPosition=39, ComSystemTemplateSystemSignalRef=BMS_BattCellOrder23Vol
        BMS_BattCellOrder22Vol: ComBitPosition=23, ComSystemTemplateSystemSignalRef=BMS_BattCellOrder22Vol
        BMS_BattCellOrder21Vol: ComBitPosition=7, ComSystemTemplateSystemSignalRef=BMS_BattCellOrder21Vol
      BMS_Vol_5_Can_Network_CANNODE_0 (ComIPdu):
        ComIPduSignalProcessing = IMMEDIATE
        ComIPduType = NORMAL
        ComIPduDirection = SEND
        ComFirstTimeout = 1.0
        ComTimeout = 1.0
        ComIPduGroupRef = ComIPduGroup_Tx
        ComPduIdRef = PduCollection/BMS_Vol_5_Can_Network_CANNODE_0_Com2PduR
        ComIPduSignalRef = BMS_BattCellOrder20Vol
        ComIPduSignalRef = BMS_BattCellOrder19Vol
        ComIPduSignalRef = BMS_BattCellOrder18Vol
        ComIPduSignalRef = BMS_BattCellOrder17Vol
        ComTxIPdu: ComMinimumDelayTime=0.0, ComTxIPduUnusedAreasDefault=255
          ComTxModeTrue
            ComTxMode: ComTxModeTimePeriod=1.0, ComTxModeMode=PERIODIC, ComTxModeNumberOfRepetitions=0, ComTxModeRepetitionPeriod=0, ComTxModeTimeOffset=0.0
          ComTxModeFalse
            ComTxMode: ComTxModeTimePeriod=1.0, ComTxModeMode=PERIODIC, ComTxModeNumberOfRepetitions=0, ComTxModeRepetitionPeriod=0, ComTxModeTimeOffset=0.0
      4 x ComSignal, all with ComSignalInitValue=0, ComSignalType=UINT16, ComSignalEndianness=BIG_ENDIAN, ComBitSize=16, ComUpdateBitPosition=-1, ComTransferProperty=TRIGGERED:
        BMS_BattCellOrder20Vol: ComBitPosition=55, ComSystemTemplateSystemSignalRef=BMS_BattCellOrder20Vol
        BMS_BattCellOrder19Vol: ComBitPosition=39, ComSystemTemplateSystemSignalRef=BMS_BattCellOrder19Vol
        BMS_BattCellOrder18Vol: ComBitPosition=23, ComSystemTemplateSystemSignalRef=BMS_BattCellOrder18Vol
        BMS_BattCellOrder17Vol: ComBitPosition=7, ComSystemTemplateSystemSignalRef=BMS_BattCellOrder17Vol
      BMS_Vol_4_Can_Network_CANNODE_0 (ComIPdu):
        ComIPduSignalProcessing = IMMEDIATE
        ComIPduType = NORMAL
        ComIPduDirection = SEND
        ComFirstTimeout = 1.0
        ComTimeout = 1.0
        ComIPduGroupRef = ComIPduGroup_Tx
        ComPduIdRef = PduCollection/BMS_Vol_4_Can_Network_CANNODE_0_Com2PduR
        ComIPduSignalRef = BMS_BattCellOrder16Vol
        ComIPduSignalRef = BMS_BattCellOrder15Vol
        ComIPduSignalRef = BMS_BattCellOrder14Vol
        ComIPduSignalRef = BMS_BattCellOrder13Vol
        ComTxIPdu: ComMinimumDelayTime=0.0, ComTxIPduUnusedAreasDefault=255
          ComTxModeTrue
            ComTxMode: ComTxModeTimePeriod=1.0, ComTxModeMode=PERIODIC, ComTxModeNumberOfRepetitions=0, ComTxModeRepetitionPeriod=0, ComTxModeTimeOffset=0.0
          ComTxModeFalse
            ComTxMode: ComTxModeTimePeriod=1.0, ComTxModeMode=PERIODIC, ComTxModeNumberOfRepetitions=0, ComTxModeRepetitionPeriod=0, ComTxModeTimeOffset=0.0
      4 x ComSignal, all with ComSignalInitValue=0, ComSignalType=UINT16, ComSignalEndianness=BIG_ENDIAN, ComBitSize=16, ComUpdateBitPosition=-1, ComTransferProperty=TRIGGERED:
        BMS_BattCellOrder16Vol: ComBitPosition=55, ComSystemTemplateSystemSignalRef=BMS_BattCellOrder16Vol
        BMS_BattCellOrder15Vol: ComBitPosition=39, ComSystemTemplateSystemSignalRef=BMS_BattCellOrder15Vol
        BMS_BattCellOrder14Vol: ComBitPosition=23, ComSystemTemplateSystemSignalRef=BMS_BattCellOrder14Vol
        BMS_BattCellOrder13Vol: ComBitPosition=7, ComSystemTemplateSystemSignalRef=BMS_BattCellOrder13Vol
      BMS_Vol_3_Can_Network_CANNODE_0 (ComIPdu):
        ComIPduSignalProcessing = IMMEDIATE
        ComIPduType = NORMAL
        ComIPduDirection = SEND
        ComFirstTimeout = 1.0
        ComTimeout = 1.0
        ComIPduGroupRef = ComIPduGroup_Tx
        ComPduIdRef = PduCollection/BMS_Vol_3_Can_Network_CANNODE_0_Com2PduR
        ComIPduSignalRef = BMS_BattCellOrder12Vol
        ComIPduSignalRef = BMS_BattCellOrder11Vol
        ComIPduSignalRef = BMS_BattCellOrder10Vol
        ComIPduSignalRef = BMS_BattCellOrder9Vol
        ComTxIPdu: ComMinimumDelayTime=0.0, ComTxIPduUnusedAreasDefault=255
          ComTxModeTrue
            ComTxMode: ComTxModeTimePeriod=1.0, ComTxModeMode=PERIODIC, ComTxModeNumberOfRepetitions=0, ComTxModeRepetitionPeriod=0, ComTxModeTimeOffset=0.0
          ComTxModeFalse
            ComTxMode: ComTxModeTimePeriod=1.0, ComTxModeMode=PERIODIC, ComTxModeNumberOfRepetitions=0, ComTxModeRepetitionPeriod=0, ComTxModeTimeOffset=0.0
      4 x ComSignal, all with ComSignalInitValue=0, ComSignalType=UINT16, ComSignalEndianness=BIG_ENDIAN, ComBitSize=16, ComUpdateBitPosition=-1, ComTransferProperty=TRIGGERED:
        BMS_BattCellOrder12Vol: ComBitPosition=55, ComSystemTemplateSystemSignalRef=BMS_BattCellOrder12Vol
        BMS_BattCellOrder11Vol: ComBitPosition=39, ComSystemTemplateSystemSignalRef=BMS_BattCellOrder11Vol
        BMS_BattCellOrder10Vol: ComBitPosition=23, ComSystemTemplateSystemSignalRef=BMS_BattCellOrder10Vol
        BMS_BattCellOrder9Vol: ComBitPosition=7, ComSystemTemplateSystemSignalRef=BMS_BattCellOrder9Vol
      BMS_8_Can_Network_CANNODE_0 (ComIPdu):
        ComIPduSignalProcessing = IMMEDIATE
        ComIPduType = NORMAL
        ComIPduDirection = SEND
        ComFirstTimeout = 0.1
        ComTimeout = 0.1
        ComIPduGroupRef = ComIPduGroup_Tx
        ComPduIdRef = PduCollection/BMS_8_Can_Network_CANNODE_0_Com2PduR
        ComIPduSignalRef = BMSH_8_CRC
        ComIPduSignalRef = BMSH_8_MessageCounter
        ComIPduSignalRef = BMSH_8_Reserved2
        ComIPduSignalRef = BMSH_KL15HDsignal
        ComIPduSignalRef = BMSH_BatteryMaintainLightReq
        ComIPduSignalRef = BMSH_SOH
        ComIPduSignalRef = BMSH_8_Reserved1
        ComIPduSignalRef = BMSH_LeftChargeTime
        ComIPduSignalRef = BMSH_PackInstantRecoveryPower
        ComIPduSignalRef = BMSH_PackInstantOutPower
        ComTxIPdu: ComMinimumDelayTime=0.0, ComTxIPduUnusedAreasDefault=255
          ComTxModeTrue
            ComTxMode: ComTxModeTimePeriod=0.1, ComTxModeMode=PERIODIC, ComTxModeNumberOfRepetitions=0, ComTxModeRepetitionPeriod=0, ComTxModeTimeOffset=0.0
          ComTxModeFalse
            ComTxMode: ComTxModeTimePeriod=0.1, ComTxModeMode=PERIODIC, ComTxModeNumberOfRepetitions=0, ComTxModeRepetitionPeriod=0, ComTxModeTimeOffset=0.0
      10 x ComSignal, all with ComSignalEndianness=BIG_ENDIAN, ComUpdateBitPosition=-1, ComTransferProperty=TRIGGERED:
        BMSH_8_CRC: ComSignalInitValue=0, ComSignalType=UINT8, ComBitSize=8, ComBitPosition=63, ComSystemTemplateSystemSignalRef=BMSH_8_CRC
        BMSH_8_MessageCounter: ComSignalInitValue=0, ComSignalType=UINT8, ComBitSize=4, ComBitPosition=51, ComSystemTemplateSystemSignalRef=BMSH_8_MessageCounter
        BMSH_8_Reserved2: ComSignalInitValue=0, ComSignalType=UINT8, ComBitSize=2, ComBitPosition=55, ComSystemTemplateSystemSignalRef=BMSH_8_Reserved2
        BMSH_KL15HDsignal: ComSignalInitValue=0, ComSignalType=BOOLEAN, ComBitSize=1, ComBitPosition=53, ComSystemTemplateSystemSignalRef=BMSH_KL15HDsignal
        BMSH_BatteryMaintainLightReq: ComSignalInitValue=0, ComSignalType=BOOLEAN, ComBitSize=1, ComBitPosition=52, ComSystemTemplateSystemSignalRef=BMSH_BatteryMaintainLightReq
        BMSH_SOH: ComSignalInitValue=0, ComSignalType=UINT8, ComBitSize=8, ComBitPosition=47, ComSystemTemplateSystemSignalRef=BMSH_SOH
        BMSH_8_Reserved1: ComSignalInitValue=0, ComSignalType=UINT8, ComBitSize=6, ComBitPosition=37, ComSystemTemplateSystemSignalRef=BMSH_8_Reserved1
        BMSH_LeftChargeTime: ComSignalInitValue=1022, ComSignalType=UINT16, ComBitSize=10, ComBitPosition=31, ComSystemTemplateSystemSignalRef=BMSH_LeftChargeTime
        BMSH_PackInstantRecoveryPower: ComSignalInitValue=0, ComSignalType=UINT16, ComBitSize=12, ComBitPosition=11, ComSystemTemplateSystemSignalRef=BMSH_PackInstantRecoveryPower
        BMSH_PackInstantOutPower: ComSignalInitValue=0, ComSignalType=UINT16, ComBitSize=12, ComBitPosition=7, ComSystemTemplateSystemSignalRef=BMSH_PackInstantOutPower
      BMS_Vol_2_Can_Network_CANNODE_0 (ComIPdu):
        ComIPduSignalProcessing = IMMEDIATE
        ComIPduType = NORMAL
        ComIPduDirection = SEND
        ComFirstTimeout = 1.0
        ComTimeout = 1.0
        ComIPduGroupRef = ComIPduGroup_Tx
        ComPduIdRef = PduCollection/BMS_Vol_2_Can_Network_CANNODE_0_Com2PduR
        ComIPduSignalRef = BMS_BattCellOrder8Vol
        ComIPduSignalRef = BMS_BattCellOrder7Vol
        ComIPduSignalRef = BMS_BattCellOrder6Vol
        ComIPduSignalRef = BMS_BattCellOrder5Vol
        ComTxIPdu: ComMinimumDelayTime=0.0, ComTxIPduUnusedAreasDefault=255
          ComTxModeTrue
            ComTxMode: ComTxModeTimePeriod=1.0, ComTxModeMode=PERIODIC, ComTxModeNumberOfRepetitions=0, ComTxModeRepetitionPeriod=0, ComTxModeTimeOffset=0.0
          ComTxModeFalse
            ComTxMode: ComTxModeTimePeriod=1.0, ComTxModeMode=PERIODIC, ComTxModeNumberOfRepetitions=0, ComTxModeRepetitionPeriod=0, ComTxModeTimeOffset=0.0
      4 x ComSignal, all with ComSignalInitValue=0, ComSignalType=UINT16, ComSignalEndianness=BIG_ENDIAN, ComBitSize=16, ComUpdateBitPosition=-1, ComTransferProperty=TRIGGERED:
        BMS_BattCellOrder8Vol: ComBitPosition=55, ComSystemTemplateSystemSignalRef=BMS_BattCellOrder8Vol
        BMS_BattCellOrder7Vol: ComBitPosition=39, ComSystemTemplateSystemSignalRef=BMS_BattCellOrder7Vol
        BMS_BattCellOrder6Vol: ComBitPosition=23, ComSystemTemplateSystemSignalRef=BMS_BattCellOrder6Vol
        BMS_BattCellOrder5Vol: ComBitPosition=7, ComSystemTemplateSystemSignalRef=BMS_BattCellOrder5Vol
      BMS_Vol_1_Can_Network_CANNODE_0 (ComIPdu):
        ComIPduSignalProcessing = IMMEDIATE
        ComIPduType = NORMAL
        ComIPduDirection = SEND
        ComFirstTimeout = 1.0
        ComTimeout = 1.0
        ComIPduGroupRef = ComIPduGroup_Tx
        ComPduIdRef = PduCollection/BMS_Vol_1_Can_Network_CANNODE_0_Com2PduR
        ComIPduSignalRef = BMS_BattCellOrder4Vol
        ComIPduSignalRef = BMS_BattCellOrder3Vol
        ComIPduSignalRef = BMS_BattCellOrder2Vol
        ComIPduSignalRef = BMS_BattCellOrder1Vol
        ComTxIPdu: ComMinimumDelayTime=0.0, ComTxIPduUnusedAreasDefault=255
          ComTxModeTrue
            ComTxMode: ComTxModeTimePeriod=1.0, ComTxModeMode=PERIODIC, ComTxModeNumberOfRepetitions=0, ComTxModeRepetitionPeriod=0, ComTxModeTimeOffset=0.0
          ComTxModeFalse
            ComTxMode: ComTxModeTimePeriod=1.0, ComTxModeMode=PERIODIC, ComTxModeNumberOfRepetitions=0, ComTxModeRepetitionPeriod=0, ComTxModeTimeOffset=0.0
      4 x ComSignal, all with ComSignalInitValue=0, ComSignalType=UINT16, ComSignalEndianness=BIG_ENDIAN, ComBitSize=16, ComUpdateBitPosition=-1, ComTransferProperty=TRIGGERED:
        BMS_BattCellOrder4Vol: ComBitPosition=55, ComSystemTemplateSystemSignalRef=BMS_BattCellOrder4Vol
        BMS_BattCellOrder3Vol: ComBitPosition=39, ComSystemTemplateSystemSignalRef=BMS_BattCellOrder3Vol
        BMS_BattCellOrder2Vol: ComBitPosition=23, ComSystemTemplateSystemSignalRef=BMS_BattCellOrder2Vol
        BMS_BattCellOrder1Vol: ComBitPosition=7, ComSystemTemplateSystemSignalRef=BMS_BattCellOrder1Vol
      BMS_1_Can_Network_CANNODE_0 (ComIPdu):
        ComIPduSignalProcessing = IMMEDIATE
        ComIPduType = NORMAL
        ComIPduDirection = SEND
        ComFirstTimeout = 0.01
        ComTimeout = 0.01
        ComIPduGroupRef = ComIPduGroup_Tx
        ComPduIdRef = PduCollection/BMS_1_Can_Network_CANNODE_0_Com2PduR
        ComIPduSignalRef = BMSH_1_CRC
        ComIPduSignalRef = BMSH_1_MessageCounter
        ComIPduSignalRef = BMSH_1_Reserved1
        ComIPduSignalRef = BMSH_WorkingMode
        ComIPduSignalRef = BMSH_BattVolt_BMS_1
        ComIPduSignalRef = BMSH_BatteryCurrent_BMS_1
        ComIPduSignalRef = BMSH_SOC_BMS_1
        ComTxIPdu: ComMinimumDelayTime=0.0, ComTxIPduUnusedAreasDefault=255
          ComTxModeTrue
            ComTxMode: ComTxModeTimePeriod=0.01, ComTxModeMode=PERIODIC, ComTxModeNumberOfRepetitions=0, ComTxModeRepetitionPeriod=0, ComTxModeTimeOffset=0.0
          ComTxModeFalse
            ComTxMode: ComTxModeTimePeriod=0.01, ComTxModeMode=PERIODIC, ComTxModeNumberOfRepetitions=0, ComTxModeRepetitionPeriod=0, ComTxModeTimeOffset=0.0
      7 x ComSignal, all with ComSignalEndianness=BIG_ENDIAN, ComUpdateBitPosition=-1, ComTransferProperty=TRIGGERED:
        BMSH_1_CRC: ComSignalInitValue=0, ComSignalType=UINT8, ComBitSize=8, ComBitPosition=63, ComSystemTemplateSystemSignalRef=BMSH_1_CRC
        BMSH_1_MessageCounter: ComSignalInitValue=0, ComSignalType=UINT8, ComBitSize=4, ComBitPosition=51, ComSystemTemplateSystemSignalRef=BMSH_1_MessageCounter
        BMSH_1_Reserved1: ComSignalInitValue=0, ComSignalType=UINT8, ComBitSize=2, ComBitPosition=55, ComSystemTemplateSystemSignalRef=BMSH_1_Reserved1
        BMSH_WorkingMode: ComSignalInitValue=0, ComSignalType=UINT8, ComBitSize=2, ComBitPosition=53, ComSystemTemplateSystemSignalRef=BMSH_WorkingMode
        BMSH_BattVolt_BMS_1: ComSignalInitValue=0, ComSignalType=UINT16, ComBitSize=16, ComBitPosition=39, ComSystemTemplateSystemSignalRef=BMSH_BattVolt
        BMSH_BatteryCurrent_BMS_1: ComSignalInitValue=32000, ComSignalType=UINT16, ComBitSize=16, ComBitPosition=23, ComSystemTemplateSystemSignalRef=BMSH_BatteryCurrent
        BMSH_SOC_BMS_1: ComSignalInitValue=0, ComSignalType=UINT16, ComBitSize=16, ComBitPosition=7, ComSystemTemplateSystemSignalRef=BMSH_SOC
      BMS_Vol_20_Can_Network_CANNODE_0 (ComIPdu):
        ComIPduSignalProcessing = IMMEDIATE
        ComIPduType = NORMAL
        ComIPduDirection = SEND
        ComFirstTimeout = 1.0
        ComTimeout = 1.0
        ComIPduGroupRef = ComIPduGroup_Tx
        ComPduIdRef = PduCollection/BMS_Vol_20_Can_Network_CANNODE_0_Com2PduR
        ComIPduSignalRef = BMS_BattCellOrder80Vol
        ComIPduSignalRef = BMS_BattCellOrder79Vol
        ComIPduSignalRef = BMS_BattCellOrder78Vol
        ComIPduSignalRef = BMS_BattCellOrder77Vol
        ComTxIPdu: ComMinimumDelayTime=0.0, ComTxIPduUnusedAreasDefault=255
          ComTxModeTrue
            ComTxMode: ComTxModeTimePeriod=1.0, ComTxModeMode=PERIODIC, ComTxModeNumberOfRepetitions=0, ComTxModeRepetitionPeriod=0, ComTxModeTimeOffset=0.0
          ComTxModeFalse
            ComTxMode: ComTxModeTimePeriod=1.0, ComTxModeMode=PERIODIC, ComTxModeNumberOfRepetitions=0, ComTxModeRepetitionPeriod=0, ComTxModeTimeOffset=0.0
      4 x ComSignal, all with ComSignalInitValue=0, ComSignalType=UINT16, ComSignalEndianness=BIG_ENDIAN, ComBitSize=16, ComUpdateBitPosition=-1, ComTransferProperty=TRIGGERED:
        BMS_BattCellOrder80Vol: ComBitPosition=55, ComSystemTemplateSystemSignalRef=BMS_BattCellOrder80Vol
        BMS_BattCellOrder79Vol: ComBitPosition=39, ComSystemTemplateSystemSignalRef=BMS_BattCellOrder79Vol
        BMS_BattCellOrder78Vol: ComBitPosition=23, ComSystemTemplateSystemSignalRef=BMS_BattCellOrder78Vol
        BMS_BattCellOrder77Vol: ComBitPosition=7, ComSystemTemplateSystemSignalRef=BMS_BattCellOrder77Vol
      BMS_Vol_19_Can_Network_CANNODE_0 (ComIPdu):
        ComIPduSignalProcessing = IMMEDIATE
        ComIPduType = NORMAL
        ComIPduDirection = SEND
        ComFirstTimeout = 1.0
        ComTimeout = 1.0
        ComIPduGroupRef = ComIPduGroup_Tx
        ComPduIdRef = PduCollection/BMS_Vol_19_Can_Network_CANNODE_0_Com2PduR
        ComIPduSignalRef = BMS_BattCellOrder76Vol
        ComIPduSignalRef = BMS_BattCellOrder75Vol
        ComIPduSignalRef = BMS_BattCellOrder74Vol
        ComIPduSignalRef = BMS_BattCellOrder73Vol
        ComTxIPdu: ComMinimumDelayTime=0.0, ComTxIPduUnusedAreasDefault=255
          ComTxModeTrue
            ComTxMode: ComTxModeTimePeriod=1.0, ComTxModeMode=PERIODIC, ComTxModeNumberOfRepetitions=0, ComTxModeRepetitionPeriod=0, ComTxModeTimeOffset=0.0
          ComTxModeFalse
            ComTxMode: ComTxModeTimePeriod=1.0, ComTxModeMode=PERIODIC, ComTxModeNumberOfRepetitions=0, ComTxModeRepetitionPeriod=0, ComTxModeTimeOffset=0.0
      4 x ComSignal, all with ComSignalInitValue=0, ComSignalType=UINT16, ComSignalEndianness=BIG_ENDIAN, ComBitSize=16, ComUpdateBitPosition=-1, ComTransferProperty=TRIGGERED:
        BMS_BattCellOrder76Vol: ComBitPosition=55, ComSystemTemplateSystemSignalRef=BMS_BattCellOrder76Vol
        BMS_BattCellOrder75Vol: ComBitPosition=39, ComSystemTemplateSystemSignalRef=BMS_BattCellOrder75Vol
        BMS_BattCellOrder74Vol: ComBitPosition=23, ComSystemTemplateSystemSignalRef=BMS_BattCellOrder74Vol
        BMS_BattCellOrder73Vol: ComBitPosition=7, ComSystemTemplateSystemSignalRef=BMS_BattCellOrder73Vol
      BMS_Vol_18_Can_Network_CANNODE_0 (ComIPdu):
        ComIPduSignalProcessing = IMMEDIATE
        ComIPduType = NORMAL
        ComIPduDirection = SEND
        ComFirstTimeout = 1.0
        ComTimeout = 1.0
        ComIPduGroupRef = ComIPduGroup_Tx
        ComPduIdRef = PduCollection/BMS_Vol_18_Can_Network_CANNODE_0_Com2PduR
        ComIPduSignalRef = BMS_BattCellOrder72Vol
        ComIPduSignalRef = BMS_BattCellOrder71Vol
        ComIPduSignalRef = BMS_BattCellOrder70Vol
        ComIPduSignalRef = BMS_BattCellOrder69Vol
        ComTxIPdu: ComMinimumDelayTime=0.0, ComTxIPduUnusedAreasDefault=255
          ComTxModeTrue
            ComTxMode: ComTxModeTimePeriod=1.0, ComTxModeMode=PERIODIC, ComTxModeNumberOfRepetitions=0, ComTxModeRepetitionPeriod=0, ComTxModeTimeOffset=0.0
          ComTxModeFalse
            ComTxMode: ComTxModeTimePeriod=1.0, ComTxModeMode=PERIODIC, ComTxModeNumberOfRepetitions=0, ComTxModeRepetitionPeriod=0, ComTxModeTimeOffset=0.0
      4 x ComSignal, all with ComSignalInitValue=0, ComSignalType=UINT16, ComSignalEndianness=BIG_ENDIAN, ComBitSize=16, ComUpdateBitPosition=-1, ComTransferProperty=TRIGGERED:
        BMS_BattCellOrder72Vol: ComBitPosition=55, ComSystemTemplateSystemSignalRef=BMS_BattCellOrder72Vol
        BMS_BattCellOrder71Vol: ComBitPosition=39, ComSystemTemplateSystemSignalRef=BMS_BattCellOrder71Vol
        BMS_BattCellOrder70Vol: ComBitPosition=23, ComSystemTemplateSystemSignalRef=BMS_BattCellOrder70Vol
        BMS_BattCellOrder69Vol: ComBitPosition=7, ComSystemTemplateSystemSignalRef=BMS_BattCellOrder69Vol
      BMS_Vol_17_Can_Network_CANNODE_0 (ComIPdu):
        ComIPduSignalProcessing = IMMEDIATE
        ComIPduType = NORMAL
        ComIPduDirection = SEND
        ComFirstTimeout = 1.0
        ComTimeout = 1.0
        ComIPduGroupRef = ComIPduGroup_Tx
        ComPduIdRef = PduCollection/BMS_Vol_17_Can_Network_CANNODE_0_Com2PduR
        ComIPduSignalRef = BMS_BattCellOrder68Vol
        ComIPduSignalRef = BMS_BattCellOrder67Vol
        ComIPduSignalRef = BMS_BattCellOrder66Vol
        ComIPduSignalRef = BMS_BattCellOrder65Vol
        ComTxIPdu: ComMinimumDelayTime=0.0, ComTxIPduUnusedAreasDefault=255
          ComTxModeTrue
            ComTxMode: ComTxModeTimePeriod=1.0, ComTxModeMode=PERIODIC, ComTxModeNumberOfRepetitions=0, ComTxModeRepetitionPeriod=0, ComTxModeTimeOffset=0.0
          ComTxModeFalse
            ComTxMode: ComTxModeTimePeriod=1.0, ComTxModeMode=PERIODIC, ComTxModeNumberOfRepetitions=0, ComTxModeRepetitionPeriod=0, ComTxModeTimeOffset=0.0
      4 x ComSignal, all with ComSignalInitValue=0, ComSignalType=UINT16, ComSignalEndianness=BIG_ENDIAN, ComBitSize=16, ComUpdateBitPosition=-1, ComTransferProperty=TRIGGERED:
        BMS_BattCellOrder68Vol: ComBitPosition=55, ComSystemTemplateSystemSignalRef=BMS_BattCellOrder68Vol
        BMS_BattCellOrder67Vol: ComBitPosition=39, ComSystemTemplateSystemSignalRef=BMS_BattCellOrder67Vol
        BMS_BattCellOrder66Vol: ComBitPosition=23, ComSystemTemplateSystemSignalRef=BMS_BattCellOrder66Vol
        BMS_BattCellOrder65Vol: ComBitPosition=7, ComSystemTemplateSystemSignalRef=BMS_BattCellOrder65Vol
      BMS_5_Can_Network_CANNODE_0 (ComIPdu):
        ComIPduSignalProcessing = IMMEDIATE
        ComIPduType = NORMAL
        ComIPduDirection = SEND
        ComFirstTimeout = 0.1
        ComTimeout = 0.1
        ComIPduGroupRef = ComIPduGroup_Tx
        ComPduIdRef = PduCollection/BMS_5_Can_Network_CANNODE_0_Com2PduR
        ComIPduSignalRef = BMSH_5_CRC
        ComIPduSignalRef = BMSH_5_MessageCounter
        ComIPduSignalRef = BMSH_PackPowerRealTime
        ComIPduSignalRef = BMSH_PackRemainEnergy
        ComIPduSignalRef = BMSH_PackFaultLevel
        ComIPduSignalRef = BMSH_MILReq
        ComIPduSignalRef = BMSH_BattFaultLampSts
        ComIPduSignalRef = BMSH_PackThermalRunawayLight
        ComIPduSignalRef = BMSH_DisChgFaultLevel
        ComIPduSignalRef = BMSH_ChgFaultLevel
        ComIPduSignalRef = BMSH_SOCDisp
        ComTxIPdu: ComMinimumDelayTime=0.0, ComTxIPduUnusedAreasDefault=255
          ComTxModeTrue
            ComTxMode: ComTxModeTimePeriod=0.1, ComTxModeMode=PERIODIC, ComTxModeNumberOfRepetitions=0, ComTxModeRepetitionPeriod=0, ComTxModeTimeOffset=0.0
          ComTxModeFalse
            ComTxMode: ComTxModeTimePeriod=0.1, ComTxModeMode=PERIODIC, ComTxModeNumberOfRepetitions=0, ComTxModeRepetitionPeriod=0, ComTxModeTimeOffset=0.0
      11 x ComSignal, all with ComSignalEndianness=BIG_ENDIAN, ComUpdateBitPosition=-1, ComTransferProperty=TRIGGERED:
        BMSH_5_CRC: ComSignalInitValue=0, ComSignalType=UINT8, ComBitSize=8, ComBitPosition=63, ComSystemTemplateSystemSignalRef=BMSH_5_CRC
        BMSH_5_MessageCounter: ComSignalInitValue=0, ComSignalType=UINT8, ComBitSize=4, ComBitPosition=51, ComSystemTemplateSystemSignalRef=BMSH_5_MessageCounter
        BMSH_PackPowerRealTime: ComSignalInitValue=2000, ComSignalType=UINT16, ComBitSize=12, ComBitPosition=47, ComSystemTemplateSystemSignalRef=BMSH_PackPowerRealTime
        BMSH_PackRemainEnergy: ComSignalInitValue=0, ComSignalType=UINT16, ComBitSize=10, ComBitPosition=25, ComSystemTemplateSystemSignalRef=BMSH_PackRemainEnergy
        BMSH_PackFaultLevel: ComSignalInitValue=0, ComSignalType=UINT8, ComBitSize=3, ComBitPosition=31, ComSystemTemplateSystemSignalRef=BMSH_PackFaultLevel
        BMSH_MILReq: ComSignalInitValue=0, ComSignalType=BOOLEAN, ComBitSize=1, ComBitPosition=28, ComSystemTemplateSystemSignalRef=BMSH_MILReq
        BMSH_BattFaultLampSts: ComSignalInitValue=0, ComSignalType=BOOLEAN, ComBitSize=1, ComBitPosition=27, ComSystemTemplateSystemSignalRef=BMSH_BattFaultLampSts
        BMSH_PackThermalRunawayLight: ComSignalInitValue=0, ComSignalType=BOOLEAN, ComBitSize=1, ComBitPosition=26, ComSystemTemplateSystemSignalRef=BMSH_PackThermalRunawayLight
        BMSH_DisChgFaultLevel: ComSignalInitValue=0, ComSignalType=UINT8, ComBitSize=4, ComBitPosition=23, ComSystemTemplateSystemSignalRef=BMSH_DisChgFaultLevel
        BMSH_ChgFaultLevel: ComSignalInitValue=0, ComSignalType=UINT8, ComBitSize=4, ComBitPosition=19, ComSystemTemplateSystemSignalRef=BMSH_ChgFaultLevel
        BMSH_SOCDisp: ComSignalInitValue=0, ComSignalType=UINT16, ComBitSize=16, ComBitPosition=7, ComSystemTemplateSystemSignalRef=BMSH_SOCDisp
      BMS_9_Can_Network_CANNODE_0 (ComIPdu):
        ComIPduSignalProcessing = IMMEDIATE
        ComIPduType = NORMAL
        ComIPduDirection = SEND
        ComFirstTimeout = 1.0
        ComTimeout = 1.0
        ComIPduGroupRef = ComIPduGroup_Tx
        ComPduIdRef = PduCollection/BMS_9_Can_Network_CANNODE_0_Com2PduR
        ComIPduSignalRef = BMSH_InsulationResis
        ComIPduSignalRef = BMSH_BattTypeCode
        ComIPduSignalRef = BMSH_batteryDataFrameNumSum
        ComIPduSignalRef = BMSH_batteryDataFrameNum
        ComIPduSignalRef = BMSH_PacksubsystemNum
        ComIPduSignalRef = BMS_9_Reserved1
        ComIPduSignalRef = BMSH_PackCellSum
        ComIPduSignalRef = BMSH_PackCodeLength
        ComIPduSignalRef = BMSH_PackSubsystemSum
        ComTxIPdu: ComMinimumDelayTime=0.0, ComTxIPduUnusedAreasDefault=255
          ComTxModeTrue
            ComTxMode: ComTxModeTimePeriod=1.0, ComTxModeMode=PERIODIC, ComTxModeNumberOfRepetitions=0, ComTxModeRepetitionPeriod=0, ComTxModeTimeOffset=0.0
          ComTxModeFalse
            ComTxMode: ComTxModeTimePeriod=1.0, ComTxModeMode=PERIODIC, ComTxModeNumberOfRepetitions=0, ComTxModeRepetitionPeriod=0, ComTxModeTimeOffset=0.0
      9 x ComSignal, all with ComSignalInitValue=0, ComSignalEndianness=BIG_ENDIAN, ComUpdateBitPosition=-1, ComTransferProperty=TRIGGERED:
        BMSH_InsulationResis: ComSignalType=UINT16, ComBitSize=16, ComBitPosition=55, ComSystemTemplateSystemSignalRef=BMSH_InsulationResis
        BMSH_BattTypeCode: ComSignalType=UINT8, ComBitSize=8, ComBitPosition=47, ComSystemTemplateSystemSignalRef=BMSH_BattTypeCode
        BMSH_batteryDataFrameNumSum: ComSignalType=UINT8, ComBitSize=8, ComBitPosition=39, ComSystemTemplateSystemSignalRef=BMSH_batteryDataFrameNumSum
        BMSH_batteryDataFrameNum: ComSignalType=UINT16, ComBitSize=10, ComBitPosition=21, ComSystemTemplateSystemSignalRef=BMSH_batteryDataFrameNum
        BMSH_PacksubsystemNum: ComSignalType=UINT8, ComBitSize=3, ComBitPosition=27, ComSystemTemplateSystemSignalRef=BMSH_PacksubsystemNum
        BMS_9_Reserved1: ComSignalType=BOOLEAN, ComBitSize=1, ComBitPosition=24, ComSystemTemplateSystemSignalRef=BMS_9_Reserved1
        BMSH_PackCellSum: ComSignalType=UINT16, ComBitSize=10, ComBitPosition=15, ComSystemTemplateSystemSignalRef=BMSH_PackCellSum
        BMSH_PackCodeLength: ComSignalType=UINT8, ComBitSize=5, ComBitPosition=7, ComSystemTemplateSystemSignalRef=BMSH_PackCodeLength
        BMSH_PackSubsystemSum: ComSignalType=UINT8, ComBitSize=3, ComBitPosition=2, ComSystemTemplateSystemSignalRef=BMSH_PackSubsystemSum
      BMS_Vol_16_Can_Network_CANNODE_0 (ComIPdu):
        ComIPduSignalProcessing = IMMEDIATE
        ComIPduType = NORMAL
        ComIPduDirection = SEND
        ComFirstTimeout = 1.0
        ComTimeout = 1.0
        ComIPduGroupRef = ComIPduGroup_Tx
        ComPduIdRef = PduCollection/BMS_Vol_16_Can_Network_CANNODE_0_Com2PduR
        ComIPduSignalRef = BMS_BattCellOrder64Vol
        ComIPduSignalRef = BMS_BattCellOrder63Vol
        ComIPduSignalRef = BMS_BattCellOrder62Vol
        ComIPduSignalRef = BMS_BattCellOrder61Vol
        ComTxIPdu: ComMinimumDelayTime=0.0, ComTxIPduUnusedAreasDefault=255
          ComTxModeTrue
            ComTxMode: ComTxModeTimePeriod=1.0, ComTxModeMode=PERIODIC, ComTxModeNumberOfRepetitions=0, ComTxModeRepetitionPeriod=0, ComTxModeTimeOffset=0.0
          ComTxModeFalse
            ComTxMode: ComTxModeTimePeriod=1.0, ComTxModeMode=PERIODIC, ComTxModeNumberOfRepetitions=0, ComTxModeRepetitionPeriod=0, ComTxModeTimeOffset=0.0
      4 x ComSignal, all with ComSignalInitValue=0, ComSignalType=UINT16, ComSignalEndianness=BIG_ENDIAN, ComBitSize=16, ComUpdateBitPosition=-1, ComTransferProperty=TRIGGERED:
        BMS_BattCellOrder64Vol: ComBitPosition=55, ComSystemTemplateSystemSignalRef=BMS_BattCellOrder64Vol
        BMS_BattCellOrder63Vol: ComBitPosition=39, ComSystemTemplateSystemSignalRef=BMS_BattCellOrder63Vol
        BMS_BattCellOrder62Vol: ComBitPosition=23, ComSystemTemplateSystemSignalRef=BMS_BattCellOrder62Vol
        BMS_BattCellOrder61Vol: ComBitPosition=7, ComSystemTemplateSystemSignalRef=BMS_BattCellOrder61Vol
      BMS_Vol_15_Can_Network_CANNODE_0 (ComIPdu):
        ComIPduSignalProcessing = IMMEDIATE
        ComIPduType = NORMAL
        ComIPduDirection = SEND
        ComFirstTimeout = 1.0
        ComTimeout = 1.0
        ComIPduGroupRef = ComIPduGroup_Tx
        ComPduIdRef = PduCollection/BMS_Vol_15_Can_Network_CANNODE_0_Com2PduR
        ComIPduSignalRef = BMS_BattCellOrder60Vol
        ComIPduSignalRef = BMS_BattCellOrder59Vol
        ComIPduSignalRef = BMS_BattCellOrder58Vol
        ComIPduSignalRef = BMS_BattCellOrder57Vol
        ComTxIPdu: ComMinimumDelayTime=0.0, ComTxIPduUnusedAreasDefault=255
          ComTxModeTrue
            ComTxMode: ComTxModeTimePeriod=1.0, ComTxModeMode=PERIODIC, ComTxModeNumberOfRepetitions=0, ComTxModeRepetitionPeriod=0, ComTxModeTimeOffset=0.0
          ComTxModeFalse
            ComTxMode: ComTxModeTimePeriod=1.0, ComTxModeMode=PERIODIC, ComTxModeNumberOfRepetitions=0, ComTxModeRepetitionPeriod=0, ComTxModeTimeOffset=0.0
      4 x ComSignal, all with ComSignalInitValue=0, ComSignalType=UINT16, ComSignalEndianness=BIG_ENDIAN, ComBitSize=16, ComUpdateBitPosition=-1, ComTransferProperty=TRIGGERED:
        BMS_BattCellOrder60Vol: ComBitPosition=55, ComSystemTemplateSystemSignalRef=BMS_BattCellOrder60Vol
        BMS_BattCellOrder59Vol: ComBitPosition=39, ComSystemTemplateSystemSignalRef=BMS_BattCellOrder59Vol
        BMS_BattCellOrder58Vol: ComBitPosition=23, ComSystemTemplateSystemSignalRef=BMS_BattCellOrder58Vol
        BMS_BattCellOrder57Vol: ComBitPosition=7, ComSystemTemplateSystemSignalRef=BMS_BattCellOrder57Vol
      BMS_Vol_14_Can_Network_CANNODE_0 (ComIPdu):
        ComIPduSignalProcessing = IMMEDIATE
        ComIPduType = NORMAL
        ComIPduDirection = SEND
        ComFirstTimeout = 1.0
        ComTimeout = 1.0
        ComIPduGroupRef = ComIPduGroup_Tx
        ComPduIdRef = PduCollection/BMS_Vol_14_Can_Network_CANNODE_0_Com2PduR
        ComIPduSignalRef = BMS_BattCellOrder56Vol
        ComIPduSignalRef = BMS_BattCellOrder55Vol
        ComIPduSignalRef = BMS_BattCellOrder54Vol
        ComIPduSignalRef = BMS_BattCellOrder53Vol
        ComTxIPdu: ComMinimumDelayTime=0.0, ComTxIPduUnusedAreasDefault=255
          ComTxModeTrue
            ComTxMode: ComTxModeTimePeriod=1.0, ComTxModeMode=PERIODIC, ComTxModeNumberOfRepetitions=0, ComTxModeRepetitionPeriod=0, ComTxModeTimeOffset=0.0
          ComTxModeFalse
            ComTxMode: ComTxModeTimePeriod=1.0, ComTxModeMode=PERIODIC, ComTxModeNumberOfRepetitions=0, ComTxModeRepetitionPeriod=0, ComTxModeTimeOffset=0.0
      4 x ComSignal, all with ComSignalInitValue=0, ComSignalType=UINT16, ComSignalEndianness=BIG_ENDIAN, ComBitSize=16, ComUpdateBitPosition=-1, ComTransferProperty=TRIGGERED:
        BMS_BattCellOrder56Vol: ComBitPosition=55, ComSystemTemplateSystemSignalRef=BMS_BattCellOrder56Vol
        BMS_BattCellOrder55Vol: ComBitPosition=39, ComSystemTemplateSystemSignalRef=BMS_BattCellOrder55Vol
        BMS_BattCellOrder54Vol: ComBitPosition=23, ComSystemTemplateSystemSignalRef=BMS_BattCellOrder54Vol
        BMS_BattCellOrder53Vol: ComBitPosition=7, ComSystemTemplateSystemSignalRef=BMS_BattCellOrder53Vol
      BMS_2_Can_Network_CANNODE_0 (ComIPdu):
        ComIPduSignalProcessing = IMMEDIATE
        ComIPduType = NORMAL
        ComIPduDirection = SEND
        ComFirstTimeout = 0.01
        ComTimeout = 0.01
        ComIPduGroupRef = ComIPduGroup_Tx
        ComPduIdRef = PduCollection/BMS_2_Can_Network_CANNODE_0_Com2PduR
        ComIPduSignalRef = BMSH_2_CRC
        ComIPduSignalRef = BMSH_2_MessageCounter
        ComIPduSignalRef = BMSH_BookSetReq
        ComIPduSignalRef = BMSH_PTCRelayWeldSts
        ComIPduSignalRef = BMSH_CHGPrechargeWeldSts
        ComIPduSignalRef = BMSH_PreChargeWeldSts
        ComIPduSignalRef = BMSH_NegSideWeldSts
        ComIPduSignalRef = BMSH_PosSideWeldSts_BMS_2
        ComIPduSignalRef = BMSH_PTCRelaySts
        ComIPduSignalRef = BMSH_CHGPrechargeRelaySts
        ComIPduSignalRef = BMSH_PrechargeRelaySts
        ComIPduSignalRef = BMSH_NegMainRelaySts
        ComIPduSignalRef = BMSH_PosMainRelaySts
        ComIPduSignalRef = BMSH_IntelligentChargeReq
        ComIPduSignalRef = BMSH_OBCPrechgSt
        ComIPduSignalRef = BMSH_MainPrechgSt
        ComIPduSignalRef = BMSH_InsulationSts_BMS_2
        ComIPduSignalRef = BMSH_VehicleHVILSts
        ComIPduSignalRef = BMSH_InterHVILSts_BMS_2
        ComIPduSignalRef = BMSH_stMode_BMS_2
        ComIPduSignalRef = Reserved_BMSH_SOH
        ComIPduSignalRef = BMSH_HVBusVolt
        ComTxIPdu: ComMinimumDelayTime=0.0, ComTxIPduUnusedAreasDefault=255
          ComTxModeTrue
            ComTxMode: ComTxModeTimePeriod=0.01, ComTxModeMode=PERIODIC, ComTxModeNumberOfRepetitions=0, ComTxModeRepetitionPeriod=0, ComTxModeTimeOffset=0.0
          ComTxModeFalse
            ComTxMode: ComTxModeTimePeriod=0.01, ComTxModeMode=PERIODIC, ComTxModeNumberOfRepetitions=0, ComTxModeRepetitionPeriod=0, ComTxModeTimeOffset=0.0
      22 x ComSignal, all with ComSignalInitValue=0, ComSignalEndianness=BIG_ENDIAN, ComUpdateBitPosition=-1, ComTransferProperty=TRIGGERED:
        BMSH_2_CRC: ComSignalType=UINT8, ComBitSize=8, ComBitPosition=63, ComSystemTemplateSystemSignalRef=BMSH_2_CRC
        BMSH_2_MessageCounter: ComSignalType=UINT8, ComBitSize=4, ComBitPosition=51, ComSystemTemplateSystemSignalRef=BMSH_2_MessageCounter
        BMSH_BookSetReq: ComSignalType=BOOLEAN, ComBitSize=1, ComBitPosition=55, ComSystemTemplateSystemSignalRef=BMSH_BookSetReq
        BMSH_PTCRelayWeldSts: ComSignalType=BOOLEAN, ComBitSize=1, ComBitPosition=54, ComSystemTemplateSystemSignalRef=BMSH_PTCRelayWeldSts
        BMSH_CHGPrechargeWeldSts: ComSignalType=BOOLEAN, ComBitSize=1, ComBitPosition=53, ComSystemTemplateSystemSignalRef=BMSH_CHGPrechargeWeldSts
        BMSH_PreChargeWeldSts: ComSignalType=BOOLEAN, ComBitSize=1, ComBitPosition=52, ComSystemTemplateSystemSignalRef=BMSH_PreChargeWeldSts
        BMSH_NegSideWeldSts: ComSignalType=BOOLEAN, ComBitSize=1, ComBitPosition=47, ComSystemTemplateSystemSignalRef=BMSH_NegSideWeldSts
        BMSH_PosSideWeldSts_BMS_2: ComSignalType=BOOLEAN, ComBitSize=1, ComBitPosition=46, ComSystemTemplateSystemSignalRef=BMSH_PosSideWeldSts
        BMSH_PTCRelaySts: ComSignalType=BOOLEAN, ComBitSize=1, ComBitPosition=45, ComSystemTemplateSystemSignalRef=BMSH_PTCRelaySts
        BMSH_CHGPrechargeRelaySts: ComSignalType=BOOLEAN, ComBitSize=1, ComBitPosition=44, ComSystemTemplateSystemSignalRef=BMSH_CHGPrechargeRelaySts
        BMSH_PrechargeRelaySts: ComSignalType=BOOLEAN, ComBitSize=1, ComBitPosition=43, ComSystemTemplateSystemSignalRef=BMSH_PrechargeRelaySts
        BMSH_NegMainRelaySts: ComSignalType=BOOLEAN, ComBitSize=1, ComBitPosition=42, ComSystemTemplateSystemSignalRef=BMSH_NegMainRelaySts
        BMSH_PosMainRelaySts: ComSignalType=BOOLEAN, ComBitSize=1, ComBitPosition=41, ComSystemTemplateSystemSignalRef=BMSH_PosMainRelaySts
        BMSH_IntelligentChargeReq: ComSignalType=BOOLEAN, ComBitSize=1, ComBitPosition=40, ComSystemTemplateSystemSignalRef=BMSH_IntelligentChargeReq
        BMSH_OBCPrechgSt: ComSignalType=UINT8, ComBitSize=3, ComBitPosition=39, ComSystemTemplateSystemSignalRef=BMSH_OBCPrechgSt
        BMSH_MainPrechgSt: ComSignalType=UINT8, ComBitSize=3, ComBitPosition=36, ComSystemTemplateSystemSignalRef=BMSH_MainPrechgSt
        BMSH_InsulationSts_BMS_2: ComSignalType=UINT8, ComBitSize=2, ComBitPosition=33, ComSystemTemplateSystemSignalRef=BMSH_InsulationSts
        BMSH_VehicleHVILSts: ComSignalType=UINT8, ComBitSize=2, ComBitPosition=31, ComSystemTemplateSystemSignalRef=BMSH_VehicleHVILSts
        BMSH_InterHVILSts_BMS_2: ComSignalType=UINT8, ComBitSize=2, ComBitPosition=29, ComSystemTemplateSystemSignalRef=BMSH_InterHVILSts
        BMSH_stMode_BMS_2: ComSignalType=UINT8, ComBitSize=4, ComBitPosition=27, ComSystemTemplateSystemSignalRef=BMSH_stMode
        Reserved_BMSH_SOH: ComSignalType=UINT8, ComBitSize=8, ComBitPosition=23, ComSystemTemplateSystemSignalRef=Reserved_BMSH_SOH
        BMSH_HVBusVolt: ComSignalType=UINT16, ComBitSize=16, ComBitPosition=7, ComSystemTemplateSystemSignalRef=BMSH_HVBusVolt
      BMS_Vol_13_Can_Network_CANNODE_0 (ComIPdu):
        ComIPduSignalProcessing = IMMEDIATE
        ComIPduType = NORMAL
        ComIPduDirection = SEND
        ComFirstTimeout = 1.0
        ComTimeout = 1.0
        ComIPduGroupRef = ComIPduGroup_Tx
        ComPduIdRef = PduCollection/BMS_Vol_13_Can_Network_CANNODE_0_Com2PduR
        ComIPduSignalRef = BMS_BattCellOrder52Vol
        ComIPduSignalRef = BMS_BattCellOrder51Vol
        ComIPduSignalRef = BMS_BattCellOrder50Vol
        ComIPduSignalRef = BMS_BattCellOrder49Vol
        ComTxIPdu: ComMinimumDelayTime=0.0, ComTxIPduUnusedAreasDefault=255
          ComTxModeTrue
            ComTxMode: ComTxModeTimePeriod=1.0, ComTxModeMode=PERIODIC, ComTxModeNumberOfRepetitions=0, ComTxModeRepetitionPeriod=0, ComTxModeTimeOffset=0.0
          ComTxModeFalse
            ComTxMode: ComTxModeTimePeriod=1.0, ComTxModeMode=PERIODIC, ComTxModeNumberOfRepetitions=0, ComTxModeRepetitionPeriod=0, ComTxModeTimeOffset=0.0
      4 x ComSignal, all with ComSignalInitValue=0, ComSignalType=UINT16, ComSignalEndianness=BIG_ENDIAN, ComBitSize=16, ComUpdateBitPosition=-1, ComTransferProperty=TRIGGERED:
        BMS_BattCellOrder52Vol: ComBitPosition=55, ComSystemTemplateSystemSignalRef=BMS_BattCellOrder52Vol
        BMS_BattCellOrder51Vol: ComBitPosition=39, ComSystemTemplateSystemSignalRef=BMS_BattCellOrder51Vol
        BMS_BattCellOrder50Vol: ComBitPosition=23, ComSystemTemplateSystemSignalRef=BMS_BattCellOrder50Vol
        BMS_BattCellOrder49Vol: ComBitPosition=7, ComSystemTemplateSystemSignalRef=BMS_BattCellOrder49Vol
      BMS_Vol_12_Can_Network_CANNODE_0 (ComIPdu):
        ComIPduSignalProcessing = IMMEDIATE
        ComIPduType = NORMAL
        ComIPduDirection = SEND
        ComFirstTimeout = 1.0
        ComTimeout = 1.0
        ComIPduGroupRef = ComIPduGroup_Tx
        ComPduIdRef = PduCollection/BMS_Vol_12_Can_Network_CANNODE_0_Com2PduR
        ComIPduSignalRef = BMS_BattCellOrder48Vol
        ComIPduSignalRef = BMS_BattCellOrder47Vol
        ComIPduSignalRef = BMS_BattCellOrder46Vol
        ComIPduSignalRef = BMS_BattCellOrder45Vol
        ComTxIPdu: ComMinimumDelayTime=0.0, ComTxIPduUnusedAreasDefault=255
          ComTxModeTrue
            ComTxMode: ComTxModeTimePeriod=1.0, ComTxModeMode=PERIODIC, ComTxModeNumberOfRepetitions=0, ComTxModeRepetitionPeriod=0, ComTxModeTimeOffset=0.0
          ComTxModeFalse
            ComTxMode: ComTxModeTimePeriod=1.0, ComTxModeMode=PERIODIC, ComTxModeNumberOfRepetitions=0, ComTxModeRepetitionPeriod=0, ComTxModeTimeOffset=0.0
      4 x ComSignal, all with ComSignalInitValue=0, ComSignalType=UINT16, ComSignalEndianness=BIG_ENDIAN, ComBitSize=16, ComUpdateBitPosition=-1, ComTransferProperty=TRIGGERED:
        BMS_BattCellOrder48Vol: ComBitPosition=55, ComSystemTemplateSystemSignalRef=BMS_BattCellOrder48Vol
        BMS_BattCellOrder47Vol: ComBitPosition=39, ComSystemTemplateSystemSignalRef=BMS_BattCellOrder47Vol
        BMS_BattCellOrder46Vol: ComBitPosition=23, ComSystemTemplateSystemSignalRef=BMS_BattCellOrder46Vol
        BMS_BattCellOrder45Vol: ComBitPosition=7, ComSystemTemplateSystemSignalRef=BMS_BattCellOrder45Vol
      BMS_23_Can_Network_CANNODE_0 (ComIPdu):
        ComIPduSignalProcessing = IMMEDIATE
        ComIPduType = NORMAL
        ComIPduDirection = SEND
        ComFirstTimeout = 1.0
        ComTimeout = 1.0
        ComIPduGroupRef = ComIPduGroup_Tx
        ComPduIdRef = PduCollection/BMS_23_Can_Network_CANNODE_0_Com2PduR
        ComIPduSignalRef = BMSH_HardwareVersionNumber7
        ComIPduSignalRef = BMSH_HardwareVersionNumber6
        ComIPduSignalRef = BMSH_HardwareVersionNumber5
        ComIPduSignalRef = BMSH_HardwareVersionNumber4
        ComIPduSignalRef = BMSH_HardwareVersionNumber3
        ComIPduSignalRef = BMSH_HardwareVersionNumber2
        ComIPduSignalRef = BMSH_HardwareVersionNumber1
        ComIPduSignalRef = BMSH_HardwareVersionDataLength
        ComIPduSignalRef = BMSH_HardwarePacketNumber
        ComTxIPdu: ComMinimumDelayTime=0.0, ComTxIPduUnusedAreasDefault=255
          ComTxModeTrue
            ComTxMode: ComTxModeTimePeriod=1.0, ComTxModeMode=PERIODIC, ComTxModeNumberOfRepetitions=0, ComTxModeRepetitionPeriod=0, ComTxModeTimeOffset=0.0
          ComTxModeFalse
            ComTxMode: ComTxModeTimePeriod=1.0, ComTxModeMode=PERIODIC, ComTxModeNumberOfRepetitions=0, ComTxModeRepetitionPeriod=0, ComTxModeTimeOffset=0.0
      9 x ComSignal, all with ComSignalInitValue=0, ComSignalType=UINT8, ComSignalEndianness=BIG_ENDIAN, ComUpdateBitPosition=-1, ComTransferProperty=TRIGGERED:
        BMSH_HardwareVersionNumber7: ComBitSize=8, ComBitPosition=63, ComSystemTemplateSystemSignalRef=BMSH_HardwareVersionNumber7
        BMSH_HardwareVersionNumber6: ComBitSize=8, ComBitPosition=55, ComSystemTemplateSystemSignalRef=BMSH_HardwareVersionNumber6
        BMSH_HardwareVersionNumber5: ComBitSize=8, ComBitPosition=47, ComSystemTemplateSystemSignalRef=BMSH_HardwareVersionNumber5
        BMSH_HardwareVersionNumber4: ComBitSize=8, ComBitPosition=39, ComSystemTemplateSystemSignalRef=BMSH_HardwareVersionNumber4
        BMSH_HardwareVersionNumber3: ComBitSize=8, ComBitPosition=31, ComSystemTemplateSystemSignalRef=BMSH_HardwareVersionNumber3
        BMSH_HardwareVersionNumber2: ComBitSize=8, ComBitPosition=23, ComSystemTemplateSystemSignalRef=BMSH_HardwareVersionNumber2
        BMSH_HardwareVersionNumber1: ComBitSize=8, ComBitPosition=15, ComSystemTemplateSystemSignalRef=BMSH_HardwareVersionNumber1
        BMSH_HardwareVersionDataLength: ComBitSize=4, ComBitPosition=7, ComSystemTemplateSystemSignalRef=BMSH_HardwareVersionDataLength
        BMSH_HardwarePacketNumber: ComBitSize=4, ComBitPosition=3, ComSystemTemplateSystemSignalRef=BMSH_HardwarePacketNumber
      BMS_Vol_11_Can_Network_CANNODE_0 (ComIPdu):
        ComIPduSignalProcessing = IMMEDIATE
        ComIPduType = NORMAL
        ComIPduDirection = SEND
        ComFirstTimeout = 1.0
        ComTimeout = 1.0
        ComIPduGroupRef = ComIPduGroup_Tx
        ComPduIdRef = PduCollection/BMS_Vol_11_Can_Network_CANNODE_0_Com2PduR
        ComIPduSignalRef = BMS_BattCellOrder44Vol
        ComIPduSignalRef = BMS_BattCellOrder43Vol
        ComIPduSignalRef = BMS_BattCellOrder42Vol
        ComIPduSignalRef = BMS_BattCellOrder41Vol
        ComTxIPdu: ComMinimumDelayTime=0.0, ComTxIPduUnusedAreasDefault=255
          ComTxModeTrue
            ComTxMode: ComTxModeTimePeriod=1.0, ComTxModeMode=PERIODIC, ComTxModeNumberOfRepetitions=0, ComTxModeRepetitionPeriod=0, ComTxModeTimeOffset=0.0
          ComTxModeFalse
            ComTxMode: ComTxModeTimePeriod=1.0, ComTxModeMode=PERIODIC, ComTxModeNumberOfRepetitions=0, ComTxModeRepetitionPeriod=0, ComTxModeTimeOffset=0.0
      4 x ComSignal, all with ComSignalInitValue=0, ComSignalType=UINT16, ComSignalEndianness=BIG_ENDIAN, ComBitSize=16, ComUpdateBitPosition=-1, ComTransferProperty=TRIGGERED:
        BMS_BattCellOrder44Vol: ComBitPosition=55, ComSystemTemplateSystemSignalRef=BMS_BattCellOrder44Vol
        BMS_BattCellOrder43Vol: ComBitPosition=39, ComSystemTemplateSystemSignalRef=BMS_BattCellOrder43Vol
        BMS_BattCellOrder42Vol: ComBitPosition=23, ComSystemTemplateSystemSignalRef=BMS_BattCellOrder42Vol
        BMS_BattCellOrder41Vol: ComBitPosition=7, ComSystemTemplateSystemSignalRef=BMS_BattCellOrder41Vol
      BMS_25_Can_Network_CANNODE_0 (ComIPdu):
        ComIPduSignalProcessing = IMMEDIATE
        ComIPduType = NORMAL
        ComIPduDirection = SEND
        ComFirstTimeout = 0.1
        ComTimeout = 0.1
        ComIPduGroupRef = ComIPduGroup_Tx
        ComPduIdRef = PduCollection/BMS_25_Can_Network_CANNODE_0_Com2PduR
        ComIPduSignalRef = BMS_25_Reserved1
        ComIPduSignalRef = BMSH_SelfHeatPowerReq
        ComIPduSignalRef = BMSH_OBDBattTempAvg
        ComIPduSignalRef = BMSH_HVV4Volt
        ComIPduSignalRef = BMSH_HVV3Volt
        ComTxIPdu: ComMinimumDelayTime=0.0, ComTxIPduUnusedAreasDefault=255
          ComTxModeTrue
            ComTxMode: ComTxModeTimePeriod=0.1, ComTxModeMode=PERIODIC, ComTxModeNumberOfRepetitions=0, ComTxModeRepetitionPeriod=0, ComTxModeTimeOffset=0.0
          ComTxModeFalse
            ComTxMode: ComTxModeTimePeriod=0.1, ComTxModeMode=PERIODIC, ComTxModeNumberOfRepetitions=0, ComTxModeRepetitionPeriod=0, ComTxModeTimeOffset=0.0
      5 x ComSignal, all with ComSignalEndianness=BIG_ENDIAN, ComUpdateBitPosition=-1, ComTransferProperty=TRIGGERED:
        BMS_25_Reserved1: ComSignalInitValue=0, ComSignalType=UINT16, ComBitSize=12, ComBitPosition=51, ComSystemTemplateSystemSignalRef=BMS_25_Reserved1
        BMSH_SelfHeatPowerReq: ComSignalInitValue=0, ComSignalType=UINT8, ComBitSize=8, ComBitPosition=43, ComSystemTemplateSystemSignalRef=BMSH_SelfHeatPowerReq
        BMSH_OBDBattTempAvg: ComSignalInitValue=1500, ComSignalType=UINT16, ComBitSize=12, ComBitPosition=39, ComSystemTemplateSystemSignalRef=BMSH_OBDBattTempAvg
        BMSH_HVV4Volt: ComSignalInitValue=0, ComSignalType=UINT16, ComBitSize=16, ComBitPosition=23, ComSystemTemplateSystemSignalRef=BMSH_HVV4Volt
        BMSH_HVV3Volt: ComSignalInitValue=0, ComSignalType=UINT16, ComBitSize=16, ComBitPosition=7, ComSystemTemplateSystemSignalRef=BMSH_HVV3Volt
      BMS_Vol_10_Can_Network_CANNODE_0 (ComIPdu):
        ComIPduSignalProcessing = IMMEDIATE
        ComIPduType = NORMAL
        ComIPduDirection = SEND
        ComFirstTimeout = 1.0
        ComTimeout = 1.0
        ComIPduGroupRef = ComIPduGroup_Tx
        ComPduIdRef = PduCollection/BMS_Vol_10_Can_Network_CANNODE_0_Com2PduR
        ComIPduSignalRef = BMS_BattCellOrder40Vol
        ComIPduSignalRef = BMS_BattCellOrder39Vol
        ComIPduSignalRef = BMS_BattCellOrder38Vol
        ComIPduSignalRef = BMS_BattCellOrder37Vol
        ComTxIPdu: ComMinimumDelayTime=0.0, ComTxIPduUnusedAreasDefault=255
          ComTxModeTrue
            ComTxMode: ComTxModeTimePeriod=1.0, ComTxModeMode=PERIODIC, ComTxModeNumberOfRepetitions=0, ComTxModeRepetitionPeriod=0, ComTxModeTimeOffset=0.0
          ComTxModeFalse
            ComTxMode: ComTxModeTimePeriod=1.0, ComTxModeMode=PERIODIC, ComTxModeNumberOfRepetitions=0, ComTxModeRepetitionPeriod=0, ComTxModeTimeOffset=0.0
      4 x ComSignal, all with ComSignalInitValue=0, ComSignalType=UINT16, ComSignalEndianness=BIG_ENDIAN, ComBitSize=16, ComUpdateBitPosition=-1, ComTransferProperty=TRIGGERED:
        BMS_BattCellOrder40Vol: ComBitPosition=55, ComSystemTemplateSystemSignalRef=BMS_BattCellOrder40Vol
        BMS_BattCellOrder39Vol: ComBitPosition=39, ComSystemTemplateSystemSignalRef=BMS_BattCellOrder39Vol
        BMS_BattCellOrder38Vol: ComBitPosition=23, ComSystemTemplateSystemSignalRef=BMS_BattCellOrder38Vol
        BMS_BattCellOrder37Vol: ComBitPosition=7, ComSystemTemplateSystemSignalRef=BMS_BattCellOrder37Vol
      BMS_22_Can_Network_CANNODE_0 (ComIPdu):
        ComIPduSignalProcessing = IMMEDIATE
        ComIPduType = NORMAL
        ComIPduDirection = SEND
        ComFirstTimeout = 1.0
        ComTimeout = 1.0
        ComIPduGroupRef = ComIPduGroup_Tx
        ComPduIdRef = PduCollection/BMS_22_Can_Network_CANNODE_0_Com2PduR
        ComIPduSignalRef = BMSH_SoftwareVersionNumber7
        ComIPduSignalRef = BMSH_SoftwareVersionNumber6
        ComIPduSignalRef = BMSH_SoftwareVersionNumber5
        ComIPduSignalRef = BMSH_SoftwareVersionNumber4
        ComIPduSignalRef = BMSH_SoftwareVersionNumber3
        ComIPduSignalRef = BMSH_SoftwareVersionNumber2
        ComIPduSignalRef = BMSH_SoftwareVersionNumber1
        ComIPduSignalRef = BMSH_SoftwareVersionDataLength
        ComIPduSignalRef = BMSH_SoftwarePacketNumber
        ComTxIPdu: ComMinimumDelayTime=0.0, ComTxIPduUnusedAreasDefault=255
          ComTxModeTrue
            ComTxMode: ComTxModeTimePeriod=1.0, ComTxModeMode=PERIODIC, ComTxModeNumberOfRepetitions=0, ComTxModeRepetitionPeriod=0, ComTxModeTimeOffset=0.0
          ComTxModeFalse
            ComTxMode: ComTxModeTimePeriod=1.0, ComTxModeMode=PERIODIC, ComTxModeNumberOfRepetitions=0, ComTxModeRepetitionPeriod=0, ComTxModeTimeOffset=0.0
      9 x ComSignal, all with ComSignalInitValue=0, ComSignalType=UINT8, ComSignalEndianness=BIG_ENDIAN, ComUpdateBitPosition=-1, ComTransferProperty=TRIGGERED:
        BMSH_SoftwareVersionNumber7: ComBitSize=8, ComBitPosition=63, ComSystemTemplateSystemSignalRef=BMSH_SoftwareVersionNumber7
        BMSH_SoftwareVersionNumber6: ComBitSize=8, ComBitPosition=55, ComSystemTemplateSystemSignalRef=BMSH_SoftwareVersionNumber6
        BMSH_SoftwareVersionNumber5: ComBitSize=8, ComBitPosition=47, ComSystemTemplateSystemSignalRef=BMSH_SoftwareVersionNumber5
        BMSH_SoftwareVersionNumber4: ComBitSize=8, ComBitPosition=39, ComSystemTemplateSystemSignalRef=BMSH_SoftwareVersionNumber4
        BMSH_SoftwareVersionNumber3: ComBitSize=8, ComBitPosition=31, ComSystemTemplateSystemSignalRef=BMSH_SoftwareVersionNumber3
        BMSH_SoftwareVersionNumber2: ComBitSize=8, ComBitPosition=23, ComSystemTemplateSystemSignalRef=BMSH_SoftwareVersionNumber2
        BMSH_SoftwareVersionNumber1: ComBitSize=8, ComBitPosition=15, ComSystemTemplateSystemSignalRef=BMSH_SoftwareVersionNumber1
        BMSH_SoftwareVersionDataLength: ComBitSize=4, ComBitPosition=7, ComSystemTemplateSystemSignalRef=BMSH_SoftwareVersionDataLength
        BMSH_SoftwarePacketNumber: ComBitSize=4, ComBitPosition=3, ComSystemTemplateSystemSignalRef=BMSH_SoftwarePacketNumber
      BMS_6_Can_Network_CANNODE_0 (ComIPdu):
        ComIPduSignalProcessing = IMMEDIATE
        ComIPduType = NORMAL
        ComIPduDirection = SEND
        ComFirstTimeout = 0.1
        ComTimeout = 0.1
        ComIPduGroupRef = ComIPduGroup_Tx
        ComPduIdRef = PduCollection/BMS_6_Can_Network_CANNODE_0_Com2PduR
        ComIPduSignalRef = BMSH_6_CRC
        ComIPduSignalRef = BMSH_6_MessageCounter
        ComIPduSignalRef = BMSH_WaterTempChangeRateReq
        ComIPduSignalRef = BMSH_6_Reserved1
        ComIPduSignalRef = BMSH_OutletWaterTempValid
        ComIPduSignalRef = BMSH_InletWaterTempValid
        ComIPduSignalRef = BMSH_PackThermalSensorSts
        ComIPduSignalRef = BMSH_ThermalManageReq
        ComIPduSignalRef = BMSH_FlowRateReq
        ComIPduSignalRef = BMSH_HeatPowerReq
        ComIPduSignalRef = BMSH_InletWaterTempTarget
        ComIPduSignalRef = BMSH_OutletWaterTemp
        ComIPduSignalRef = BMSH_InletWaterTemp
        ComTxIPdu: ComMinimumDelayTime=0.0, ComTxIPduUnusedAreasDefault=255
          ComTxModeTrue
            ComTxMode: ComTxModeTimePeriod=0.1, ComTxModeMode=PERIODIC, ComTxModeNumberOfRepetitions=0, ComTxModeRepetitionPeriod=0, ComTxModeTimeOffset=0.0
          ComTxModeFalse
            ComTxMode: ComTxModeTimePeriod=0.1, ComTxModeMode=PERIODIC, ComTxModeNumberOfRepetitions=0, ComTxModeRepetitionPeriod=0, ComTxModeTimeOffset=0.0
      13 x ComSignal, all with ComSignalEndianness=BIG_ENDIAN, ComUpdateBitPosition=-1, ComTransferProperty=TRIGGERED:
        BMSH_6_CRC: ComSignalInitValue=0, ComSignalType=UINT8, ComBitSize=8, ComBitPosition=63, ComSystemTemplateSystemSignalRef=BMSH_6_CRC
        BMSH_6_MessageCounter: ComSignalInitValue=0, ComSignalType=UINT8, ComBitSize=4, ComBitPosition=51, ComSystemTemplateSystemSignalRef=BMSH_6_MessageCounter
        BMSH_WaterTempChangeRateReq: ComSignalInitValue=0, ComSignalType=UINT8, ComBitSize=4, ComBitPosition=55, ComSystemTemplateSystemSignalRef=BMSH_WaterTempChangeRateReq
        BMSH_6_Reserved1: ComSignalInitValue=0, ComSignalType=UINT8, ComBitSize=2, ComBitPosition=47, ComSystemTemplateSystemSignalRef=BMSH_6_Reserved1
        BMSH_OutletWaterTempValid: ComSignalInitValue=0, ComSignalType=BOOLEAN, ComBitSize=1, ComBitPosition=45, ComSystemTemplateSystemSignalRef=BMSH_OutletWaterTempValid
        BMSH_InletWaterTempValid: ComSignalInitValue=0, ComSignalType=BOOLEAN, ComBitSize=1, ComBitPosition=44, ComSystemTemplateSystemSignalRef=BMSH_InletWaterTempValid
        BMSH_PackThermalSensorSts: ComSignalInitValue=0, ComSignalType=UINT8, ComBitSize=2, ComBitPosition=43, ComSystemTemplateSystemSignalRef=BMSH_PackThermalSensorSts
        BMSH_ThermalManageReq: ComSignalInitValue=0, ComSignalType=UINT8, ComBitSize=2, ComBitPosition=41, ComSystemTemplateSystemSignalRef=BMSH_ThermalManageReq
        BMSH_FlowRateReq: ComSignalInitValue=0, ComSignalType=UINT8, ComBitSize=8, ComBitPosition=39, ComSystemTemplateSystemSignalRef=BMSH_FlowRateReq
        BMSH_HeatPowerReq: ComSignalInitValue=0, ComSignalType=UINT8, ComBitSize=8, ComBitPosition=31, ComSystemTemplateSystemSignalRef=BMSH_HeatPowerReq
        BMSH_InletWaterTempTarget: ComSignalInitValue=40, ComSignalType=UINT8, ComBitSize=8, ComBitPosition=23, ComSystemTemplateSystemSignalRef=BMSH_InletWaterTempTarget
        BMSH_OutletWaterTemp: ComSignalInitValue=40, ComSignalType=UINT8, ComBitSize=8, ComBitPosition=15, ComSystemTemplateSystemSignalRef=BMSH_OutletWaterTemp
        BMSH_InletWaterTemp: ComSignalInitValue=40, ComSignalType=UINT8, ComBitSize=8, ComBitPosition=7, ComSystemTemplateSystemSignalRef=BMSH_InletWaterTemp
      BMS_13_Can_Network_CANNODE_0 (ComIPdu):
        ComIPduSignalProcessing = IMMEDIATE
        ComIPduType = NORMAL
        ComIPduDirection = SEND
        ComFirstTimeout = 1.0
        ComTimeout = 1.0
        ComIPduGroupRef = ComIPduGroup_Tx
        ComPduIdRef = PduCollection/BMS_13_Can_Network_CANNODE_0_Com2PduR
        ComIPduSignalRef = BMS_SubsymCodeOrder6
        ComIPduSignalRef = BMS_SubsymCodeOrder5
        ComIPduSignalRef = BMS_SubsymCodeOrder4
        ComIPduSignalRef = BMS_SubsymCodeOrder3
        ComIPduSignalRef = BMS_SubsymCodeOrder2
        ComIPduSignalRef = BMS_SubsymCodeOrder1
        ComIPduSignalRef = BMS_SubsymCodeFrameTotalNum_BMS_13
        ComIPduSignalRef = BMS_SubsymCodeFrameOrder1
        ComTxIPdu: ComMinimumDelayTime=0.0, ComTxIPduUnusedAreasDefault=255
          ComTxModeTrue
            ComTxMode: ComTxModeTimePeriod=1.0, ComTxModeMode=PERIODIC, ComTxModeNumberOfRepetitions=0, ComTxModeRepetitionPeriod=0, ComTxModeTimeOffset=0.0
          ComTxModeFalse
            ComTxMode: ComTxModeTimePeriod=1.0, ComTxModeMode=PERIODIC, ComTxModeNumberOfRepetitions=0, ComTxModeRepetitionPeriod=0, ComTxModeTimeOffset=0.0
      8 x ComSignal, all with ComSignalInitValue=0, ComSignalType=UINT8, ComSignalEndianness=BIG_ENDIAN, ComBitSize=8, ComUpdateBitPosition=-1, ComTransferProperty=TRIGGERED:
        BMS_SubsymCodeOrder6: ComBitPosition=63, ComSystemTemplateSystemSignalRef=BMS_SubsymCodeOrder6
        BMS_SubsymCodeOrder5: ComBitPosition=55, ComSystemTemplateSystemSignalRef=BMS_SubsymCodeOrder5
        BMS_SubsymCodeOrder4: ComBitPosition=47, ComSystemTemplateSystemSignalRef=BMS_SubsymCodeOrder4
        BMS_SubsymCodeOrder3: ComBitPosition=39, ComSystemTemplateSystemSignalRef=BMS_SubsymCodeOrder3
        BMS_SubsymCodeOrder2: ComBitPosition=31, ComSystemTemplateSystemSignalRef=BMS_SubsymCodeOrder2
        BMS_SubsymCodeOrder1: ComBitPosition=23, ComSystemTemplateSystemSignalRef=BMS_SubsymCodeOrder1
        BMS_SubsymCodeFrameTotalNum_BMS_13: ComBitPosition=15, ComSystemTemplateSystemSignalRef=BMS_SubsymCodeFrameTotalNum
        BMS_SubsymCodeFrameOrder1: ComBitPosition=7, ComSystemTemplateSystemSignalRef=BMS_SubsymCodeFrameOrder1
      BMS_12_Can_Network_CANNODE_0 (ComIPdu):
        ComIPduSignalProcessing = IMMEDIATE
        ComIPduType = NORMAL
        ComIPduDirection = SEND
        ComFirstTimeout = 1.0
        ComTimeout = 1.0
        ComIPduGroupRef = ComIPduGroup_Tx
        ComPduIdRef = PduCollection/BMS_12_Can_Network_CANNODE_0_Com2PduR
        ComIPduSignalRef = BMSH_BalanceActive
        ComIPduSignalRef = BMSH_Battery_Uniformity
        ComIPduSignalRef = BMSH_StoredEnergySys
        ComIPduSignalRef = BMSH_Charge_Over
        ComIPduSignalRef = BMSH_HVILcuitFailure
        ComIPduSignalRef = BMSH_Battery_Mismatching
        ComIPduSignalRef = BMSH_BatteryTempLightSts
        ComIPduSignalRef = BMSH_Charge_Over_Current
        ComIPduSignalRef = BMSH_Discharge_Over_Current
        ComIPduSignalRef = BMSH_IsocircuitFailure
        ComIPduSignalRef = BMSH_Cell_Voltage_Uniformity
        ComIPduSignalRef = BMSH_LowSOC
        ComIPduSignalRef = BMSH_CellUnderVol
        ComIPduSignalRef = BMSH_CellOverVol
        ComIPduSignalRef = BMSH_OverSOC
        ComIPduSignalRef = BMSH_Battery_Under_Voltage
        ComIPduSignalRef = BMSH_Battery_Over_Voltage
        ComIPduSignalRef = BMSH_Low_Temperature
        ComIPduSignalRef = BMSH_Over_Temperature
        ComIPduSignalRef = BMSH_PacksubsystemVolt
        ComIPduSignalRef = BMSH_SOC_Jump
        ComIPduSignalRef = BMSH_PacksubsystemCurrent
        ComIPduSignalRef = BMSH_TempUniformity
        ComTxIPdu: ComMinimumDelayTime=0.0, ComTxIPduUnusedAreasDefault=255
          ComTxModeTrue
            ComTxMode: ComTxModeTimePeriod=1.0, ComTxModeMode=PERIODIC, ComTxModeNumberOfRepetitions=0, ComTxModeRepetitionPeriod=0, ComTxModeTimeOffset=0.0
          ComTxModeFalse
            ComTxMode: ComTxModeTimePeriod=1.0, ComTxModeMode=PERIODIC, ComTxModeNumberOfRepetitions=0, ComTxModeRepetitionPeriod=0, ComTxModeTimeOffset=0.0
      23 x ComSignal, all with ComSignalEndianness=BIG_ENDIAN, ComUpdateBitPosition=-1, ComTransferProperty=TRIGGERED:
        BMSH_BalanceActive: ComSignalInitValue=0, ComSignalType=BOOLEAN, ComBitSize=1, ComBitPosition=63, ComSystemTemplateSystemSignalRef=BMSH_BalanceActive
        BMSH_Battery_Uniformity: ComSignalInitValue=0, ComSignalType=BOOLEAN, ComBitSize=1, ComBitPosition=62, ComSystemTemplateSystemSignalRef=BMSH_Battery_Uniformity
        BMSH_StoredEnergySys: ComSignalInitValue=0, ComSignalType=BOOLEAN, ComBitSize=1, ComBitPosition=61, ComSystemTemplateSystemSignalRef=BMSH_StoredEnergySys
        BMSH_Charge_Over: ComSignalInitValue=0, ComSignalType=BOOLEAN, ComBitSize=1, ComBitPosition=60, ComSystemTemplateSystemSignalRef=BMSH_Charge_Over
        BMSH_HVILcuitFailure: ComSignalInitValue=0, ComSignalType=BOOLEAN, ComBitSize=1, ComBitPosition=59, ComSystemTemplateSystemSignalRef=BMSH_HVILcuitFailure
        BMSH_Battery_Mismatching: ComSignalInitValue=0, ComSignalType=BOOLEAN, ComBitSize=1, ComBitPosition=58, ComSystemTemplateSystemSignalRef=BMSH_Battery_Mismatching
        BMSH_BatteryTempLightSts: ComSignalInitValue=0, ComSignalType=UINT8, ComBitSize=2, ComBitPosition=57, ComSystemTemplateSystemSignalRef=BMSH_BatteryTempLightSts
        BMSH_Charge_Over_Current: ComSignalInitValue=0, ComSignalType=UINT8, ComBitSize=2, ComBitPosition=55, ComSystemTemplateSystemSignalRef=BMSH_Charge_Over_Current
        BMSH_Discharge_Over_Current: ComSignalInitValue=0, ComSignalType=UINT8, ComBitSize=2, ComBitPosition=53, ComSystemTemplateSystemSignalRef=BMSH_Discharge_Over_Current
        BMSH_IsocircuitFailure: ComSignalInitValue=0, ComSignalType=UINT8, ComBitSize=2, ComBitPosition=51, ComSystemTemplateSystemSignalRef=BMSH_IsocircuitFailure
        BMSH_Cell_Voltage_Uniformity: ComSignalInitValue=0, ComSignalType=UINT8, ComBitSize=2, ComBitPosition=49, ComSystemTemplateSystemSignalRef=BMSH_Cell_Voltage_Uniformity
        BMSH_LowSOC: ComSignalInitValue=0, ComSignalType=UINT8, ComBitSize=2, ComBitPosition=47, ComSystemTemplateSystemSignalRef=BMSH_LowSOC
        BMSH_CellUnderVol: ComSignalInitValue=0, ComSignalType=UINT8, ComBitSize=2, ComBitPosition=45, ComSystemTemplateSystemSignalRef=BMSH_CellUnderVol
        BMSH_CellOverVol: ComSignalInitValue=0, ComSignalType=UINT8, ComBitSize=2, ComBitPosition=43, ComSystemTemplateSystemSignalRef=BMSH_CellOverVol
        BMSH_OverSOC: ComSignalInitValue=0, ComSignalType=UINT8, ComBitSize=2, ComBitPosition=41, ComSystemTemplateSystemSignalRef=BMSH_OverSOC
        BMSH_Battery_Under_Voltage: ComSignalInitValue=0, ComSignalType=UINT8, ComBitSize=2, ComBitPosition=39, ComSystemTemplateSystemSignalRef=BMSH_Battery_Under_Voltage
        BMSH_Battery_Over_Voltage: ComSignalInitValue=0, ComSignalType=UINT8, ComBitSize=2, ComBitPosition=37, ComSystemTemplateSystemSignalRef=BMSH_Battery_Over_Voltage
        BMSH_Low_Temperature: ComSignalInitValue=0, ComSignalType=UINT8, ComBitSize=2, ComBitPosition=35, ComSystemTemplateSystemSignalRef=BMSH_Low_Temperature
        BMSH_Over_Temperature: ComSignalInitValue=0, ComSignalType=UINT8, ComBitSize=2, ComBitPosition=33, ComSystemTemplateSystemSignalRef=BMSH_Over_Temperature
        BMSH_PacksubsystemVolt: ComSignalInitValue=0, ComSignalType=UINT16, ComBitSize=15, ComBitPosition=23, ComSystemTemplateSystemSignalRef=BMSH_PacksubsystemVolt
        BMSH_SOC_Jump: ComSignalInitValue=0, ComSignalType=BOOLEAN, ComBitSize=1, ComBitPosition=24, ComSystemTemplateSystemSignalRef=BMSH_SOC_Jump
        BMSH_PacksubsystemCurrent: ComSignalInitValue=16000, ComSignalType=UINT16, ComBitSize=15, ComBitPosition=7, ComSystemTemplateSystemSignalRef=BMSH_PacksubsystemCurrent
        BMSH_TempUniformity: ComSignalInitValue=0, ComSignalType=BOOLEAN, ComBitSize=1, ComBitPosition=8, ComSystemTemplateSystemSignalRef=BMSH_TempUniformity
      BMS_7_Can_Network_CANNODE_0 (ComIPdu):
        ComIPduSignalProcessing = IMMEDIATE
        ComIPduType = NORMAL
        ComIPduDirection = SEND
        ComFirstTimeout = 0.1
        ComTimeout = 0.1
        ComIPduGroupRef = ComIPduGroup_Tx
        ComPduIdRef = PduCollection/BMS_7_Can_Network_CANNODE_0_Com2PduR
        ComIPduSignalRef = BMSH_7_CRC
        ComIPduSignalRef = BMSH_7_MessageCounter
        ComIPduSignalRef = BMSH_HCUChargeReq
        ComIPduSignalRef = BMS_OBCHeatRequest
        ComIPduSignalRef = BMSH_OBCChargeReq
        ComIPduSignalRef = BMS_HCUHeatRequest
        ComIPduSignalRef = BMSH_ChargeOutHeatVolSet
        ComIPduSignalRef = BMSH_ChargeOutMaxCurSet
        ComIPduSignalRef = BMSH_ChargeOutMaxVolSet
        ComTxIPdu: ComMinimumDelayTime=0.0, ComTxIPduUnusedAreasDefault=255
          ComTxModeTrue
            ComTxMode: ComTxModeTimePeriod=0.1, ComTxModeMode=PERIODIC, ComTxModeNumberOfRepetitions=0, ComTxModeRepetitionPeriod=0, ComTxModeTimeOffset=0.0
          ComTxModeFalse
            ComTxMode: ComTxModeTimePeriod=0.1, ComTxModeMode=PERIODIC, ComTxModeNumberOfRepetitions=0, ComTxModeRepetitionPeriod=0, ComTxModeTimeOffset=0.0
      9 x ComSignal, all with ComSignalInitValue=0, ComSignalEndianness=BIG_ENDIAN, ComUpdateBitPosition=-1, ComTransferProperty=TRIGGERED:
        BMSH_7_CRC: ComSignalType=UINT8, ComBitSize=8, ComBitPosition=63, ComSystemTemplateSystemSignalRef=BMSH_7_CRC
        BMSH_7_MessageCounter: ComSignalType=UINT8, ComBitSize=4, ComBitPosition=51, ComSystemTemplateSystemSignalRef=BMSH_7_MessageCounter
        BMSH_HCUChargeReq: ComSignalType=BOOLEAN, ComBitSize=1, ComBitPosition=55, ComSystemTemplateSystemSignalRef=BMSH_HCUChargeReq
        BMS_OBCHeatRequest: ComSignalType=BOOLEAN, ComBitSize=1, ComBitPosition=54, ComSystemTemplateSystemSignalRef=BMS_OBCHeatRequest
        BMSH_OBCChargeReq: ComSignalType=BOOLEAN, ComBitSize=1, ComBitPosition=53, ComSystemTemplateSystemSignalRef=BMSH_OBCChargeReq
        BMS_HCUHeatRequest: ComSignalType=BOOLEAN, ComBitSize=1, ComBitPosition=52, ComSystemTemplateSystemSignalRef=BMS_HCUHeatRequest
        BMSH_ChargeOutHeatVolSet: ComSignalType=UINT16, ComBitSize=16, ComBitPosition=39, ComSystemTemplateSystemSignalRef=BMSH_ChargeOutHeatVolSet
        BMSH_ChargeOutMaxCurSet: ComSignalType=UINT16, ComBitSize=16, ComBitPosition=23, ComSystemTemplateSystemSignalRef=BMSH_ChargeOutMaxCurSet
        BMSH_ChargeOutMaxVolSet: ComSignalType=UINT16, ComBitSize=16, ComBitPosition=7, ComSystemTemplateSystemSignalRef=BMSH_ChargeOutMaxVolSet
      BMS_10_Can_Network_CANNODE_0 (ComIPdu):
        ComIPduSignalProcessing = IMMEDIATE
        ComIPduType = NORMAL
        ComIPduDirection = SEND
        ComFirstTimeout = 1.0
        ComTimeout = 1.0
        ComIPduGroupRef = ComIPduGroup_Tx
        ComPduIdRef = PduCollection/BMS_10_Can_Network_CANNODE_0_Com2PduR
        ComIPduSignalRef = BMSH_TempMin_Num
        ComIPduSignalRef = BMSH_TempMax_Num
        ComIPduSignalRef = BMSH_TempSensor_MinTemp
        ComIPduSignalRef = BMSH_TempSensor_TempMinNum
        ComIPduSignalRef = BMSH_TempSensor_MaxTemp
        ComIPduSignalRef = BMSH_TempSensor_TempMaxNum
        ComIPduSignalRef = BMSH_TempSensor_TotalNum
        ComIPduSignalRef = BMSH_BattTempAvg
        ComTxIPdu: ComMinimumDelayTime=0.0, ComTxIPduUnusedAreasDefault=255
          ComTxModeTrue
            ComTxMode: ComTxModeTimePeriod=1.0, ComTxModeMode=PERIODIC, ComTxModeNumberOfRepetitions=0, ComTxModeRepetitionPeriod=0, ComTxModeTimeOffset=0.0
          ComTxModeFalse
            ComTxMode: ComTxModeTimePeriod=1.0, ComTxModeMode=PERIODIC, ComTxModeNumberOfRepetitions=0, ComTxModeRepetitionPeriod=0, ComTxModeTimeOffset=0.0
      8 x ComSignal, all with ComSignalType=UINT8, ComSignalEndianness=BIG_ENDIAN, ComBitSize=8, ComUpdateBitPosition=-1, ComTransferProperty=TRIGGERED:
        BMSH_TempMin_Num: ComSignalInitValue=0, ComBitPosition=63, ComSystemTemplateSystemSignalRef=BMSH_TempMin_Num
        BMSH_TempMax_Num: ComSignalInitValue=0, ComBitPosition=55, ComSystemTemplateSystemSignalRef=BMSH_TempMax_Num
        BMSH_TempSensor_MinTemp: ComSignalInitValue=40, ComBitPosition=47, ComSystemTemplateSystemSignalRef=BMSH_TempSensor_MinTemp
        BMSH_TempSensor_TempMinNum: ComSignalInitValue=0, ComBitPosition=39, ComSystemTemplateSystemSignalRef=BMSH_TempSensor_TempMinNum
        BMSH_TempSensor_MaxTemp: ComSignalInitValue=40, ComBitPosition=31, ComSystemTemplateSystemSignalRef=BMSH_TempSensor_MaxTemp
        BMSH_TempSensor_TempMaxNum: ComSignalInitValue=0, ComBitPosition=23, ComSystemTemplateSystemSignalRef=BMSH_TempSensor_TempMaxNum
        BMSH_TempSensor_TotalNum: ComSignalInitValue=0, ComBitPosition=15, ComSystemTemplateSystemSignalRef=BMSH_TempSensor_TotalNum
        BMSH_BattTempAvg: ComSignalInitValue=40, ComBitPosition=7, ComSystemTemplateSystemSignalRef=BMSH_BattTempAvg
      BMS_3_Can_Network_CANNODE_0 (ComIPdu):
        ComIPduSignalProcessing = IMMEDIATE
        ComIPduType = NORMAL
        ComIPduDirection = SEND
        ComFirstTimeout = 0.01
        ComTimeout = 0.01
        ComIPduGroupRef = ComIPduGroup_Tx
        ComPduIdRef = PduCollection/BMS_3_Can_Network_CANNODE_0_Com2PduR
        ComIPduSignalRef = BMSH_3_Reserved1
        ComIPduSignalRef = BMSH_MainPrechgResistanceSts
        ComIPduSignalRef = BMSH_PTCFuseSts
        ComIPduSignalRef = BMSH_RmcuFuseSts
        ComIPduSignalRef = BMSH_FmcuFuseSts
        ComIPduSignalRef = BMSH_BattVoltMinLimt
        ComIPduSignalRef = BMSH_BattVoltMaxLimt
        ComIPduSignalRef = BMSH_MaxChgPwrCont
        ComIPduSignalRef = BMSH_MaxChgPwrPeak
        ComTxIPdu: ComMinimumDelayTime=0.0, ComTxIPduUnusedAreasDefault=255
          ComTxModeTrue
            ComTxMode: ComTxModeTimePeriod=0.01, ComTxModeMode=PERIODIC, ComTxModeNumberOfRepetitions=0, ComTxModeRepetitionPeriod=0, ComTxModeTimeOffset=0.0
          ComTxModeFalse
            ComTxMode: ComTxModeTimePeriod=0.01, ComTxModeMode=PERIODIC, ComTxModeNumberOfRepetitions=0, ComTxModeRepetitionPeriod=0, ComTxModeTimeOffset=0.0
      9 x ComSignal, all with ComSignalInitValue=0, ComSignalEndianness=BIG_ENDIAN, ComUpdateBitPosition=-1, ComTransferProperty=TRIGGERED:
        BMSH_3_Reserved1: ComSignalType=UINT8, ComBitSize=4, ComBitPosition=63, ComSystemTemplateSystemSignalRef=BMSH_3_Reserved1
        BMSH_MainPrechgResistanceSts: ComSignalType=BOOLEAN, ComBitSize=1, ComBitPosition=59, ComSystemTemplateSystemSignalRef=BMSH_MainPrechgResistanceSts
        BMSH_PTCFuseSts: ComSignalType=BOOLEAN, ComBitSize=1, ComBitPosition=58, ComSystemTemplateSystemSignalRef=BMSH_PTCFuseSts
        BMSH_RmcuFuseSts: ComSignalType=BOOLEAN, ComBitSize=1, ComBitPosition=57, ComSystemTemplateSystemSignalRef=BMSH_RmcuFuseSts
        BMSH_FmcuFuseSts: ComSignalType=BOOLEAN, ComBitSize=1, ComBitPosition=56, ComSystemTemplateSystemSignalRef=BMSH_FmcuFuseSts
        BMSH_BattVoltMinLimt: ComSignalType=UINT16, ComBitSize=16, ComBitPosition=47, ComSystemTemplateSystemSignalRef=BMSH_BattVoltMinLimt
        BMSH_BattVoltMaxLimt: ComSignalType=UINT16, ComBitSize=16, ComBitPosition=31, ComSystemTemplateSystemSignalRef=BMSH_BattVoltMaxLimt
        BMSH_MaxChgPwrCont: ComSignalType=UINT16, ComBitSize=12, ComBitPosition=11, ComSystemTemplateSystemSignalRef=BMSH_MaxChgPwrCont
        BMSH_MaxChgPwrPeak: ComSignalType=UINT16, ComBitSize=12, ComBitPosition=7, ComSystemTemplateSystemSignalRef=BMSH_MaxChgPwrPeak
      BMS_Vol_24_Can_Network_CANNODE_0 (ComIPdu):
        ComIPduSignalProcessing = IMMEDIATE
        ComIPduType = NORMAL
        ComIPduDirection = SEND
        ComFirstTimeout = 1.0
        ComTimeout = 1.0
        ComIPduGroupRef = ComIPduGroup_Tx
        ComPduIdRef = PduCollection/BMS_Vol_24_Can_Network_CANNODE_0_Com2PduR
        ComIPduSignalRef = BMS_BattCellOrder96Vol
        ComIPduSignalRef = BMS_BattCellOrder95Vol
        ComIPduSignalRef = BMS_BattCellOrder94Vol
        ComIPduSignalRef = BMS_BattCellOrder93Vol
        ComTxIPdu: ComMinimumDelayTime=0.0, ComTxIPduUnusedAreasDefault=255
          ComTxModeTrue
            ComTxMode: ComTxModeTimePeriod=1.0, ComTxModeMode=PERIODIC, ComTxModeNumberOfRepetitions=0, ComTxModeRepetitionPeriod=0, ComTxModeTimeOffset=0.0
          ComTxModeFalse
            ComTxMode: ComTxModeTimePeriod=1.0, ComTxModeMode=PERIODIC, ComTxModeNumberOfRepetitions=0, ComTxModeRepetitionPeriod=0, ComTxModeTimeOffset=0.0
      4 x ComSignal, all with ComSignalInitValue=0, ComSignalType=UINT16, ComSignalEndianness=BIG_ENDIAN, ComBitSize=16, ComUpdateBitPosition=-1, ComTransferProperty=TRIGGERED:
        BMS_BattCellOrder96Vol: ComBitPosition=55, ComSystemTemplateSystemSignalRef=BMS_BattCellOrder96Vol
        BMS_BattCellOrder95Vol: ComBitPosition=39, ComSystemTemplateSystemSignalRef=BMS_BattCellOrder95Vol
        BMS_BattCellOrder94Vol: ComBitPosition=23, ComSystemTemplateSystemSignalRef=BMS_BattCellOrder94Vol
        BMS_BattCellOrder93Vol: ComBitPosition=7, ComSystemTemplateSystemSignalRef=BMS_BattCellOrder93Vol
      BMS_Vol_23_Can_Network_CANNODE_0 (ComIPdu):
        ComIPduSignalProcessing = IMMEDIATE
        ComIPduType = NORMAL
        ComIPduDirection = SEND
        ComFirstTimeout = 1.0
        ComTimeout = 1.0
        ComIPduGroupRef = ComIPduGroup_Tx
        ComPduIdRef = PduCollection/BMS_Vol_23_Can_Network_CANNODE_0_Com2PduR
        ComIPduSignalRef = BMS_BattCellOrder92Vol
        ComIPduSignalRef = BMS_BattCellOrder91Vol
        ComIPduSignalRef = BMS_BattCellOrder90Vol
        ComIPduSignalRef = BMS_BattCellOrder89Vol
        ComTxIPdu: ComMinimumDelayTime=0.0, ComTxIPduUnusedAreasDefault=255
          ComTxModeTrue
            ComTxMode: ComTxModeTimePeriod=1.0, ComTxModeMode=PERIODIC, ComTxModeNumberOfRepetitions=0, ComTxModeRepetitionPeriod=0, ComTxModeTimeOffset=0.0
          ComTxModeFalse
            ComTxMode: ComTxModeTimePeriod=1.0, ComTxModeMode=PERIODIC, ComTxModeNumberOfRepetitions=0, ComTxModeRepetitionPeriod=0, ComTxModeTimeOffset=0.0
      4 x ComSignal, all with ComSignalInitValue=0, ComSignalType=UINT16, ComSignalEndianness=BIG_ENDIAN, ComBitSize=16, ComUpdateBitPosition=-1, ComTransferProperty=TRIGGERED:
        BMS_BattCellOrder92Vol: ComBitPosition=55, ComSystemTemplateSystemSignalRef=BMS_BattCellOrder92Vol
        BMS_BattCellOrder91Vol: ComBitPosition=39, ComSystemTemplateSystemSignalRef=BMS_BattCellOrder91Vol
        BMS_BattCellOrder90Vol: ComBitPosition=23, ComSystemTemplateSystemSignalRef=BMS_BattCellOrder90Vol
        BMS_BattCellOrder89Vol: ComBitPosition=7, ComSystemTemplateSystemSignalRef=BMS_BattCellOrder89Vol
      BMS_Vol_22_Can_Network_CANNODE_0 (ComIPdu):
        ComIPduSignalProcessing = IMMEDIATE
        ComIPduType = NORMAL
        ComIPduDirection = SEND
        ComFirstTimeout = 1.0
        ComTimeout = 1.0
        ComIPduGroupRef = ComIPduGroup_Tx
        ComPduIdRef = PduCollection/BMS_Vol_22_Can_Network_CANNODE_0_Com2PduR
        ComIPduSignalRef = BMS_BattCellOrder88Vol
        ComIPduSignalRef = BMS_BattCellOrder87Vol
        ComIPduSignalRef = BMS_BattCellOrder86Vol
        ComIPduSignalRef = BMS_BattCellOrder85Vol
        ComTxIPdu: ComMinimumDelayTime=0.0, ComTxIPduUnusedAreasDefault=255
          ComTxModeTrue
            ComTxMode: ComTxModeTimePeriod=1.0, ComTxModeMode=PERIODIC, ComTxModeNumberOfRepetitions=0, ComTxModeRepetitionPeriod=0, ComTxModeTimeOffset=0.0
          ComTxModeFalse
            ComTxMode: ComTxModeTimePeriod=1.0, ComTxModeMode=PERIODIC, ComTxModeNumberOfRepetitions=0, ComTxModeRepetitionPeriod=0, ComTxModeTimeOffset=0.0
      4 x ComSignal, all with ComSignalInitValue=0, ComSignalType=UINT16, ComSignalEndianness=BIG_ENDIAN, ComBitSize=16, ComUpdateBitPosition=-1, ComTransferProperty=TRIGGERED:
        BMS_BattCellOrder88Vol: ComBitPosition=55, ComSystemTemplateSystemSignalRef=BMS_BattCellOrder88Vol
        BMS_BattCellOrder87Vol: ComBitPosition=39, ComSystemTemplateSystemSignalRef=BMS_BattCellOrder87Vol
        BMS_BattCellOrder86Vol: ComBitPosition=23, ComSystemTemplateSystemSignalRef=BMS_BattCellOrder86Vol
        BMS_BattCellOrder85Vol: ComBitPosition=7, ComSystemTemplateSystemSignalRef=BMS_BattCellOrder85Vol
      BMS_Vol_21_Can_Network_CANNODE_0 (ComIPdu):
        ComIPduSignalProcessing = IMMEDIATE
        ComIPduType = NORMAL
        ComIPduDirection = SEND
        ComFirstTimeout = 1.0
        ComTimeout = 1.0
        ComIPduGroupRef = ComIPduGroup_Tx
        ComPduIdRef = PduCollection/BMS_Vol_21_Can_Network_CANNODE_0_Com2PduR
        ComIPduSignalRef = BMS_BattCellOrder84Vol
        ComIPduSignalRef = BMS_BattCellOrder83Vol
        ComIPduSignalRef = BMS_BattCellOrder82Vol
        ComIPduSignalRef = BMS_BattCellOrder81Vol
        ComTxIPdu: ComMinimumDelayTime=0.0, ComTxIPduUnusedAreasDefault=255
          ComTxModeTrue
            ComTxMode: ComTxModeTimePeriod=1.0, ComTxModeMode=PERIODIC, ComTxModeNumberOfRepetitions=0, ComTxModeRepetitionPeriod=0, ComTxModeTimeOffset=0.0
          ComTxModeFalse
            ComTxMode: ComTxModeTimePeriod=1.0, ComTxModeMode=PERIODIC, ComTxModeNumberOfRepetitions=0, ComTxModeRepetitionPeriod=0, ComTxModeTimeOffset=0.0
      4 x ComSignal, all with ComSignalInitValue=0, ComSignalType=UINT16, ComSignalEndianness=BIG_ENDIAN, ComBitSize=16, ComUpdateBitPosition=-1, ComTransferProperty=TRIGGERED:
        BMS_BattCellOrder84Vol: ComBitPosition=55, ComSystemTemplateSystemSignalRef=BMS_BattCellOrder84Vol
        BMS_BattCellOrder83Vol: ComBitPosition=39, ComSystemTemplateSystemSignalRef=BMS_BattCellOrder83Vol
        BMS_BattCellOrder82Vol: ComBitPosition=23, ComSystemTemplateSystemSignalRef=BMS_BattCellOrder82Vol
        BMS_BattCellOrder81Vol: ComBitPosition=7, ComSystemTemplateSystemSignalRef=BMS_BattCellOrder81Vol
      BMS_4_Can_Network_CANNODE_0 (ComIPdu):
        ComIPduSignalProcessing = IMMEDIATE
        ComIPduType = NORMAL
        ComIPduDirection = SEND
        ComFirstTimeout = 0.01
        ComTimeout = 0.01
        ComIPduGroupRef = ComIPduGroup_Tx
        ComPduIdRef = PduCollection/BMS_4_Can_Network_CANNODE_0_Com2PduR
        ComIPduSignalRef = BMSH_4_Reserved1
        ComIPduSignalRef = BMSH_MaxChargeCurrent
        ComIPduSignalRef = BMSH_MaxDischargeCurrent
        ComIPduSignalRef = BMSH_MaxDchgPwrCont
        ComIPduSignalRef = BMSH_MaxDchgPwrPeak
        ComTxIPdu: ComMinimumDelayTime=0.0, ComTxIPduUnusedAreasDefault=255
          ComTxModeTrue
            ComTxMode: ComTxModeTimePeriod=0.01, ComTxModeMode=PERIODIC, ComTxModeNumberOfRepetitions=0, ComTxModeRepetitionPeriod=0, ComTxModeTimeOffset=0.0
          ComTxModeFalse
            ComTxMode: ComTxModeTimePeriod=0.01, ComTxModeMode=PERIODIC, ComTxModeNumberOfRepetitions=0, ComTxModeRepetitionPeriod=0, ComTxModeTimeOffset=0.0
      5 x ComSignal, all with ComSignalEndianness=BIG_ENDIAN, ComUpdateBitPosition=-1, ComTransferProperty=TRIGGERED:
        BMSH_4_Reserved1: ComSignalInitValue=0, ComSignalType=UINT8, ComBitSize=8, ComBitPosition=63, ComSystemTemplateSystemSignalRef=BMSH_4_Reserved1
        BMSH_MaxChargeCurrent: ComSignalInitValue=32000, ComSignalType=UINT16, ComBitSize=16, ComBitPosition=47, ComSystemTemplateSystemSignalRef=BMSH_MaxChargeCurrent
        BMSH_MaxDischargeCurrent: ComSignalInitValue=32000, ComSignalType=UINT16, ComBitSize=16, ComBitPosition=31, ComSystemTemplateSystemSignalRef=BMSH_MaxDischargeCurrent
        BMSH_MaxDchgPwrCont: ComSignalInitValue=0, ComSignalType=UINT16, ComBitSize=12, ComBitPosition=11, ComSystemTemplateSystemSignalRef=BMSH_MaxDchgPwrCont
        BMSH_MaxDchgPwrPeak: ComSignalInitValue=0, ComSignalType=UINT16, ComBitSize=12, ComBitPosition=7, ComSystemTemplateSystemSignalRef=BMSH_MaxDchgPwrPeak
      BMS_11_Can_Network_CANNODE_0 (ComIPdu):
        ComIPduSignalProcessing = IMMEDIATE
        ComIPduType = NORMAL
        ComIPduDirection = SEND
        ComFirstTimeout = 1.0
        ComTimeout = 1.0
        ComIPduGroupRef = ComIPduGroup_Tx
        ComPduIdRef = PduCollection/BMS_11_Can_Network_CANNODE_0_Com2PduR
        ComIPduSignalRef = BMSH_CellVoltMin
        ComIPduSignalRef = BMSH_CellVoltMax
        ComIPduSignalRef = BMSH_CellVoltMin_Num
        ComIPduSignalRef = BMSH_CellVoltMax_Num
        ComIPduSignalRef = BMSH_VoltMin_Num
        ComIPduSignalRef = BMSH_VoltMax_Num
        ComTxIPdu: ComMinimumDelayTime=0.0, ComTxIPduUnusedAreasDefault=255
          ComTxModeTrue
            ComTxMode: ComTxModeTimePeriod=1.0, ComTxModeMode=PERIODIC, ComTxModeNumberOfRepetitions=0, ComTxModeRepetitionPeriod=0, ComTxModeTimeOffset=0.0
          ComTxModeFalse
            ComTxMode: ComTxModeTimePeriod=1.0, ComTxModeMode=PERIODIC, ComTxModeNumberOfRepetitions=0, ComTxModeRepetitionPeriod=0, ComTxModeTimeOffset=0.0
      6 x ComSignal, all with ComSignalInitValue=0, ComSignalEndianness=BIG_ENDIAN, ComUpdateBitPosition=-1, ComTransferProperty=TRIGGERED:
        BMSH_CellVoltMin: ComSignalType=UINT16, ComBitSize=16, ComBitPosition=55, ComSystemTemplateSystemSignalRef=BMSH_CellVoltMin
        BMSH_CellVoltMax: ComSignalType=UINT16, ComBitSize=16, ComBitPosition=39, ComSystemTemplateSystemSignalRef=BMSH_CellVoltMax
        BMSH_CellVoltMin_Num: ComSignalType=UINT8, ComBitSize=8, ComBitPosition=31, ComSystemTemplateSystemSignalRef=BMSH_CellVoltMin_Num
        BMSH_CellVoltMax_Num: ComSignalType=UINT8, ComBitSize=8, ComBitPosition=23, ComSystemTemplateSystemSignalRef=BMSH_CellVoltMax_Num
        BMSH_VoltMin_Num: ComSignalType=UINT8, ComBitSize=8, ComBitPosition=15, ComSystemTemplateSystemSignalRef=BMSH_VoltMin_Num
        BMSH_VoltMax_Num: ComSignalType=UINT8, ComBitSize=8, ComBitPosition=7, ComSystemTemplateSystemSignalRef=BMSH_VoltMax_Num
    ComGeneral:
      ComVersionInfoApi = false
      ComCommonIPduTxPeriodFeature = false
      ComEnableJitterFilter = false
      ComEnableSignalGroupArrayApi = false
      ComCancellationSupport = false
      ComConfigurationUseDet = false
