AUTOSAR XML (schema 4-2-2)
package /ETAS_Project/EcucModuleConfigurationValuess
  module config CanNm: implementation-config-variant=VARIANT-PRE-COMPILE
    CanNmGlobalConfig:
      CanNmComUserDataSupport = false
      CanNmImmediateRestartEnabled = false
      CanNmImmediateTxconfEnabled = true
      CanNmVersionInfoApi = false
      CanNmBusLoadReductionEnabled = false
      CanNmBusSynchronizationEnabled = false
      CanNmComControlEnabled = true
      CanNmCoordinatorSyncSupport = false
      CanNmMainFunctionPeriod = 0.01
      CanNmNodeDetectionEnabled = false
      CanNmNodeIdEnabled = false
      CanNmPassiveModeEnabled = false
      CanNmPduRxIndicationEnabled = true
      CanNmRemoteSleepIndEnabled = false
      CanNmRepeatMsgIndEnabled = true
      CanNmStateChangeIndEnabled = true
      CanNmUserDataEnabled = true
      CanNmDevErrorDetect = false
      CanNmPnEiraCalcEnabled = false
      CanNmChannelConfig_NmConfig_0_CanNmCluster_0 (CanNmChannelConfig):
        CanNmBusLoadReductionActive = false
        CanNmCarWakeUpRxEnabled = false
        CanNmImmediateNmCycleTime = 0.01
        CanNmImmediateNmTransmissions = 10
        CanNmMsgCycleOffset = 0.0
        CanNmMsgCycleTime = 0.02
        CanNmMsgReducedTime = 0.01
        CanNmMsgTimeoutTime = 0.03
        CanNmNodeId = 0
        CanNmPduCbvPosition = CANNM_PDU_BYTE_1
        CanNmPduNidPosition = CANNM_PDU_BYTE_0
        CanNmRepeatMessageTime = 1.0
        CanNmTimeoutTime = 2.5
        CanNmWaitBusSleepTime = 1.5
        CanNmNodeDetectionEnabled = true
        CanNmNodeIdEnabled = true
        CanNmRepeatMsgIndEnabled = true
        CanNmComMNetworkHandleRef = ComMChannel_Can_Network_Channel
        CanNmRxPdu_NMm_CDU_Can_Network_CANNODE_0_CanIf2CanNm (CanNmRxPdu): CanNmRxPduRef=NMm_CDU_Can_Network_CANNODE_0_CanIf2CanNm
        CanNmTxPdu_NMm_BMS_Can_Network_CANNODE_0_CanNm2CanIf (CanNmTxPdu): CanNmTxPduRef=NMm_BMS_Can_Network_CANNODE_0_CanNm2CanIf
  module config ComM: implementation-config-variant=VARIANT-PRE-COMPILE
    ComMGeneral:
      ComMEcuGroupClassification = 0
      ComMModeLimitationEnabled = false
      ComMTMinFullComModeDuration = 0.01
      ComMVersionInfoApi = false
      ComMWakeupInhibitionEnabled = false
      ComMPncGatewayEnabled = false
      ComMPncSupport = false
      ComMResetAfterForcingNoComm = false
      ComMSynchronousWakeUp = false
      ComMRteEnabled = false
      ComMDevErrorDetect = false
    ComMConfigSet
      ComMUser_Can_Network_Channel (ComMUser)
      ComMChannel_Can_Network_Channel (ComMChannel):
        ComMMainFunctionPeriod = 0.01
        ComMFullCommRequestNotificationEnabled = false
        ComMNoCom = true
        ComMNoWakeUpInhibitionNvmStorage = false
        ComMNoWakeup = true
        ComMBusType = COMM_BUS_TYPE_CAN
        ComMNetworkManagement: ComMNmLightTimeout=10, ComMPncNmRequest=false, ComMNmVariant=FULL
        ComMUserPerChannel_Can_Network_Channel (ComMUserPerChannel): ComMUserChannel=ComMUser_Can_Network_Channel
  module config CanIf: implementation-config-variant=VARIANT-PRE-COMPILE
    CanIfInitCfg: CanIfInitCfgSet=0
      CanIfInitHohCfg
        Can_Network_CANNODE_0_Rx_Std_MailBox_1 (CanIfHrhCfg): CanIfHrhIdSymRef=Can_Network_CANNODE_0_Rx_Std_MailBox_1, CanIfHrhCanCtrlIdRef=Can_Network_CANNODE_0
        Can_Network_CANNODE_0_Rx_Std_MailBox_2 (CanIfHrhCfg): CanIfHrhIdSymRef=Can_Network_CANNODE_0_Rx_Std_MailBox_2, CanIfHrhCanCtrlIdRef=Can_Network_CANNODE_0
        Can_Network_CANNODE_0_Tx_Std_MailBox_1 (CanIfHthCfg): CanIfHthIdSymRef=Can_Network_CANNODE_0_Tx_Std_MailBox_1, CanIfHthCanCtrlIdRef=Can_Network_CANNODE_0
        Can_Network_CANNODE_0_Tx_Std_MailBox_2 (CanIfHthCfg): CanIfHthIdSymRef=Can_Network_CANNODE_0_Tx_Std_MailBox_2, CanIfHthCanCtrlIdRef=Can_Network_CANNODE_0
      NMm_CDU_Can_Network_CANNODE_0 (CanIfRxPduCfg):
        CanIfRxPduReadData = false
        CanIfRxPduReadNotifyStatus = true
        CanIfRxPduCanId = 1583
        CanIfRxPduCanIdType = STANDARD_CAN
        CanIfRxPduDlc = 8
        CanIfRxPduUserRxIndicationUL = CAN_NM
        CanIfRxPduHrhIdRef = Can_Network_CANNODE_0_Rx_Std_MailBox_1
        CanIfRxPduRef = NMm_CDU_Can_Network_CANNODE_0_CanIf2CanNm
      OBC_4_Can_Network_CANNODE_0 (CanIfRxPduCfg):
        CanIfRxPduReadData = false
        CanIfRxPduReadNotifyStatus = true
        CanIfRxPduCanId = 1084
        CanIfRxPduCanIdType = STANDARD_CAN
        CanIfRxPduDlc = 8
        CanIfRxPduUserRxIndicationName = PduR_CanIfRxIndication
        CanIfRxPduUserRxIndicationUL = PDUR
        CanIfRxPduHrhIdRef = Can_Network_CANNODE_0_Rx_Std_MailBox_2
        CanIfRxPduRef = PduCollection/OBC_4_Can_Network_CANNODE_0_CanIf2PduR
      Buffer_Can_Network_CANNODE_0_Tx_Std_MailBox_1 (CanIfBufferCfg): CanIfBufferSize=0, CanIfBufferHthRef=Can_Network_CANNODE_0_Tx_Std_MailBox_1
      BMS_Tem_5_Can_Network_CANNODE_0 (CanIfTxPduCfg):
        CanIfTxPduReadNotifyStatus = false
        CanIfTxPduType = STATIC
        CanIfTxPduTruncation = false
        CanIfTxPduCanIdType = STANDARD_CAN
        CanIfTxPduCanId = 1380
        CanIfTxPduUserTxConfirmationUL = PDUR
        CanIfTxPduBufferRef = Buffer_Can_Network_CANNODE_0_Tx_Std_MailBox_1
        CanIfTxPduRef = PduCollection/BMS_Tem_5_Can_Network_CANNODE_0_PduR2CanIf
      Buffer_Can_Network_CANNODE_0_Tx_Std_MailBox_2 (CanIfBufferCfg): CanIfBufferSize=0, CanIfBufferHthRef=Can_Network_CANNODE_0_Tx_Std_MailBox_2
      NMm_BMS_Can_Network_CANNODE_0 (CanIfTxPduCfg):
        CanIfTxPduReadNotifyStatus = false
        CanIfTxPduType = STATIC
        CanIfTxPduTruncation = false
        CanIfTxPduCanIdType = STANDARD_CAN
        CanIfTxPduCanId = 1551
        CanIfTxPduUserTxConfirmationUL = CAN_NM
        CanIfTxPduBufferRef = Buffer_Can_Network_CANNODE_0_Tx_Std_MailBox_2
        CanIfTxPduRef = NMm_BMS_Can_Network_CANNODE_0_CanNm2CanIf
    CanIfCtrlDrvCfg: CanIfRbCtrlDrvPrefix=CanConf_CanHardwareObject, CanIfCtrlDrvNameRef=CanGeneral, CanIfCtrlDrvInitHohConfigRef=CanIfInitHohCfg
      Can_Network_CANNODE_0 (CanIfCtrlCfg): CanIfCtrlWakeupSupport=false, CanIfCtrlCanCtrlRef=Can_Network_CANNODE_0
    CanIfDispatchCfg: CanIfDispatchUserCtrlBusOffUL=CAN_SM, CanIfDispatchUserCtrlModeIndicationUL=CAN_SM, CanIfDispatchUserTrcvModeIndicationName=CAN_SM
    CanIfPrivateCfg: CanIfPrivateDlcCheck=false
    CanIfPublicCfg:
      CanIfPublicReadRxPduDataApi = false
      CanIfPublicReadRxPduNotifyStatusApi = true
      CanIfPublicReadTxPduNotifyStatusApi = true
      CanIfPublicSetDynamicTxIdApi = false
      CanIfPublicTxBuffering = false
      CanIfPublicTxConfirmPollingSupport = false
      CanIfPublicVersionInfoApi = false
      CanIfPublicCancelTransmitSupport = false
      CanIfPublicErrorPassiveSupport = false
      CanIfPublicCanIfLiteConfiguration = false
      CanIfPublicUserTpTxInOfflineMode = false
      CanIfPublicWakeupCheckValidSupport = false
      CanIfPublicPnSupport = false
      CanIfPublicBusoffRecoveryfromRxIndication = false
      CanIfTriggerTransmitSupport = false
      CanIfTxOfflineActiveSupport = false
      CanIfWakeupSupport = false
      CanIfPublicDevErrorDetect = false
  module config CanSM: implementation-config-variant=VARIANT-PRE-COMPILE
    CanSMConfiguration: CanSMModeRequestRepetitionMax=5, CanSMModeRequestRepetitionTime=0.07
      CanSMManagerNetwork_Can_Network (CanSMManagerNetwork):
        CanSMBorTxConfirmationPolling = false
        CanSMBorCounterL1ToL2 = 0
        CanSMBorTimeL1 = 0.04
        CanSMBorTimeL2 = 0.1
        CanSMBorTimeTxEnsured = 0.02
        CanSMComMNetworkHandleRef = ComMChannel_Can_Network_Channel
        CanSMDemEventParameterRefs: CanSMRbDynCreate_CANSM_E_BUS_OFF=Standard
        CanSMController_Can_Network_CANNODE_0 (CanSMController): CanSMControllerId=Can_Network_CANNODE_0
    CanSMGeneral: CanSMMainFunctionTimePeriod=0.01, CanSMVersionInfoApi=false, CanSMDevErrorDetect=false
  module config PduR: implementation-config-variant=VARIANT-PRE-COMPILE
    PduRGeneral:
      PduRVersionInfoApi = false
      PduRZeroCostOperation = false
      PduRFifoTxBufferSupport = false
      PduRIFGatewayOperation = false
      PduRTPGatewayOperation = false
      PduRMemorySize = 0
      PduRMinimumRoutingLoRxPduId = 0
      PduRMinimumRoutingLoTxPduId = 0
      PduRMinimumRoutingUpRxPduId = 0
      PduRMinimumRoutingUpTxPduId = 0
      PduRMulticastFromIfSupport = false
      PduRMulticastFromTpSupport = false
      PduRMulticastToIfSupport = false
      PduRMulticastToTpSupport = false
      PduRSbTxBufferSupport = false
      PduRQueueingSupport = false
      PduRCanTpChangeParameterRequestApi = false
      PduRFrTpChangeParameterRequestApi = false
      PduRGwTpWithLimitedBuffer = false
      PduRDevErrorDetect = false
    PduRRoutingTables: PduRConfigurationId=0
      PduRRoutingTable
        OBC_4_Can_Network_CANNODE_0_CanIf2Com (PduRRoutingPath)
          OBC_4_Can_Network_CANNODE_0_CanIf2PduR (PduRSrcPdu): PduRSrcPduRef=PduCollection/OBC_4_Can_Network_CANNODE_0_CanIf2PduR
          OBC_4_Can_Network_CANNODE_0_PduR2Com (PduRDestPdu): PduRTransmissionConfirmation=false, PduRDestPduRef=PduCollection/OBC_4_Can_Network_CANNODE_0_PduR2Com
        BMS_Tem_5_Can_Network_CANNODE_0_Com2CanIf (PduRRoutingPath)
          BMS_Tem_5_Can_Network_CANNODE_0_Com2PduR (PduRSrcPdu): PduRSrcPduRef=PduCollection/BMS_Tem_5_Can_Network_CANNODE_0_Com2PduR
          BMS_Tem_5_Can_Network_CANNODE_0_PduR2CanIf (PduRDestPdu): PduRTransmissionConfirmation=false, PduRDestPduRef=PduCollection/BMS_Tem_5_Can_Network_CANNODE_0_PduR2CanIf
    3 x PduRBswModules, all with PduRCancelReceive=0, PduRCancelTransmit=0, PduRChangeParameterApi=0, PduRCommunicationInterface=1, PduRRetransmission=0, PduRUseTag=0:
      CanNm: PduRLowerModule=1, PduRTransportProtocol=0, PduRTriggertransmit=1, PduRTxConfirmation=1, PduRUpperModule=0, PduRBswModuleRef=CanNm
      CanIf: PduRLowerModule=1, PduRTransportProtocol=0, PduRTriggertransmit=0, PduRTxConfirmation=1, PduRUpperModule=0, PduRBswModuleRef=CanIf
      Com: PduRLowerModule=0, PduRTransportProtocol=1, PduRTriggertransmit=1, PduRTxConfirmation=0, PduRUpperModule=1, PduRBswModuleRef=Com
  module config EcuC: implementation-config-variant=VARIANT-PRE-COMPILE
    EcucConfigSet
      PduCollection (EcucPduCollection): PduIdTypeEnum=uint16, PduLengthTypeEnum=uint16
        6 x Pdu, all with PduLength=8:
          NMm_CDU_Can_Network_CANNODE_0_CanIf2CanNm
          OBC_4_Can_Network_CANNODE_0_CanIf2PduR
          OBC_4_Can_Network_CANNODE_0_PduR2Com
          BMS_Tem_5_Can_Network_CANNODE_0_Com2PduR
          BMS_Tem_5_Can_Network_CANNODE_0_PduR2CanIf
          NMm_BMS_Can_Network_CANNODE_0_CanNm2CanIf
    EcuCRbSettings: EcuCRbArRelease=AR42_Rev2, EcuCRbRteInUse=true
  module config Com: implementation-config-variant=VARIANT-PRE-COMPILE
    ComConfig_0 (ComConfig)
      ComTimeBase: ComGwTimeBase=0.005, ComRxTimeBase=0.01, ComTxTimeBase=0.01
      ComIPduGroup_Rx (ComIPduGroup)
      OBC_4_Can_Network_CANNODE_0 (ComIPdu):
        ComIPduSignalProcessing = IMMEDIATE
        ComIPduType = NORMAL
        ComIPduDirection = RECEIVE
        ComIPduGroupRef = ComIPduGroup_Rx
        ComPduIdRef = PduCollection/OBC_4_Can_Network_CANNODE_0_PduR2Com
        ComIPduSignalRef = OBC_ChargeSourceMode
        ComIPduSignalRef = OBC_FaultCode
        ComIPduSignalRef = OBC_MaxOutputVoltage
        ComIPduSignalRef = OBC_MaxOutputCurrent
      4 x ComSignal, all with ComSignalInitValue=0, ComSignalEndianness=BIG_ENDIAN, ComUpdateBitPosition=-1, ComTransferProperty=TRIGGERED:
        OBC_ChargeSourceMode: ComSignalType=UINT8, ComBitSize=2, ComBitPosition=53, ComSystemTemplateSystemSignalRef=OBC_ChargeSourceMode
        OBC_FaultCode: ComSignalType=UINT8, ComBitSize=8, ComBitPosition=39, ComSystemTemplateSystemSignalRef=OBC_FaultCode
        OBC_MaxOutputVoltage: ComSignalType=UINT16, ComBitSize=16, ComBitPosition=23, ComSystemTemplateSystemSignalRef=OBC_MaxOutputVoltage
        OBC_MaxOutputCurrent: ComSignalType=UINT16, ComBitSize=16, ComBitPosition=7, ComSystemTemplateSystemSignalRef=OBC_MaxOutputCurrent
      ComIPduGroup_Tx (ComIPduGroup)
      BMS_Tem_5_Can_Network_CANNODE_0 (ComIPdu):
        ComIPduSignalProcessing = IMMEDIATE
        ComIPduType = NORMAL
        ComIPduDirection = SEND
        ComFirstTimeout = 1.0
        ComTimeout = 1.0
        ComIPduGroupRef = ComIPduGroup_Tx
        ComPduIdRef = PduCollection/BMS_Tem_5_Can_Network_CANNODE_0_Com2PduR
        ComIPduSignalRef = BMS_BattTempSensorOrder40
        ComIPduSignalRef = BMS_BattTempSensorOrder39
        ComIPduSignalRef = BMS_BattTempSensorOrder38
        ComIPduSignalRef = BMS_BattTempSensorOrder37
        ComIPduSignalRef = BMS_BattTempSensorOrder36
        ComIPduSignalRef = BMS_BattTempSensorOrder35
        ComIPduSignalRef = BMS_BattTempSensorOrder34
        ComIPduSignalRef = BMS_BattTempSensorOrder33
        ComTxIPdu: ComMinimumDelayTime=0.0, ComTxIPduUnusedAreasDefault=255
          ComTxModeTrue
            ComTxMode: ComTxModeTimePeriod=1.0, ComTxModeMode=PERIODIC, ComTxModeNumberOfRepetitions=0, ComTxModeRepetitionPeriod=0, ComTxModeTimeOffset=0.0
          ComTxModeFalse
            ComTxMode: ComTxModeTimePeriod=1.0, ComTxModeMode=PERIODIC, ComTxModeNumberOfRepetitions=0, ComTxModeRepetitionPeriod=0, ComTxModeTimeOffset=0.0
      8 x ComSignal, all with ComSignalInitValue=0, ComSignalType=UINT8, ComSignalEndianness=BIG_ENDIAN, ComBitSize=8, ComUpdateBitPosition=-1, ComTransferProperty=TRIGGERED:
        BMS_BattTempSensorOrder40: ComBitPosition=63, ComSystemTemplateSystemSignalRef=BMS_BattTempSensorOrder40
        BMS_BattTempSensorOrder39: ComBitPosition=55, ComSystemTemplateSystemSignalRef=BMS_BattTempSensorOrder39
        BMS_BattTempSensorOrder38: ComBitPosition=47, ComSystemTemplateSystemSignalRef=BMS_BattTempSensorOrder38
        BMS_BattTempSensorOrder37: ComBitPosition=39, ComSystemTemplateSystemSignalRef=BMS_BattTempSensorOrder37
        BMS_BattTempSensorOrder36: ComBitPosition=31, ComSystemTemplateSystemSignalRef=BMS_BattTempSensorOrder36
        BMS_BattTempSensorOrder35: ComBitPosition=23, ComSystemTemplateSystemSignalRef=BMS_BattTempSensorOrder35
        BMS_BattTempSensorOrder34: ComBitPosition=15, ComSystemTemplateSystemSignalRef=BMS_BattTempSensorOrder34
        BMS_BattTempSensorOrder33: ComBitPosition=7, ComSystemTemplateSystemSignalRef=BMS_BattTempSensorOrder33
    ComGeneral:
      ComVersionInfoApi = false
      ComCommonIPduTxPeriodFeature = false
      ComEnableJitterFilter = false
      ComEnableSignalGroupArrayApi = false
      ComCancellationSupport = false
      ComConfigurationUseDet = false
  module config Nm: implementation-config-variant=VARIANT-PRE-COMPILE
    NmGlobalConfig
      NmGlobalConstants: NmNumberOfChannels=1, NmRemoteSleepCancelCallback=TestNm_RemoteSleepCancellation, NmRemoteSleepIndCallback=TestNm_RemoteSleepIndication
      NmGlobalProperties: NmVersionInfoApi=true, NmCycletimeMainFunction=0.01, NmDevErrorDetect=false
      NmGlobalFeatures:
        NmCarWakeUpRxEnabled = false
        NmComUserDataSupport = false
        NmCoordinatorSupportEnabled = false
        NmBusSynchronizationEnabled = false
        NmComControlEnabled = true
        NmCoordinatorSyncSupport = false
        NmNodeDetectionEnabled = false
        NmNodeIdEnabled = false
        NmPassiveModeEnabled = false
        NmPduRxIndicationEnabled = false
        NmRemoteSleepIndEnabled = false
        NmRepeatMsgIndEnabled = true
        NmUserDataEnabled = true
        NmStateChangeIndEnabled = true
    NmChannelConfig_Can_Network_Channel (NmChannelConfig):
      NmChannelSleepMaster = false
      NmStateReportEnabled = false
      NmSynchronizingNetwork = false
      NmShutdownDelayTimer = 0.0
      NmNodeIdEnabled = true
      NmNodeDetectionEnabled = true
      NmRepeatMsgIndEnabled = true
      NmComMChannelRef = ComMChannel_Can_Network_Channel
      NmBusType
        NmStandardBusNmConfig: NmStandardBusType=NM_BUSNM_CANNM
