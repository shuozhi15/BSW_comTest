[part 1 of 2: package /ETAS_Project/EcucModuleConfigurationValuess]
AUTOSAR XML (schema 4-2-2)
package /ETAS_Project/EcucModuleConfigurationValuess
  module config ComM: implementation-config-variant=VARIANT-PRE-COMPILE
    ComMGeneral:
      ComMEcuGroupClassification = 0
      ComMModeLimitationEnabled = false
      ComMTMinFullComModeDuration = 0.01
      ComMVersionInfoApi = false
      ComMWakeupInhibitionEnabled = false
      ComMPncGatewayEnabled = false
      ComMPncSupport = false
      ComMResetAfterForcingNoComm = false
      ComMSynchronousWakeUp = false
      ComMRteEnabled = false
      ComMDevErrorDetect = false
    ComMConfigSet
      ComMUser_Can_Network_Channel (ComMUser)
      ComMChannel_Can_Network_Channel (ComMChannel):
        ComMMainFunctionPeriod = 0.01
        ComMFullCommRequestNotificationEnabled = false
        ComMNoCom = true
        ComMNoWakeUpInhibitionNvmStorage = false
        ComMNoWakeup = true
        ComMBusType = COMM_BUS_TYPE_CAN
        ComMNetworkManagement: ComMNmLightTimeout=10, ComMNmVariant=NONE, ComMPncNmRequest=false
        ComMUserPerChannel_Can_Network_Channel (ComMUserPerChannel): ComMUserChannel=ComMUser_Can_Network_Channel
  module config CanIf: implementation-config-variant=VARIANT-PRE-COMPILE
    CanIfInitCfg: CanIfInitCfgSet=0
      CanIfInitHohCfg
        25 x CanIfHrhCfg, all with CanIfHrhCanCtrlIdRef=Can_Network_CANNODE_0:
          Can_Network_CANNODE_0_Rx_Std_MailBox_{1..25}: CanIfHrhIdSymRef=Can_Network_CANNODE_0_Rx_Std_MailBox_{1..25}
        56 x CanIfHthCfg, all with CanIfHthCanCtrlIdRef=Can_Network_CANNODE_0:
          Can_Network_CANNODE_0_Tx_Std_MailBox_{1..56}: CanIfHthIdSymRef=Can_Network_CANNODE_0_Tx_Std_MailBox_{1..56}
      25 x CanIfRxPduCfg, all with CanIfRxPduReadData=false, CanIfRxPduReadNotifyStatus=true, CanIfRxPduCanIdType=STANDARD_CAN:
        TMR_3_Can_Network_CANNODE_0: CanIfRxPduCanId=808, CanIfRxPduDlc=8, CanIfRxPduUserRxIndicationName=PduR_CanIfRxIndication, CanIfRxPduUserRxIndicationUL=PDUR, CanIfRxPduHrhIdRef=Can_Network_CANNODE_0_Rx_Std_MailBox_1, CanIfRxPduRef=PduCollection/TMR_3_Can_Network_CANNODE_0_CanIf2PduR
        EMS_4_G_Can_Network_CANNODE_0: CanIfRxPduCanId=1241, CanIfRxPduDlc=8, CanIfRxPduUserRxIndicationName=PduR_CanIfRxIndication, CanIfRxPduUserRxIndicationUL=PDUR, CanIfRxPduHrhIdRef=Can_Network_CANNODE_0_Rx_Std_MailBox_2, CanIfRxPduRef=PduCollection/EMS_4_G_Can_Network_CANNODE_0_CanIf2PduR
        OBC_2_Can_Network_CANNODE_0: CanIfRxPduCanId=1064, CanIfRxPduDlc=8, CanIfRxPduUserRxIndicationName=PduR_CanIfRxIndication, CanIfRxPduUserRxIndicationUL=PDUR, CanIfRxPduHrhIdRef=Can_Network_CANNODE_0_Rx_Std_MailBox_3, CanIfRxPduRef=PduCollection/OBC_2_Can_Network_CANNODE_0_CanIf2PduR
        OBC_4_Can_Network_CANNODE_0: CanIfRxPduCanId=1084, CanIfRxPduDlc=8, CanIfRxPduUserRxIndicationName=PduR_CanIfRxIndication, CanIfRxPduUserRxIndicationUL=PDUR, CanIfRxPduHrhIdRef=Can_Network_CANNODE_0_Rx_Std_MailBox_4, CanIfRxPduRef=PduCollection/OBC_4_Can_Network_CANNODE_0_CanIf2PduR
        ABS_ESP_G_Can_Network_CANNODE_0: CanIfRxPduCanId=1282, CanIfRxPduDlc=7, CanIfRxPduUserRxIndicationName=PduR_CanIfRxIndication, CanIfRxPduUserRxIndicationUL=PDUR, CanIfRxPduHrhIdRef=Can_Network_CANNODE_0_Rx_Std_MailBox_5, CanIfRxPduRef=PduCollection/ABS_ESP_G_Can_Network_CANNODE_0_CanIf2PduR
        TMR_1_Can_Network_CANNODE_0: CanIfRxPduCanId=371, CanIfRxPduDlc=8, CanIfRxPduUserRxIndicationName=PduR_CanIfRxIndication, CanIfRxPduUserRxIndicationUL=PDUR, CanIfRxPduHrhIdRef=Can_Network_CANNODE_0_Rx_Std_MailBox_6, CanIfRxPduRef=PduCollection/TMR_1_Can_Network_CANNODE_0_CanIf2PduR
        OBC_1_Can_Network_CANNODE_0: CanIfRxPduCanId=1061, CanIfRxPduDlc=8, CanIfRxPduUserRxIndicationName=PduR_CanIfRxIndication, CanIfRxPduUserRxIndicationUL=PDUR, CanIfRxPduHrhIdRef=Can_Network_CANNODE_0_Rx_Std_MailBox_7, CanIfRxPduRef=PduCollection/OBC_1_Can_Network_CANNODE_0_CanIf2PduR
        TMF_3_Can_Network_CANNODE_0: CanIfRxPduCanId=795, CanIfRxPduDlc=8, CanIfRxPduUserRxIndicationName=PduR_CanIfRxIndication, CanIfRxPduUserRxIndicationUL=PDUR, CanIfRxPduHrhIdRef=Can_Network_CANNODE_0_Rx_Std_MailBox_8, CanIfRxPduRef=PduCollection/TMF_3_Can_Network_CANNODE_0_CanIf2PduR
        EMS_28_Can_Network_CANNODE_0: CanIfRxPduCanId=1213, CanIfRxPduDlc=8, CanIfRxPduUserRxIndicationName=PduR_CanIfRxIndication, CanIfRxPduUserRxIndicationUL=PDUR, CanIfRxPduHrhIdRef=Can_Network_CANNODE_0_Rx_Std_MailBox_9, CanIfRxPduRef=PduCollection/EMS_28_Can_Network_CANNODE_0_CanIf2PduR
        CLM_2_Can_Network_CANNODE_0: CanIfRxPduCanId=1333, CanIfRxPduDlc=8, CanIfRxPduUserRxIndicationName=PduR_CanIfRxIndication, CanIfRxPduUserRxIndicationUL=PDUR, CanIfRxPduHrhIdRef=Can_Network_CANNODE_0_Rx_Std_MailBox_10, CanIfRxPduRef=PduCollection/CLM_2_Can_Network_CANNODE_0_CanIf2PduR
        HCU_1_G_Can_Network_CANNODE_0: CanIfRxPduCanId=1034, CanIfRxPduDlc=8, CanIfRxPduUserRxIndicationName=PduR_CanIfRxIndication, CanIfRxPduUserRxIndicationUL=PDUR, CanIfRxPduHrhIdRef=Can_Network_CANNODE_0_Rx_Std_MailBox_11, CanIfRxPduRef=PduCollection/HCU_1_G_Can_Network_CANNODE_0_CanIf2PduR
        TBOX_3_Can_Network_CANNODE_0: CanIfRxPduCanId=856, CanIfRxPduDlc=8, CanIfRxPduUserRxIndicationName=PduR_CanIfRxIndication, CanIfRxPduUserRxIndicationUL=PDUR, CanIfRxPduHrhIdRef=Can_Network_CANNODE_0_Rx_Std_MailBox_12, CanIfRxPduRef=PduCollection/TBOX_3_Can_Network_CANNODE_0_CanIf2PduR
        DCDC_2_Can_Network_CANNODE_0: CanIfRxPduCanId=1054, CanIfRxPduDlc=8, CanIfRxPduUserRxIndicationName=PduR_CanIfRxIndication, CanIfRxPduUserRxIndicationUL=PDUR, CanIfRxPduHrhIdRef=Can_Network_CANNODE_0_Rx_Std_MailBox_13, CanIfRxPduRef=PduCollection/DCDC_2_Can_Network_CANNODE_0_CanIf2PduR
        Diag_BMS_REQ_Can_Network_CANNODE_0: CanIfRxPduCanId=2021, CanIfRxPduDlc=1, CanIfRxPduUserRxIndicationUL=CAN_TP, CanIfRxPduHrhIdRef=Can_Network_CANNODE_0_Rx_Std_MailBox_14, CanIfRxPduRef=Diag_BMS_REQ_Can_Network_CANNODE_0_CanIf2CanTp
        ICM_1_Can_Network_CANNODE_0: CanIfRxPduCanId=1072, CanIfRxPduDlc=8, CanIfRxPduUserRxIndicationName=PduR_CanIfRxIndication, CanIfRxPduUserRxIndicationUL=PDUR, CanIfRxPduHrhIdRef=Can_Network_CANNODE_0_Rx_Std_MailBox_15, CanIfRxPduRef=PduCollection/ICM_1_Can_Network_CANNODE_0_CanIf2PduR
        HCU_7_Can_Network_CANNODE_0: CanIfRxPduCanId=264, CanIfRxPduDlc=8, CanIfRxPduUserRxIndicationName=PduR_CanIfRxIndication, CanIfRxPduUserRxIndicationUL=PDUR, CanIfRxPduHrhIdRef=Can_Network_CANNODE_0_Rx_Std_MailBox_16, CanIfRxPduRef=PduCollection/HCU_7_Can_Network_CANNODE_0_CanIf2PduR
        EMS_1_G_Can_Network_CANNODE_0: CanIfRxPduCanId=640, CanIfRxPduDlc=8, CanIfRxPduUserRxIndicationName=PduR_CanIfRxIndication, CanIfRxPduUserRxIndicationUL=PDUR, CanIfRxPduHrhIdRef=Can_Network_CANNODE_0_Rx_Std_MailBox_17, CanIfRxPduRef=PduCollection/EMS_1_G_Can_Network_CANNODE_0_CanIf2PduR
        DCDC_1_Can_Network_CANNODE_0: CanIfRxPduCanId=1048, CanIfRxPduDlc=8, CanIfRxPduUserRxIndicationName=PduR_CanIfRxIndication, CanIfRxPduUserRxIndicationUL=PDUR, CanIfRxPduHrhIdRef=Can_Network_CANNODE_0_Rx_Std_MailBox_18, CanIfRxPduRef=PduCollection/DCDC_1_Can_Network_CANNODE_0_CanIf2PduR
        DIAG_OBD_REQ_Broadcast_Can_Network_CANNODE_0: CanIfRxPduCanId=2015, CanIfRxPduDlc=1, CanIfRxPduUserRxIndicationUL=CAN_TP, CanIfRxPduHrhIdRef=Can_Network_CANNODE_0_Rx_Std_MailBox_19, CanIfRxPduRef=DIAG_OBD_REQ_Broadcast_Can_Network_CANNODE_0_CanIf2CanTp
        ISGF_3_Can_Network_CANNODE_0: CanIfRxPduCanId=786, CanIfRxPduDlc=8, CanIfRxPduUserRxIndicationName=PduR_CanIfRxIndication, CanIfRxPduUserRxIndicationUL=PDUR, CanIfRxPduHrhIdRef=Can_Network_CANNODE_0_Rx_Std_MailBox_20, CanIfRxPduRef=PduCollection/ISGF_3_Can_Network_CANNODE_0_CanIf2PduR
        TBOX_2_Can_Network_CANNODE_0: CanIfRxPduCanId=1266, CanIfRxPduDlc=8, CanIfRxPduUserRxIndicationName=PduR_CanIfRxIndication, CanIfRxPduUserRxIndicationUL=PDUR, CanIfRxPduHrhIdRef=Can_Network_CANNODE_0_Rx_Std_MailBox_21, CanIfRxPduRef=PduCollection/TBOX_2_Can_Network_CANNODE_0_CanIf2PduR
        ISGF_1_Can_Network_CANNODE_0: CanIfRxPduCanId=326, CanIfRxPduDlc=8, CanIfRxPduUserRxIndicationName=PduR_CanIfRxIndication, CanIfRxPduUserRxIndicationUL=PDUR, CanIfRxPduHrhIdRef=Can_Network_CANNODE_0_Rx_Std_MailBox_22, CanIfRxPduRef=PduCollection/ISGF_1_Can_Network_CANNODE_0_CanIf2PduR
        OBC_3_Can_Network_CANNODE_0: CanIfRxPduCanId=1067, CanIfRxPduDlc=8, CanIfRxPduUserRxIndicationName=PduR_CanIfRxIndication, CanIfRxPduUserRxIndicationUL=PDUR, CanIfRxPduHrhIdRef=Can_Network_CANNODE_0_Rx_Std_MailBox_23, CanIfRxPduRef=PduCollection/OBC_3_Can_Network_CANNODE_0_CanIf2PduR
        TMF_1_Can_Network_CANNODE_0: CanIfRxPduCanId=348, CanIfRxPduDlc=8, CanIfRxPduUserRxIndicationName=PduR_CanIfRxIndication, CanIfRxPduUserRxIndicationUL=PDUR, CanIfRxPduHrhIdRef=Can_Network_CANNODE_0_Rx_Std_MailBox_24, CanIfRxPduRef=PduCollection/TMF_1_Can_Network_CANNODE_0_CanIf2PduR
        ABM_1_Can_Network_CANNODE_0: CanIfRxPduCanId=800, CanIfRxPduDlc=4, CanIfRxPduUserRxIndicationName=PduR_CanIfRxIndication, CanIfRxPduUserRxIndicationUL=PDUR, CanIfRxPduHrhIdRef=Can_Network_CANNODE_0_Rx_Std_MailBox_25, CanIfRxPduRef=PduCollection/ABM_1_Can_Network_CANNODE_0_CanIf2PduR
      Buffer_Can_Network_CANNODE_0_Tx_Std_MailBox_1 (CanIfBufferCfg): CanIfBufferSize=0, CanIfBufferHthRef=Can_Network_CANNODE_0_Tx_Std_MailBox_1
      BMS_24_Can_Network_CANNODE_0 (CanIfTxPduCfg):
        CanIfTxPduReadNotifyStatus = false
        CanIfTxPduType = STATIC
        CanIfTxPduTruncation = false
        CanIfTxPduCanIdType = STANDARD_CAN
        CanIfTxPduCanId = 1183
        CanIfTxPduUserTxConfirmationUL = PDUR
        CanIfTxPduBufferRef = Buffer_Can_Network_CANNODE_0_Tx_Std_MailBox_1
        CanIfTxPduRef = PduCollection/BMS_24_Can_Network_CANNODE_0_PduR2CanIf
      Buffer_Can_Network_CANNODE_0_Tx_Std_MailBox_2 (CanIfBufferCfg): CanIfBufferSize=0, CanIfBufferHthRef=Can_Network_CANNODE_0_Tx_Std_MailBox_2
      BMS_Tem_6_Can_Network_CANNODE_0 (CanIfTxPduCfg):
        CanIfTxPduReadNotifyStatus = false
        CanIfTxPduType = STATIC
        CanIfTxPduTruncation = false
        CanIfTxPduCanIdType = STANDARD_CAN
        CanIfTxPduCanId = 1381
        CanIfTxPduUserTxConfirmationUL = PDUR
        CanIfTxPduBufferRef = Buffer_Can_Network_CANNODE_0_Tx_Std_MailBox_2
        CanIfTxPduRef = PduCollection/BMS_Tem_6_Can_Network_CANNODE_0_PduR2CanIf
      Buffer_Can_Network_CANNODE_0_Tx_Std_MailBox_3 (CanIfBufferCfg): CanIfBufferSize=0, CanIfBufferHthRef=Can_Network_CANNODE_0_Tx_Std_MailBox_3
      BMS_Tem_5_Can_Network_CANNODE_0 (CanIfTxPduCfg):
        CanIfTxPduReadNotifyStatus = false
        CanIfTxPduType = STATIC
        CanIfTxPduTruncation = false
        CanIfTxPduCanIdType = STANDARD_CAN
        CanIfTxPduCanId = 1380
        CanIfTxPduUserTxConfirmationUL = PDUR
        CanIfTxPduBufferRef = Buffer_Can_Network_CANNODE_0_Tx_Std_MailBox_3
        CanIfTxPduRef = PduCollection/BMS_Tem_5_Can_Network_CANNODE_0_PduR2CanIf
      Buffer_Can_Network_CANNODE_0_Tx_Std_MailBox_4 (CanIfBufferCfg): CanIfBufferSize=0, CanIfBufferHthRef=Can_Network_CANNODE_0_Tx_Std_MailBox_4
      BMS_19_Can_Network_CANNODE_0 (CanIfTxPduCfg):
        CanIfTxPduReadNotifyStatus = false
        CanIfTxPduType = STATIC
        CanIfTxPduTruncation = false
        CanIfTxPduCanIdType = STANDARD_CAN
        CanIfTxPduCanId = 1458
        CanIfTxPduUserTxConfirmationUL = PDUR
        CanIfTxPduBufferRef = Buffer_Can_Network_CANNODE_0_Tx_Std_MailBox_4
        CanIfTxPduRef = PduCollection/BMS_19_Can_Network_CANNODE_0_PduR2CanIf
      Buffer_Can_Network_CANNODE_0_Tx_Std_MailBox_5 (CanIfBufferCfg): CanIfBufferSize=0, CanIfBufferHthRef=Can_Network_CANNODE_0_Tx_Std_MailBox_5
      Diag_BMS_RES_Can_Network_CANNODE_0 (CanIfTxPduCfg):
        CanIfTxPduReadNotifyStatus = false
        CanIfTxPduType = STATIC
        CanIfTxPduTruncation = false
        CanIfTxPduCanIdType = STANDARD_CAN
        CanIfTxPduCanId = 2029
        CanIfTxPduUserTxConfirmationUL = CAN_TP
        CanIfTxPduBufferRef = Buffer_Can_Network_CANNODE_0_Tx_Std_MailBox_5
        CanIfTxPduRef = Diag_BMS_RES_Can_Network_CANNODE_0_Phys_CanTp2CanIf
      Buffer_Can_Network_CANNODE_0_Tx_Std_MailBox_6 (CanIfBufferCfg): CanIfBufferSize=0, CanIfBufferHthRef=Can_Network_CANNODE_0_Tx_Std_MailBox_6
      BMS_18_Can_Network_CANNODE_0 (CanIfTxPduCfg):
        CanIfTxPduReadNotifyStatus = false
        CanIfTxPduType = STATIC
        CanIfTxPduTruncation = false
        CanIfTxPduCanIdType = STANDARD_CAN
        CanIfTxPduCanId = 1457
        CanIfTxPduUserTxConfirmationUL = PDUR
        CanIfTxPduBufferRef = Buffer_Can_Network_CANNODE_0_Tx_Std_MailBox_6
        CanIfTxPduRef = PduCollection/BMS_18_Can_Network_CANNODE_0_PduR2CanIf
      Buffer_Can_Network_CANNODE_0_Tx_Std_MailBox_7 (CanIfBufferCfg): CanIfBufferSize=0, CanIfBufferHthRef=Can_Network_CANNODE_0_Tx_Std_MailBox_7
      BMS_17_Can_Network_CANNODE_0 (CanIfTxPduCfg):
        CanIfTxPduReadNotifyStatus = false
        CanIfTxPduType = STATIC
        CanIfTxPduTruncation = false
        CanIfTxPduCanIdType = STANDARD_CAN
        CanIfTxPduCanId = 1456
        CanIfTxPduUserTxConfirmationUL = PDUR
        CanIfTxPduBufferRef = Buffer_Can_Network_CANNODE_0_Tx_Std_MailBox_7
        CanIfTxPduRef = PduCollection/BMS_17_Can_Network_CANNODE_0_PduR2CanIf
      Buffer_Can_Network_CANNODE_0_Tx_Std_MailBox_8 (CanIfBufferCfg): CanIfBufferSize=0, CanIfBufferHthRef=Can_Network_CANNODE_0_Tx_Std_MailBox_8
      BMS_Tem_4_Can_Network_CANNODE_0 (CanIfTxPduCfg):
        CanIfTxPduReadNotifyStatus = false
        CanIfTxPduType = STATIC
        CanIfTxPduTruncation = false
        CanIfTxPduCanIdType = STANDARD_CAN
        CanIfTxPduCanId = 1379
        CanIfTxPduUserTxConfirmationUL = PDUR
        CanIfTxPduBufferRef = Buffer_Can_Network_CANNODE_0_Tx_Std_MailBox_8
        CanIfTxPduRef = PduCollection/BMS_Tem_4_Can_Network_CANNODE_0_PduR2CanIf
      Buffer_Can_Network_CANNODE_0_Tx_Std_MailBox_9 (CanIfBufferCfg): CanIfBufferSize=0, CanIfBufferHthRef=Can_Network_CANNODE_0_Tx_Std_MailBox_9
      BMS_Tem_3_Can_Network_CANNODE_0 (CanIfTxPduCfg):
        CanIfTxPduReadNotifyStatus = false
        CanIfTxPduType = STATIC
        CanIfTxPduTruncation = false
        CanIfTxPduCanIdType = STANDARD_CAN
        CanIfTxPduCanId = 1378
        CanIfTxPduUserTxConfirmationUL = PDUR
        CanIfTxPduBufferRef = Buffer_Can_Network_CANNODE_0_Tx_Std_MailBox_9
        CanIfTxPduRef = PduCollection/BMS_Tem_3_Can_Network_CANNODE_0_PduR2CanIf
      Buffer_Can_Network_CANNODE_0_Tx_Std_MailBox_10 (CanIfBufferCfg): CanIfBufferSize=0, CanIfBufferHthRef=Can_Network_CANNODE_0_Tx_Std_MailBox_10
      BMS_16_Can_Network_CANNODE_0 (CanIfTxPduCfg):
        CanIfTxPduReadNotifyStatus = false
        CanIfTxPduType = STATIC
        CanIfTxPduTruncation = false
        CanIfTxPduCanIdType = STANDARD_CAN
        CanIfTxPduCanId = 1454
        CanIfTxPduUserTxConfirmationUL = PDUR
        CanIfTxPduBufferRef = Buffer_Can_Network_CANNODE_0_Tx_Std_MailBox_10
        CanIfTxPduRef = PduCollection/BMS_16_Can_Network_CANNODE_0_PduR2CanIf
      Buffer_Can_Network_CANNODE_0_Tx_Std_MailBox_11 (CanIfBufferCfg): CanIfBufferSize=0, CanIfBufferHthRef=Can_Network_CANNODE_0_Tx_Std_MailBox_11
      BMS_Tem_2_Can_Network_CANNODE_0 (CanIfTxPduCfg):
        CanIfTxPduReadNotifyStatus = false
        CanIfTxPduType = STATIC
        CanIfTxPduTruncation = false
        CanIfTxPduCanIdType = STANDARD_CAN
        CanIfTxPduCanId = 1377
        CanIfTxPduUserTxConfirmationUL = PDUR
        CanIfTxPduBufferRef = Buffer_Can_Network_CANNODE_0_Tx_Std_MailBox_11
        CanIfTxPduRef = PduCollection/BMS_Tem_2_Can_Network_CANNODE_0_PduR2CanIf
      Buffer_Can_Network_CANNODE_0_Tx_Std_MailBox_12 (CanIfBufferCfg): CanIfBufferSize=0, CanIfBufferHthRef=Can_Network_CANNODE_0_Tx_Std_MailBox_12
      BMS_15_Can_Network_CANNODE_0 (CanIfTxPduCfg):
        CanIfTxPduReadNotifyStatus = false
        CanIfTxPduType = STATIC
        CanIfTxPduTruncation = false
        CanIfTxPduCanIdType = STANDARD_CAN
        CanIfTxPduCanId = 1453
        CanIfTxPduUserTxConfirmationUL = PDUR
        CanIfTxPduBufferRef = Buffer_Can_Network_CANNODE_0_Tx_Std_MailBox_12
        CanIfTxPduRef = PduCollection/BMS_15_Can_Network_CANNODE_0_PduR2CanIf
      Buffer_Can_Network_CANNODE_0_Tx_Std_MailBox_13 (CanIfBufferCfg): CanIfBufferSize=0, CanIfBufferHthRef=Can_Network_CANNODE_0_Tx_Std_MailBox_13
      BMS_Tem_1_Can_Network_CANNODE_0 (CanIfTxPduCfg):
        CanIfTxPduReadNotifyStatus = false
        CanIfTxPduType = STATIC
        CanIfTxPduTruncation = false
        CanIfTxPduCanIdType = STANDARD_CAN
        CanIfTxPduCanId = 1376
        CanIfTxPduUserTxConfirmationUL = PDUR
        CanIfTxPduBufferRef = Buffer_Can_Network_CANNODE_0_Tx_Std_MailBox_13
        CanIfTxPduRef = PduCollection/BMS_Tem_1_Can_Network_CANNODE_0_PduR2CanIf
      Buffer_Can_Network_CANNODE_0_Tx_Std_MailBox_14 (CanIfBufferCfg): CanIfBufferSize=0, CanIfBufferHthRef=Can_Network_CANNODE_0_Tx_Std_MailBox_14
      BMS_14_Can_Network_CANNODE_0 (CanIfTxPduCfg):
        CanIfTxPduReadNotifyStatus = false
        CanIfTxPduType = STATIC
        CanIfTxPduTruncation = false
        CanIfTxPduCanIdType = STANDARD_CAN
        CanIfTxPduCanId = 1452
        CanIfTxPduUserTxConfirmationUL = PDUR
        CanIfTxPduBufferRef = Buffer_Can_Network_CANNODE_0_Tx_Std_MailBox_14
        CanIfTxPduRef = PduCollection/BMS_14_Can_Network_CANNODE_0_PduR2CanIf
      Buffer_Can_Network_CANNODE_0_Tx_Std_MailBox_15 (CanIfBufferCfg): CanIfBufferSize=0, CanIfBufferHthRef=Can_Network_CANNODE_0_Tx_Std_MailBox_15
      BMS_Vol_9_Can_Network_CANNODE_0 (CanIfTxPduCfg):
        CanIfTxPduReadNotifyStatus = false
        CanIfTxPduType = STATIC
        CanIfTxPduTruncation = false
        CanIfTxPduCanIdType = STANDARD_CAN
        CanIfTxPduCanId = 1352
        CanIfTxPduUserTxConfirmationUL = PDUR
        CanIfTxPduBufferRef = Buffer_Can_Network_CANNODE_0_Tx_Std_MailBox_15
        CanIfTxPduRef = PduCollection/BMS_Vol_9_Can_Network_CANNODE_0_PduR2CanIf
      Buffer_Can_Network_CANNODE_0_Tx_Std_MailBox_16 (CanIfBufferCfg): CanIfBufferSize=0, CanIfBufferHthRef=Can_Network_CANNODE_0_Tx_Std_MailBox_16
      BMS_21_Can_Network_CANNODE_0 (CanIfTxPduCfg):
        CanIfTxPduReadNotifyStatus = false
        CanIfTxPduType = STATIC
        CanIfTxPduTruncation = false
        CanIfTxPduCanIdType = STANDARD_CAN
        CanIfTxPduCanId = 1473
        CanIfTxPduUserTxConfirmationUL = PDUR
        CanIfTxPduBufferRef = Buffer_Can_Network_CANNODE_0_Tx_Std_MailBox_16
        CanIfTxPduRef = PduCollection/BMS_21_Can_Network_CANNODE_0_PduR2CanIf
      Buffer_Can_Network_CANNODE_0_Tx_Std_MailBox_17 (CanIfBufferCfg): CanIfBufferSize=0, CanIfBufferHthRef=Can_Network_CANNODE_0_Tx_Std_MailBox_17
      BMS_Vol_8_Can_Network_CANNODE_0 (CanIfTxPduCfg):
        CanIfTxPduReadNotifyStatus = false
        CanIfTxPduType = STATIC
        CanIfTxPduTruncation = false
        CanIfTxPduCanIdType = STANDARD_CAN
        CanIfTxPduCanId = 1351
        CanIfTxPduUserTxConfirmationUL = PDUR
        CanIfTxPduBufferRef = Buffer_Can_Network_CANNODE_0_Tx_Std_MailBox_17
        CanIfTxPduRef = PduCollection/BMS_Vol_8_Can_Network_CANNODE_0_PduR2CanIf
      Buffer_Can_Network_CANNODE_0_Tx_Std_MailBox_18 (CanIfBufferCfg): CanIfBufferSize=0, CanIfBufferHthRef=Can_Network_CANNODE_0_Tx_Std_MailBox_18
      BMS_20_Can_Network_CANNODE_0 (CanIfTxPduCfg):
        CanIfTxPduReadNotifyStatus = false
        CanIfTxPduType = STATIC
        CanIfTxPduTruncation = false
        CanIfTxPduCanIdType = STANDARD_CAN
        CanIfTxPduCanId = 1472
        CanIfTxPduUserTxConfirmationUL = PDUR
        CanIfTxPduBufferRef = Buffer_Can_Network_CANNODE_0_Tx_Std_MailBox_18
        CanIfTxPduRef = PduCollection/BMS_20_Can_Network_CANNODE_0_PduR2CanIf
      Buffer_Can_Network_CANNODE_0_Tx_Std_MailBox_19 (CanIfBufferCfg): CanIfBufferSize=0, CanIfBufferHthRef=Can_Network_CANNODE_0_Tx_Std_MailBox_19
      BMS_Vol_7_Can_Network_CANNODE_0 (CanIfTxPduCfg):
        CanIfTxPduReadNotifyStatus = false
        CanIfTxPduType = STATIC
        CanIfTxPduTruncation = false
        CanIfTxPduCanIdType = STANDARD_CAN
        CanIfTxPduCanId = 1350
        CanIfTxPduUserTxConfirmationUL = PDUR
        CanIfTxPduBufferRef = Buffer_Can_Network_CANNODE_0_Tx_Std_MailBox_19
        CanIfTxPduRef = PduCollection/BMS_Vol_7_Can_Network_CANNODE_0_PduR2CanIf
      Buffer_Can_Network_CANNODE_0_Tx_Std_MailBox_20 (CanIfBufferCfg): CanIfBufferSize=0, CanIfBufferHthRef=Can_Network_CANNODE_0_Tx_Std_MailBox_20
      BMS_Vol_6_Can_Network_CANNODE_0 (CanIfTxPduCfg):
        CanIfTxPduReadNotifyStatus = false
        CanIfTxPduType = STATIC
        CanIfTxPduTruncation = false
        CanIfTxPduCanIdType = STANDARD_CAN
        CanIfTxPduCanId = 1349
        CanIfTxPduUserTxConfirmationUL = PDUR
        CanIfTxPduBufferRef = Buffer_Can_Network_CANNODE_0_Tx_Std_MailBox_20
        CanIfTxPduRef = PduCollection/BMS_Vol_6_Can_Network_CANNODE_0_PduR2CanIf
      Buffer_Can_Network_CANNODE_0_Tx_Std_MailBox_21 (CanIfBufferCfg): CanIfBufferSize=0, CanIfBufferHthRef=Can_Network_CANNODE_0_Tx_Std_MailBox_21
      BMS_Vol_5_Can_Network_CANNODE_0 (CanIfTxPduCfg):
        CanIfTxPduReadNotifyStatus = false
        CanIfTxPduType = STATIC
        CanIfTxPduTruncation = false
        CanIfTxPduCanIdType = STANDARD_CAN
        CanIfTxPduCanId = 1348
        CanIfTxPduUserTxConfirmationUL = PDUR
        CanIfTxPduBufferRef = Buffer_Can_Network_CANNODE_0_Tx_Std_MailBox_21
        CanIfTxPduRef = PduCollection/BMS_Vol_5_Can_Network_CANNODE_0_PduR2CanIf
      Buffer_Can_Network_CANNODE_0_Tx_Std_MailBox_22 (CanIfBufferCfg): CanIfBufferSize=0, CanIfBufferHthRef=Can_Network_CANNODE_0_Tx_Std_MailBox_22
      BMS_Vol_4_Can_Network_CANNODE_0 (CanIfTxPduCfg):
        CanIfTxPduReadNotifyStatus = false
        CanIfTxPduType = STATIC
        CanIfTxPduTruncation = false
        CanIfTxPduCanIdType = STANDARD_CAN
        CanIfTxPduCanId = 1347
        CanIfTxPduUserTxConfirmationUL = PDUR
        CanIfTxPduBufferRef = Buffer_Can_Network_CANNODE_0_Tx_Std_MailBox_22
        CanIfTxPduRef = PduCollection/BMS_Vol_4_Can_Network_CANNODE_0_PduR2CanIf
      Buffer_Can_Network_CANNODE_0_Tx_Std_MailBox_23 (CanIfBufferCfg): CanIfBufferSize=0, CanIfBufferHthRef=Can_Network_CANNODE_0_Tx_Std_MailBox_23
      BMS_Vol_3_Can_Network_CANNODE_0 (CanIfTxPduCfg):
        CanIfTxPduReadNotifyStatus = false
        CanIfTxPduType = STATIC
        CanIfTxPduTruncation = false
        CanIfTxPduCanIdType = STANDARD_CAN
        CanIfTxPduCanId = 1346
        CanIfTxPduUserTxConfirmationUL = PDUR
        CanIfTxPduBufferRef = Buffer_Can_Network_CANNODE_0_Tx_Std_MailBox_23
        CanIfTxPduRef = PduCollection/BMS_Vol_3_Can_Network_CANNODE_0_PduR2CanIf
      Buffer_Can_Network_CANNODE_0_Tx_Std_MailBox_24 (CanIfBufferCfg): CanIfBufferSize=0, CanIfBufferHthRef=Can_Network_CANNODE_0_Tx_Std_MailBox_24
      BMS_8_Can_Network_CANNODE_0 (CanIfTxPduCfg):
        CanIfTxPduReadNotifyStatus = false
        CanIfTxPduType = STATIC
        CanIfTxPduTruncation = false
        CanIfTxPduCanIdType = STANDARD_CAN
        CanIfTxPduCanId = 1103
        CanIfTxPduUserTxConfirmationUL = PDUR
        CanIfTxPduBufferRef = Buffer_Can_Network_CANNODE_0_Tx_Std_MailBox_24
        CanIfTxPduRef = PduCollection/BMS_8_Can_Network_CANNODE_0_PduR2CanIf
      Buffer_Can_Network_CANNODE_0_Tx_Std_MailBox_25 (CanIfBufferCfg): CanIfBufferSize=0, CanIfBufferHthRef=Can_Network_CANNODE_0_Tx_Std_MailBox_25
      BMS_Vol_2_Can_Network_CANNODE_0 (CanIfTxPduCfg):
        CanIfTxPduReadNotifyStatus = false
        CanIfTxPduType = STATIC
        CanIfTxPduTruncation = false
        CanIfTxPduCanIdType = STANDARD_CAN
        CanIfTxPduCanId = 1345
        CanIfTxPduUserTxConfirmationUL = PDUR
        CanIfTxPduBufferRef = Buffer_Can_Network_CANNODE_0_Tx_Std_MailBox_25
        CanIfTxPduRef = PduCollection/BMS_Vol_2_Can_Network_CANNODE_0_PduR2CanIf
      Buffer_Can_Network_CANNODE_0_Tx_Std_MailBox_26 (CanIfBufferCfg): CanIfBufferSize=0, CanIfBufferHthRef=Can_Network_CANNODE_0_Tx_Std_MailBox_26
      BMS_Vol_1_Can_Network_CANNODE_0 (CanIfTxPduCfg):
        CanIfTxPduReadNotifyStatus = false
        CanIfTxPduType = STATIC
        CanIfTxPduTruncation = false
        CanIfTxPduCanIdType = STANDARD_CAN
        CanIfTxPduCanId = 1344
        CanIfTxPduUserTxConfirmationUL = PDUR
        CanIfTxPduBufferRef = Buffer_Can_Network_CANNODE_0_Tx_Std_MailBox_26
        CanIfTxPduRef = PduCollection/BMS_Vol_1_Can_Network_CANNODE_0_PduR2CanIf
      Buffer_Can_Network_CANNODE_0_Tx_Std_MailBox_27 (CanIfBufferCfg): CanIfBufferSize=0, CanIfBufferHthRef=Can_Network_CANNODE_0_Tx_Std_MailBox_27
      BMS_1_Can_Network_CANNODE_0 (CanIfTxPduCfg):
        CanIfTxPduReadNotifyStatus = false
        CanIfTxPduType = STATIC
        CanIfTxPduTruncation = false
        CanIfTxPduCanIdType = STANDARD_CAN
        CanIfTxPduCanId = 403
        CanIfTxPduUserTxConfirmationUL = PDUR
        CanIfTxPduBufferRef = Buffer_Can_Network_CANNODE_0_Tx_Std_MailBox_27
        CanIfTxPduRef = PduCollection/BMS_1_Can_Network_CANNODE_0_PduR2CanIf
      Buffer_Can_Network_CANNODE_0_Tx_Std_MailBox_28 (CanIfBufferCfg): CanIfBufferSize=0, CanIfBufferHthRef=Can_Network_CANNODE_0_Tx_Std_MailBox_28
      BMS_Vol_20_Can_Network_CANNODE_0 (CanIfTxPduCfg):
        CanIfTxPduReadNotifyStatus = false
        CanIfTxPduType = STATIC
        CanIfTxPduTruncation = false
        CanIfTxPduCanIdType = STANDARD_CAN
        CanIfTxPduCanId = 1363
        CanIfTxPduUserTxConfirmationUL = PDUR
        CanIfTxPduBufferRef = Buffer_Can_Network_CANNODE_0_Tx_Std_MailBox_28
        CanIfTxPduRef = PduCollection/BMS_Vol_20_Can_Network_CANNODE_0_PduR2CanIf
      Buffer_Can_Network_CANNODE_0_Tx_Std_MailBox_29 (CanIfBufferCfg): CanIfBufferSize=0, CanIfBufferHthRef=Can_Network_CANNODE_0_Tx_Std_MailBox_29
      BMS_Vol_19_Can_Network_CANNODE_0 (CanIfTxPduCfg):
        CanIfTxPduReadNotifyStatus = false
        CanIfTxPduType = STATIC
        CanIfTxPduTruncation = false
        CanIfTxPduCanIdType = STANDARD_CAN
        CanIfTxPduCanId = 1362
        CanIfTxPduUserTxConfirmationUL = PDUR
        CanIfTxPduBufferRef = Buffer_Can_Network_CANNODE_0_Tx_Std_MailBox_29
        CanIfTxPduRef = PduCollection/BMS_Vol_19_Can_Network_CANNODE_0_PduR2CanIf
      Buffer_Can_Network_CANNODE_0_Tx_Std_MailBox_30 (CanIfBufferCfg): CanIfBufferSize=0, CanIfBufferHthRef=Can_Network_CANNODE_0_Tx_Std_MailBox_30
      BMS_Vol_18_Can_Network_CANNODE_0 (CanIfTxPduCfg):
        CanIfTxPduReadNotifyStatus = false
        CanIfTxPduType = STATIC
        CanIfTxPduTruncation = false
        CanIfTxPduCanIdType = STANDARD_CAN
        CanIfTxPduCanId = 1361
        CanIfTxPduUserTxConfirmationUL = PDUR
        CanIfTxPduBufferRef = Buffer_Can_Network_CANNODE_0_Tx_Std_MailBox_30
        CanIfTxPduRef = PduCollection/BMS_Vol_18_Can_Network_CANNODE_0_PduR2CanIf
      Buffer_Can_Network_CANNODE_0_Tx_Std_MailBox_31 (CanIfBufferCfg): CanIfBufferSize=0, CanIfBufferHthRef=Can_Network_CANNODE_0_Tx_Std_MailBox_31
      BMS_Vol_17_Can_Network_CANNODE_0 (CanIfTxPduCfg):
        CanIfTxPduReadNotifyStatus = false
        CanIfTxPduType = STATIC
        CanIfTxPduTruncation = false
        CanIfTxPduCanIdType = STANDARD_CAN
        CanIfTxPduCanId = 1360
        CanIfTxPduUserTxConfirmationUL = PDUR
        CanIfTxPduBufferRef = Buffer_Can_Network_CANNODE_0_Tx_Std_MailBox_31
        CanIfTxPduRef = PduCollection/BMS_Vol_17_Can_Network_CANNODE_0_PduR2CanIf
      Buffer_Can_Network_CANNODE_0_Tx_Std_MailBox_32 (CanIfBufferCfg): CanIfBufferSize=0, CanIfBufferHthRef=Can_Network_CANNODE_0_Tx_Std_MailBox_32
      BMS_5_Can_Network_CANNODE_0 (CanIfTxPduCfg):
        CanIfTxPduReadNotifyStatus = false
        CanIfTxPduType = STATIC
        CanIfTxPduTruncation = false
        CanIfTxPduCanIdType = STANDARD_CAN
        CanIfTxPduCanId = 1083
        CanIfTxPduUserTxConfirmationUL = PDUR
        CanIfTxPduBufferRef = Buffer_Can_Network_CANNODE_0_Tx_Std_MailBox_32
        CanIfTxPduRef = PduCollection/BMS_5_Can_Network_CANNODE_0_PduR2CanIf
      Buffer_Can_Network_CANNODE_0_Tx_Std_MailBox_33 (CanIfBufferCfg): CanIfBufferSize=0, CanIfBufferHthRef=Can_Network_CANNODE_0_Tx_Std_MailBox_33
      BMS_9_Can_Network_CANNODE_0 (CanIfTxPduCfg):
        CanIfTxPduReadNotifyStatus = false
        CanIfTxPduType = STATIC
        CanIfTxPduTruncation = false
        CanIfTxPduCanIdType = STANDARD_CAN
        CanIfTxPduCanId = 1436
        CanIfTxPduUserTxConfirmationUL = PDUR
        CanIfTxPduBufferRef = Buffer_Can_Network_CANNODE_0_Tx_Std_MailBox_33
        CanIfTxPduRef = PduCollection/BMS_9_Can_Network_CANNODE_0_PduR2CanIf
      Buffer_Can_Network_CANNODE_0_Tx_Std_MailBox_34 (CanIfBufferCfg): CanIfBufferSize=0, CanIfBufferHthRef=Can_Network_CANNODE_0_Tx_Std_MailBox_34
      BMS_Vol_16_Can_Network_CANNODE_0 (CanIfTxPduCfg):
        CanIfTxPduReadNotifyStatus = false
        CanIfTxPduType = STATIC
        CanIfTxPduTruncation = false
        CanIfTxPduCanIdType = STANDARD_CAN
        CanIfTxPduCanId = 1359
        CanIfTxPduUserTxConfirmationUL = PDUR
        CanIfTxPduBufferRef = Buffer_Can_Network_CANNODE_0_Tx_Std_MailBox_34
        CanIfTxPduRef = PduCollection/BMS_Vol_16_Can_Network_CANNODE_0_PduR2CanIf
      Buffer_Can_Network_CANNODE_0_Tx_Std_MailBox_35 (CanIfBufferCfg): CanIfBufferSize=0, CanIfBufferHthRef=Can_Network_CANNODE_0_Tx_Std_MailBox_35
      BMS_Vol_15_Can_Network_CANNODE_0 (CanIfTxPduCfg):
        CanIfTxPduReadNotifyStatus = false
        CanIfTxPduType = STATIC
        CanIfTxPduTruncation = false
        CanIfTxPduCanIdType = STANDARD_CAN
        CanIfTxPduCanId = 1358
        CanIfTxPduUserTxConfirmationUL = PDUR
        CanIfTxPduBufferRef = Buffer_Can_Network_CANNODE_0_Tx_Std_MailBox_35
        CanIfTxPduRef = PduCollection/BMS_Vol_15_Can_Network_CANNODE_0_PduR2CanIf
      Buffer_Can_Network_CANNODE_0_Tx_Std_MailBox_36 (CanIfBufferCfg): CanIfBufferSize=0, CanIfBufferHthRef=Can_Network_CANNODE_0_Tx_Std_MailBox_36
      BMS_Vol_14_Can_Network_CANNODE_0 (CanIfTxPduCfg):
        CanIfTxPduReadNotifyStatus = false
        CanIfTxPduType = STATIC
        CanIfTxPduTruncation = false
        CanIfTxPduCanIdType = STANDARD_CAN
        CanIfTxPduCanId = 1357
        CanIfTxPduUserTxConfirmationUL = PDUR
        CanIfTxPduBufferRef = Buffer_Can_Network_CANNODE_0_Tx_Std_MailBox_36
        CanIfTxPduRef = PduCollection/BMS_Vol_14_Can_Network_CANNODE_0_PduR2CanIf
      Buffer_Can_Network_CANNODE_0_Tx_Std_MailBox_37 (CanIfBufferCfg): CanIfBufferSize=0, CanIfBufferHthRef=Can_Network_CANNODE_0_Tx_Std_MailBox_37
      BMS_2_Can_Network_CANNODE_0 (CanIfTxPduCfg):
        CanIfTxPduReadNotifyStatus = false
        CanIfTxPduType = STATIC
        CanIfTxPduTruncation = false
        CanIfTxPduCanIdType = STANDARD_CAN
        CanIfTxPduCanId = 411
        CanIfTxPduUserTxConfirmationUL = PDUR
        CanIfTxPduBufferRef = Buffer_Can_Network_CANNODE_0_Tx_Std_MailBox_37
        CanIfTxPduRef = PduCollection/BMS_2_Can_Network_CANNODE_0_PduR2CanIf
      Buffer_Can_Network_CANNODE_0_Tx_Std_MailBox_38 (CanIfBufferCfg): CanIfBufferSize=0, CanIfBufferHthRef=Can_Network_CANNODE_0_Tx_Std_MailBox_38
      BMS_Vol_13_Can_Network_CANNODE_0 (CanIfTxPduCfg):
        CanIfTxPduReadNotifyStatus = false
        CanIfTxPduType = STATIC
        CanIfTxPduTruncation = false
        CanIfTxPduCanIdType = STANDARD_CAN
        CanIfTxPduCanId = 1356
        CanIfTxPduUserTxConfirmationUL = PDUR
        CanIfTxPduBufferRef = Buffer_Can_Network_CANNODE_0_Tx_Std_MailBox_38
        CanIfTxPduRef = PduCollection/BMS_Vol_13_Can_Network_CANNODE_0_PduR2CanIf
      Buffer_Can_Network_CANNODE_0_Tx_Std_MailBox_39 (CanIfBufferCfg): CanIfBufferSize=0, CanIfBufferHthRef=Can_Network_CANNODE_0_Tx_Std_MailBox_39
      BMS_Vol_12_Can_Network_CANNODE_0 (CanIfTxPduCfg):
        CanIfTxPduReadNotifyStatus = false
        CanIfTxPduType = STATIC
        CanIfTxPduTruncation = false
        CanIfTxPduCanIdType = STANDARD_CAN
        CanIfTxPduCanId = 1355
        CanIfTxPduUserTxConfirmationUL = PDUR
        CanIfTxPduBufferRef = Buffer_Can_Network_CANNODE_0_Tx_Std_MailBox_39
        CanIfTxPduRef = PduCollection/BMS_Vol_12_Can_Network_CANNODE_0_PduR2CanIf
      Buffer_Can_Network_CANNODE_0_Tx_Std_MailBox_40 (CanIfBufferCfg): CanIfBufferSize=0, CanIfBufferHthRef=Can_Network_CANNODE_0_Tx_Std_MailBox_40
      BMS_23_Can_Network_CANNODE_0 (CanIfTxPduCfg):
        CanIfTxPduReadNotifyStatus = false
        CanIfTxPduType = STATIC
        CanIfTxPduTruncation = false
        CanIfTxPduCanIdType = STANDARD_CAN
        CanIfTxPduCanId = 1475
        CanIfTxPduUserTxConfirmationUL = PDUR
        CanIfTxPduBufferRef = Buffer_Can_Network_CANNODE_0_Tx_Std_MailBox_40
        CanIfTxPduRef = PduCollection/BMS_23_Can_Network_CANNODE_0_PduR2CanIf
      Buffer_Can_Network_CANNODE_0_Tx_Std_MailBox_41 (CanIfBufferCfg): CanIfBufferSize=0, CanIfBufferHthRef=Can_Network_CANNODE_0_Tx_Std_MailBox_41
      BMS_Vol_11_Can_Network_CANNODE_0 (CanIfTxPduCfg):
        CanIfTxPduReadNotifyStatus = false
        CanIfTxPduType = STATIC
        CanIfTxPduTruncation = false
        CanIfTxPduCanIdType = STANDARD_CAN
        CanIfTxPduCanId = 1354
        CanIfTxPduUserTxConfirmationUL = PDUR
        CanIfTxPduBufferRef = Buffer_Can_Network_CANNODE_0_Tx_Std_MailBox_41
        CanIfTxPduRef = PduCollection/BMS_Vol_11_Can_Network_CANNODE_0_PduR2CanIf
      Buffer_Can_Network_CANNODE_0_Tx_Std_MailBox_42 (CanIfBufferCfg): CanIfBufferSize=0, CanIfBufferHthRef=Can_Network_CANNODE_0_Tx_Std_MailBox_42
      BMS_25_Can_Network_CANNODE_0 (CanIfTxPduCfg):
        CanIfTxPduReadNotifyStatus = false
        CanIfTxPduType = STATIC
        CanIfTxPduTruncation = false
        CanIfTxPduCanIdType = STANDARD_CAN
        CanIfTxPduCanId = 1199
        CanIfTxPduUserTxConfirmationUL = PDUR
        CanIfTxPduBufferRef = Buffer_Can_Network_CANNODE_0_Tx_Std_MailBox_42
        CanIfTxPduRef = PduCollection/BMS_25_Can_Network_CANNODE_0_PduR2CanIf
      Buffer_Can_Network_CANNODE_0_Tx_Std_MailBox_43 (CanIfBufferCfg): CanIfBufferSize=0, CanIfBufferHthRef=Can_Network_CANNODE_0_Tx_Std_MailBox_43
      BMS_Vol_10_Can_Network_CANNODE_0 (CanIfTxPduCfg):
        CanIfTxPduReadNotifyStatus = false
        CanIfTxPduType = STATIC
        CanIfTxPduTruncation = false
        CanIfTxPduCanIdType = STANDARD_CAN
        CanIfTxPduCanId = 1353
        CanIfTxPduUserTxConfirmationUL = PDUR
        CanIfTxPduBufferRef = Buffer_Can_Network_CANNODE_0_Tx_Std_MailBox_43
        CanIfTxPduRef = PduCollection/BMS_Vol_10_Can_Network_CANNODE_0_PduR2CanIf
      Buffer_Can_Network_CANNODE_0_Tx_Std_MailBox_44 (CanIfBufferCfg): CanIfBufferSize=0, CanIfBufferHthRef=Can_Network_CANNODE_0_Tx_Std_MailBox_44
      BMS_22_Can_Network_CANNODE_0 (CanIfTxPduCfg):
        CanIfTxPduReadNotifyStatus = false
        CanIfTxPduType = STATIC
        CanIfTxPduTruncation = false
        CanIfTxPduCanIdType = STANDARD_CAN
        CanIfTxPduCanId = 1474
        CanIfTxPduUserTxConfirmationUL = PDUR
        CanIfTxPduBufferRef = Buffer_Can_Network_CANNODE_0_Tx_Std_MailBox_44
        CanIfTxPduRef = PduCollection/BMS_22_Can_Network_CANNODE_0_PduR2CanIf
      Buffer_Can_Network_CANNODE_0_Tx_Std_MailBox_45 (CanIfBufferCfg): CanIfBufferSize=0, CanIfBufferHthRef=Can_Network_CANNODE_0_Tx_Std_MailBox_45
      BMS_6_Can_Network_CANNODE_0 (CanIfTxPduCfg):
        CanIfTxPduReadNotifyStatus = false
        CanIfTxPduType = STATIC
        CanIfTxPduTruncation = false
        CanIfTxPduCanIdType = STANDARD_CAN
        CanIfTxPduCanId = 1091
        CanIfTxPduUserTxConfirmationUL = PDUR
        CanIfTxPduBufferRef = Buffer_Can_Network_CANNODE_0_Tx_Std_MailBox_45
        CanIfTxPduRef = PduCollection/BMS_6_Can_Network_CANNODE_0_PduR2CanIf
      Buffer_Can_Network_CANNODE_0_Tx_Std_MailBox_46 (CanIfBufferCfg): CanIfBufferSize=0, CanIfBufferHthRef=Can_Network_CANNODE_0_Tx_Std_MailBox_46
      BMS_13_Can_Network_CANNODE_0 (CanIfTxPduCfg):
        CanIfTxPduReadNotifyStatus = false
        CanIfTxPduType = STATIC
        CanIfTxPduTruncation = false
        CanIfTxPduCanIdType = STANDARD_CAN
        CanIfTxPduCanId = 1451
        CanIfTxPduUserTxConfirmationUL = PDUR
        CanIfTxPduBufferRef = Buffer_Can_Network_CANNODE_0_Tx_Std_MailBox_46
        CanIfTxPduRef = PduCollection/BMS_13_Can_Network_CANNODE_0_PduR2CanIf
      Buffer_Can_Network_CANNODE_0_Tx_Std_MailBox_47 (CanIfBufferCfg): CanIfBufferSize=0, CanIfBufferHthRef=Can_Network_CANNODE_0_Tx_Std_MailBox_47
      BMS_12_Can_Network_CANNODE_0 (CanIfTxPduCfg):
        CanIfTxPduReadNotifyStatus = false
        CanIfTxPduType = STATIC
        CanIfTxPduTruncation = false
        CanIfTxPduCanIdType = STANDARD_CAN
        CanIfTxPduCanId = 1450
        CanIfTxPduUserTxConfirmationUL = PDUR
        CanIfTxPduBufferRef = Buffer_Can_Network_CANNODE_0_Tx_Std_MailBox_47
        CanIfTxPduRef = PduCollection/BMS_12_Can_Network_CANNODE_0_PduR2CanIf
      Buffer_Can_Network_CANNODE_0_Tx_Std_MailBox_48 (CanIfBufferCfg): CanIfBufferSize=0, CanIfBufferHthRef=Can_Network_CANNODE_0_Tx_Std_MailBox_48
      BMS_7_Can_Network_CANNODE_0 (CanIfTxPduCfg):
        CanIfTxPduReadNotifyStatus = false
        CanIfTxPduType = STATIC
        CanIfTxPduTruncation = false
        CanIfTxPduCanIdType = STANDARD_CAN
        CanIfTxPduCanId = 1096
        CanIfTxPduUserTxConfirmationUL = PDUR
        CanIfTxPduBufferRef = Buffer_Can_Network_CANNODE_0_Tx_Std_MailBox_48
        CanIfTxPduRef = PduCollection/BMS_7_Can_Network_CANNODE_0_PduR2CanIf
      Buffer_Can_Network_CANNODE_0_Tx_Std_MailBox_49 (CanIfBufferCfg): CanIfBufferSize=0, CanIfBufferHthRef=Can_Network_CANNODE_0_Tx_Std_MailBox_49
      BMS_10_Can_Network_CANNODE_0 (CanIfTxPduCfg):
        CanIfTxPduReadNotifyStatus = false
        CanIfTxPduType = STATIC
        CanIfTxPduTruncation = false
        CanIfTxPduCanIdType = STANDARD_CAN
        CanIfTxPduCanId = 1448
        CanIfTxPduUserTxConfirmationUL = PDUR
        CanIfTxPduBufferRef = Buffer_Can_Network_CANNODE_0_Tx_Std_MailBox_49
        CanIfTxPduRef = PduCollection/BMS_10_Can_Network_CANNODE_0_PduR2CanIf
      Buffer_Can_Network_CANNODE_0_Tx_Std_MailBox_50 (CanIfBufferCfg): CanIfBufferSize=0, CanIfBufferHthRef=Can_Network_CANNODE_0_Tx_Std_MailBox_50
      BMS_3_Can_Network_CANNODE_0 (CanIfTxPduCfg):
        CanIfTxPduReadNotifyStatus = false
        CanIfTxPduType = STATIC
        CanIfTxPduTruncation = false
        CanIfTxPduCanIdType = STANDARD_CAN
        CanIfTxPduCanId = 420
        CanIfTxPduUserTxConfirmationUL = PDUR
        CanIfTxPduBufferRef = Buffer_Can_Network_CANNODE_0_Tx_Std_MailBox_50
        CanIfTxPduRef = PduCollection/BMS_3_Can_Network_CANNODE_0_PduR2CanIf
      Buffer_Can_Network_CANNODE_0_Tx_Std_MailBox_51 (CanIfBufferCfg): CanIfBufferSize=0, CanIfBufferHthRef=Can_Network_CANNODE_0_Tx_Std_MailBox_51
      BMS_Vol_24_Can_Network_CANNODE_0 (CanIfTxPduCfg):
        CanIfTxPduReadNotifyStatus = false
        CanIfTxPduType = STATIC
        CanIfTxPduTruncation = false
        CanIfTxPduCanIdType = STANDARD_CAN
        CanIfTxPduCanId = 1367
        CanIfTxPduUserTxConfirmationUL = PDUR
        CanIfTxPduBufferRef = Buffer_Can_Network_CANNODE_0_Tx_Std_MailBox_51
        CanIfTxPduRef = PduCollection/BMS_Vol_24_Can_Network_CANNODE_0_PduR2CanIf
      Buffer_Can_Network_CANNODE_0_Tx_Std_MailBox_52 (CanIfBufferCfg): CanIfBufferSize=0, CanIfBufferHthRef=Can_Network_CANNODE_0_Tx_Std_MailBox_52
      BMS_Vol_23_Can_Network_CANNODE_0 (CanIfTxPduCfg):
        CanIfTxPduReadNotifyStatus = false
        CanIfTxPduType = STATIC
        CanIfTxPduTruncation = false
        CanIfTxPduCanIdType = STANDARD_CAN
        CanIfTxPduCanId = 1366
        CanIfTxPduUserTxConfirmationUL = PDUR
        CanIfTxPduBufferRef = Buffer_Can_Network_CANNODE_0_Tx_Std_MailBox_52
        CanIfTxPduRef = PduCollection/BMS_Vol_23_Can_Network_CANNODE_0_PduR2CanIf
      Buffer_Can_Network_CANNODE_0_Tx_Std_MailBox_53 (CanIfBufferCfg): CanIfBufferSize=0, CanIfBufferHthRef=Can_Network_CANNODE_0_Tx_Std_MailBox_53
      BMS_Vol_22_Can_Network_CANNODE_0 (CanIfTxPduCfg):
        CanIfTxPduReadNotifyStatus = false
        CanIfTxPduType = STATIC
        CanIfTxPduTruncation = false
        CanIfTxPduCanIdType = STANDARD_CAN
        CanIfTxPduCanId = 1365
        CanIfTxPduUserTxConfirmationUL = PDUR
        CanIfTxPduBufferRef = Buffer_Can_Network_CANNODE_0_Tx_Std_MailBox_53
        CanIfTxPduRef = PduCollection/BMS_Vol_22_Can_Network_CANNODE_0_PduR2CanIf
      Buffer_Can_Network_CANNODE_0_Tx_Std_MailBox_54 (CanIfBufferCfg): CanIfBufferSize=0, CanIfBufferHthRef=Can_Network_CANNODE_0_Tx_Std_MailBox_54
      BMS_Vol_21_Can_Network_CANNODE_0 (CanIfTxPduCfg):
        CanIfTxPduReadNotifyStatus = false
        CanIfTxPduType = STATIC
        CanIfTxPduTruncation = false
        CanIfTxPduCanIdType = STANDARD_CAN
        CanIfTxPduCanId = 1364
        CanIfTxPduUserTxConfirmationUL = PDUR
        CanIfTxPduBufferRef = Buffer_Can_Network_CANNODE_0_Tx_Std_MailBox_54
        CanIfTxPduRef = PduCollection/BMS_Vol_21_Can_Network_CANNODE_0_PduR2CanIf
      Buffer_Can_Network_CANNODE_0_Tx_Std_MailBox_55 (CanIfBufferCfg): CanIfBufferSize=0, CanIfBufferHthRef=Can_Network_CANNODE_0_Tx_Std_MailBox_55
      BMS_4_Can_Network_CANNODE_0 (CanIfTxPduCfg):
        CanIfTxPduReadNotifyStatus = false
        CanIfTxPduType = STATIC
        CanIfTxPduTruncation = false
        CanIfTxPduCanIdType = STANDARD_CAN
        CanIfTxPduCanId = 427
        CanIfTxPduUserTxConfirmationUL = PDUR
        CanIfTxPduBufferRef = Buffer_Can_Network_CANNODE_0_Tx_Std_MailBox_55
        CanIfTxPduRef = PduCollection/BMS_4_Can_Network_CANNODE_0_PduR2CanIf
      Buffer_Can_Network_CANNODE_0_Tx_Std_MailBox_56 (CanIfBufferCfg): CanIfBufferSize=0, CanIfBufferHthRef=Can_Network_CANNODE_0_Tx_Std_MailBox_56
      BMS_11_Can_Network_CANNODE_0 (CanIfTxPduCfg):
        CanIfTxPduReadNotifyStatus = false
        CanIfTxPduType = STATIC
        CanIfTxPduTruncation = false
        CanIfTxPduCanIdType = STANDARD_CAN
        CanIfTxPduCanId = 1449
        CanIfTxPduUserTxConfirmationUL = PDUR
        CanIfTxPduBufferRef = Buffer_Can_Network_CANNODE_0_Tx_Std_MailBox_56
        CanIfTxPduRef = PduCollection/BMS_11_Can_Network_CANNODE_0_PduR2CanIf
    CanIfCtrlDrvCfg: CanIfRbCtrlDrvPrefix=CanConf_CanHardwareObject, CanIfCtrlDrvNameRef=CanGeneral, CanIfCtrlDrvInitHohConfigRef=CanIfInitHohCfg
      Can_Network_CANNODE_0 (CanIfCtrlCfg): CanIfCtrlWakeupSupport=false, CanIfCtrlCanCtrlRef=Can_Network_CANNODE_0
    CanIfDispatchCfg: CanIfDispatchUserCtrlBusOffUL=CAN_SM, CanIfDispatchUserCtrlModeIndicationUL=CAN_SM, CanIfDispatchUserTrcvModeIndicationName=CAN_SM
    CanIfPrivateCfg: CanIfPrivateDlcCheck=false
    CanIfPublicCfg:
      CanIfPublicReadRxPduDataApi = false
      CanIfPublicReadRxPduNotifyStatusApi = true
      CanIfPublicReadTxPduNotifyStatusApi = true
      CanIfPublicSetDynamicTxIdApi = false
      CanIfPublicTxBuffering = false
      CanIfPublicTxConfirmPollingSupport = false
      CanIfPublicVersionInfoApi = false
      CanIfPublicCancelTransmitSupport = false
      CanIfPublicErrorPassiveSupport = false
      CanIfPublicCanIfLiteConfiguration = false
      CanIfPublicUserTpTxInOfflineMode = false
      CanIfPublicWakeupCheckValidSupport = false
      CanIfPublicPnSupport = false
      CanIfPublicBusoffRecoveryfromRxIndication = false
      CanIfTriggerTransmitSupport = false
      CanIfTxOfflineActiveSupport = false
      CanIfWakeupSupport = false
      CanIfPublicDevErrorDetect = false
  module config CanSM: implementation-config-variant=VARIANT-PRE-COMPILE
    CanSMConfiguration: CanSMModeRequestRepetitionMax=5, CanSMModeRequestRepetitionTime=0.07
      CanSMManagerNetwork_Can_Network (CanSMManagerNetwork):
        CanSMBorTxConfirmationPolling = false
        CanSMBorCounterL1ToL2 = 0
        CanSMBorTimeL1 = 0.04
        CanSMBorTimeL2 = 0.1
        CanSMBorTimeTxEnsured = 0.02
        CanSMComMNetworkHandleRef = ComMChannel_Can_Network_Channel
        CanSMDemEventParameterRefs: CanSMRbDynCreate_CANSM_E_BUS_OFF=Standard
        CanSMController_Can_Network_CANNODE_0 (CanSMController): CanSMControllerId=Can_Network_CANNODE_0
    CanSMGeneral: CanSMMainFunctionTimePeriod=0.01, CanSMVersionInfoApi=false, CanSMDevErrorDetect=false
  module config PduR: implementation-config-variant=VARIANT-PRE-COMPILE
    PduRGeneral:
      PduRVersionInfoApi = false
      PduRZeroCostOperation = false
      PduRFifoTxBufferSupport = false
      PduRIFGatewayOperation = false
      PduRTPGatewayOperation = false
      PduRMemorySize = 0
      PduRMinimumRoutingLoRxPduId = 0
      PduRMinimumRoutingLoTxPduId = 0
      PduRMinimumRoutingUpRxPduId = 0
      PduRMinimumRoutingUpTxPduId = 0
      PduRMulticastFromIfSupport = false
      PduRMulticastFromTpSupport = false
      PduRMulticastToIfSupport = false
      PduRMulticastToTpSupport = false
      PduRSbTxBufferSupport = false
      PduRQueueingSupport = false
      PduRCanTpChangeParameterRequestApi = false
      PduRFrTpChangeParameterRequestApi = false
      PduRGwTpWithLimitedBuffer = false
      PduRDevErrorDetect = false
    PduRRoutingTables: PduRConfigurationId=0
      PduRRoutingTable
        81 x PduRRoutingPath:
          TMR_3_Can_Network_CANNODE_0_CanIf2Com
            TMR_3_Can_Network_CANNODE_0_CanIf2PduR (PduRSrcPdu): PduRSrcPduRef=PduCollection/TMR_3_Can_Network_CANNODE_0_CanIf2PduR
            TMR_3_Can_Network_CANNODE_0_PduR2Com (PduRDestPdu): PduRTransmissionConfirmation=false, PduRDestPduRef=PduCollection/TMR_3_Can_Network_CANNODE_0_PduR2Com
          EMS_4_G_Can_Network_CANNODE_0_CanIf2Com
            EMS_4_G_Can_Network_CANNODE_0_CanIf2PduR (PduRSrcPdu): PduRSrcPduRef=PduCollection/EMS_4_G_Can_Network_CANNODE_0_CanIf2PduR
            EMS_4_G_Can_Network_CANNODE_0_PduR2Com (PduRDestPdu): PduRTransmissionConfirmation=false, PduRDestPduRef=PduCollection/EMS_4_G_Can_Network_CANNODE_0_PduR2Com
          OBC_2_Can_Network_CANNODE_0_CanIf2Com
            OBC_2_Can_Network_CANNODE_0_CanIf2PduR (PduRSrcPdu): PduRSrcPduRef=PduCollection/OBC_2_Can_Network_CANNODE_0_CanIf2PduR
            OBC_2_Can_Network_CANNODE_0_PduR2Com (PduRDestPdu): PduRTransmissionConfirmation=false, PduRDestPduRef=PduCollection/OBC_2_Can_Network_CANNODE_0_PduR2Com
          OBC_4_Can_Network_CANNODE_0_CanIf2Com
            OBC_4_Can_Network_CANNODE_0_CanIf2PduR (PduRSrcPdu): PduRSrcPduRef=PduCollection/OBC_4_Can_Network_CANNODE_0_CanIf2PduR
            OBC_4_Can_Network_CANNODE_0_PduR2Com (PduRDestPdu): PduRTransmissionConfirmation=false, PduRDestPduRef=PduCollection/OBC_4_Can_Network_CANNODE_0_PduR2Com
          ABS_ESP_G_Can_Network_CANNODE_0_CanIf2Com
            ABS_ESP_G_Can_Network_CANNODE_0_CanIf2PduR (PduRSrcPdu): PduRSrcPduRef=PduCollection/ABS_ESP_G_Can_Network_CANNODE_0_CanIf2PduR
            ABS_ESP_G_Can_Network_CANNODE_0_PduR2Com (PduRDestPdu): PduRTransmissionConfirmation=false, PduRDestPduRef=PduCollection/ABS_ESP_G_Can_Network_CANNODE_0_PduR2Com
          TMR_1_Can_Network_CANNODE_0_CanIf2Com
            TMR_1_Can_Network_CANNODE_0_CanIf2PduR (PduRSrcPdu): PduRSrcPduRef=PduCollection/TMR_1_Can_Network_CANNODE_0_CanIf2PduR
            TMR_1_Can_Network_CANNODE_0_PduR2Com (PduRDestPdu): PduRTransmissionConfirmation=false, PduRDestPduRef=PduCollection/TMR_1_Can_Network_CANNODE_0_PduR2Com
          OBC_1_Can_Network_CANNODE_0_CanIf2Com
            OBC_1_Can_Network_CANNODE_0_CanIf2PduR (PduRSrcPdu): PduRSrcPduRef=PduCollection/OBC_1_Can_Network_CANNODE_0_CanIf2PduR
            OBC_1_Can_Network_CANNODE_0_PduR2Com (PduRDestPdu): PduRTransmissionConfirmation=false, PduRDestPduRef=PduCollection/OBC_1_Can_Network_CANNODE_0_PduR2Com
          TMF_3_Can_Network_CANNODE_0_CanIf2Com
            TMF_3_Can_Network_CANNODE_0_CanIf2PduR (PduRSrcPdu): PduRSrcPduRef=PduCollection/TMF_3_Can_Network_CANNODE_0_CanIf2PduR
            TMF_3_Can_Network_CANNODE_0_PduR2Com (PduRDestPdu): PduRTransmissionConfirmation=false, PduRDestPduRef=PduCollection/TMF_3_Can_Network_CANNODE_0_PduR2Com
          EMS_28_Can_Network_CANNODE_0_CanIf2Com
            EMS_28_Can_Network_CANNODE_0_CanIf2PduR (PduRSrcPdu): PduRSrcPduRef=PduCollection/EMS_28_Can_Network_CANNODE_0_CanIf2PduR
            EMS_28_Can_Network_CANNODE_0_PduR2Com (PduRDestPdu): PduRTransmissionConfirmation=false, PduRDestPduRef=PduCollection/EMS_28_Can_Network_CANNODE_0_PduR2Com
          CLM_2_Can_Network_CANNODE_0_CanIf2Com
            CLM_2_Can_Network_CANNODE_0_CanIf2PduR (PduRSrcPdu): PduRSrcPduRef=PduCollection/CLM_2_Can_Network_CANNODE_0_CanIf2PduR
            CLM_2_Can_Network_CANNODE_0_PduR2Com (PduRDestPdu): PduRTransmissionConfirmation=false, PduRDestPduRef=PduCollection/CLM_2_Can_Network_CANNODE_0_PduR2Com
          HCU_1_G_Can_Network_CANNODE_0_CanIf2Com
            HCU_1_G_Can_Network_CANNODE_0_CanIf2PduR (PduRSrcPdu): PduRSrcPduRef=PduCollection/HCU_1_G_Can_Network_CANNODE_0_CanIf2PduR
            HCU_1_G_Can_Network_CANNODE_0_PduR2Com (PduRDestPdu): PduRTransmissionConfirmation=false, PduRDestPduRef=PduCollection/HCU_1_G_Can_Network_CANNODE_0_PduR2Com
          TBOX_3_Can_Network_CANNODE_0_CanIf2Com
            TBOX_3_Can_Network_CANNODE_0_CanIf2PduR (PduRSrcPdu): PduRSrcPduRef=PduCollection/TBOX_3_Can_Network_CANNODE_0_CanIf2PduR
            TBOX_3_Can_Network_CANNODE_0_PduR2Com (PduRDestPdu): PduRTransmissionConfirmation=false, PduRDestPduRef=PduCollection/TBOX_3_Can_Network_CANNODE_0_PduR2Com
          DCDC_2_Can_Network_CANNODE_0_CanIf2Com
            DCDC_2_Can_Network_CANNODE_0_CanIf2PduR (PduRSrcPdu): PduRSrcPduRef=PduCollection/DCDC_2_Can_Network_CANNODE_0_CanIf2PduR
            DCDC_2_Can_Network_CANNODE_0_PduR2Com (PduRDestPdu): PduRTransmissionConfirmation=false, PduRDestPduRef=PduCollection/DCDC_2_Can_Network_CANNODE_0_PduR2Com
          Diag_BMS_REQ_Can_Network_CANNODE_0_CanTp2Dcm
            Diag_BMS_REQ_Can_Network_CANNODE_0_CanTp2PduR (PduRSrcPdu): PduRSrcPduRef=PduCollection/Diag_BMS_REQ_Can_Network_CANNODE_0_CanTp2PduR
            Diag_BMS_REQ_Can_Network_CANNODE_0_PduR2Dcm (PduRDestPdu): PduRTransmissionConfirmation=false, PduRDestPduRef=PduCollection/Diag_BMS_REQ_Can_Network_CANNODE_0_PduR2Dcm
          ICM_1_Can_Network_CANNODE_0_CanIf2Com
            ICM_1_Can_Network_CANNODE_0_CanIf2PduR (PduRSrcPdu): PduRSrcPduRef=PduCollection/ICM_1_Can_Network_CANNODE_0_CanIf2PduR
            ICM_1_Can_Network_CANNODE_0_PduR2Com (PduRDestPdu): PduRTransmissionConfirmation=false, PduRDestPduRef=PduCollection/ICM_1_Can_Network_CANNODE_0_PduR2Com
          HCU_7_Can_Network_CANNODE_0_CanIf2Com
            HCU_7_Can_Network_CANNODE_0_CanIf2PduR (PduRSrcPdu): PduRSrcPduRef=PduCollection/HCU_7_Can_Network_CANNODE_0_CanIf2PduR
            HCU_7_Can_Network_CANNODE_0_PduR2Com (PduRDestPdu): PduRTransmissionConfirmation=false, PduRDestPduRef=PduCollection/HCU_7_Can_Network_CANNODE_0_PduR2Com
          EMS_1_G_Can_Network_CANNODE_0_CanIf2Com
            EMS_1_G_Can_Network_CANNODE_0_CanIf2PduR (PduRSrcPdu): PduRSrcPduRef=PduCollection/EMS_1_G_Can_Network_CANNODE_0_CanIf2PduR
            EMS_1_G_Can_Network_CANNODE_0_PduR2Com (PduRDestPdu): PduRTransmissionConfirmation=false, PduRDestPduRef=PduCollection/EMS_1_G_Can_Network_CANNODE_0_PduR2Com
          DCDC_1_Can_Network_CANNODE_0_CanIf2Com
            DCDC_1_Can_Network_CANNODE_0_CanIf2PduR (PduRSrcPdu): PduRSrcPduRef=PduCollection/DCDC_1_Can_Network_CANNODE_0_CanIf2PduR
            DCDC_1_Can_Network_CANNODE_0_PduR2Com (PduRDestPdu): PduRTransmissionConfirmation=false, PduRDestPduRef=PduCollection/DCDC_1_Can_Network_CANNODE_0_PduR2Com
          DIAG_OBD_REQ_Broadcast_Can_Network_CANNODE_0_CanTp2Dcm
            DIAG_OBD_REQ_Broadcast_Can_Network_CANNODE_0_CanTp2PduR (PduRSrcPdu): PduRSrcPduRef=PduCollection/DIAG_OBD_REQ_Broadcast_Can_Network_CANNODE_0_CanTp2PduR
            DIAG_OBD_REQ_Broadcast_Can_Network_CANNODE_0_PduR2Dcm (PduRDestPdu): PduRTransmissionConfirmation=false, PduRDestPduRef=PduCollection/DIAG_OBD_REQ_Broadcast_Can_Network_CANNODE_0_PduR2Dcm
          ISGF_3_Can_Network_CANNODE_0_CanIf2Com
            ISGF_3_Can_Network_CANNODE_0_CanIf2PduR (PduRSrcPdu): PduRSrcPduRef=PduCollection/ISGF_3_Can_Network_CANNODE_0_CanIf2PduR
            ISGF_3_Can_Network_CANNODE_0_PduR2Com (PduRDestPdu): PduRTransmissionConfirmation=false, PduRDestPduRef=PduCollection/ISGF_3_Can_Network_CANNODE_0_PduR2Com
          TBOX_2_Can_Network_CANNODE_0_CanIf2Com
            TBOX_2_Can_Network_CANNODE_0_CanIf2PduR (PduRSrcPdu): PduRSrcPduRef=PduCollection/TBOX_2_Can_Network_CANNODE_0_CanIf2PduR
            TBOX_2_Can_Network_CANNODE_0_PduR2Com (PduRDestPdu): PduRTransmissionConfirmation=false, PduRDestPduRef=PduCollection/TBOX_2_Can_Network_CANNODE_0_PduR2Com
          ISGF_1_Can_Network_CANNODE_0_CanIf2Com
            ISGF_1_Can_Network_CANNODE_0_CanIf2PduR (PduRSrcPdu): PduRSrcPduRef=PduCollection/ISGF_1_Can_Network_CANNODE_0_CanIf2PduR
            ISGF_1_Can_Network_CANNODE_0_PduR2Com (PduRDestPdu): PduRTransmissionConfirmation=false, PduRDestPduRef=PduCollection/ISGF_1_Can_Network_CANNODE_0_PduR2Com
          OBC_3_Can_Network_CANNODE_0_CanIf2Com
            OBC_3_Can_Network_CANNODE_0_CanIf2PduR (PduRSrcPdu): PduRSrcPduRef=PduCollection/OBC_3_Can_Network_CANNODE_0_CanIf2PduR
            OBC_3_Can_Network_CANNODE_0_PduR2Com (PduRDestPdu): PduRTransmissionConfirmation=false, PduRDestPduRef=PduCollection/OBC_3_Can_Network_CANNODE_0_PduR2Com
          TMF_1_Can_Network_CANNODE_0_CanIf2Com
            TMF_1_Can_Network_CANNODE_0_CanIf2PduR (PduRSrcPdu): PduRSrcPduRef=PduCollection/TMF_1_Can_Network_CANNODE_0_CanIf2PduR
            TMF_1_Can_Network_CANNODE_0_PduR2Com (PduRDestPdu): PduRTransmissionConfirmation=false, PduRDestPduRef=PduCollection/TMF_1_Can_Network_CANNODE_0_PduR2Com
          ABM_1_Can_Network_CANNODE_0_CanIf2Com
            ABM_1_Can_Network_CANNODE_0_CanIf2PduR (PduRSrcPdu): PduRSrcPduRef=PduCollection/ABM_1_Can_Network_CANNODE_0_CanIf2PduR
            ABM_1_Can_Network_CANNODE_0_PduR2Com (PduRDestPdu): PduRTransmissionConfirmation=false, PduRDestPduRef=PduCollection/ABM_1_Can_Network_CANNODE_0_PduR2Com
          BMS_24_Can_Network_CANNODE_0_Com2CanIf
            BMS_24_Can_Network_CANNODE_0_Com2PduR (PduRSrcPdu): PduRSrcPduRef=PduCollection/BMS_24_Can_Network_CANNODE_0_Com2PduR
            BMS_24_Can_Network_CANNODE_0_PduR2CanIf (PduRDestPdu): PduRTransmissionConfirmation=false, PduRDestPduRef=PduCollection/BMS_24_Can_Network_CANNODE_0_PduR2CanIf
          BMS_Tem_6_Can_Network_CANNODE_0_Com2CanIf
            BMS_Tem_6_Can_Network_CANNODE_0_Com2PduR (PduRSrcPdu): PduRSrcPduRef=PduCollection/BMS_Tem_6_Can_Network_CANNODE_0_Com2PduR
            BMS_Tem_6_Can_Network_CANNODE_0_PduR2CanIf (PduRDestPdu): PduRTransmissionConfirmation=false, PduRDestPduRef=PduCollection/BMS_Tem_6_Can_Network_CANNODE_0_PduR2CanIf
          BMS_Tem_5_Can_Network_CANNODE_0_Com2CanIf
            BMS_Tem_5_Can_Network_CANNODE_0_Com2PduR (PduRSrcPdu): PduRSrcPduRef=PduCollection/BMS_Tem_5_Can_Network_CANNODE_0_Com2PduR
            BMS_Tem_5_Can_Network_CANNODE_0_PduR2CanIf (PduRDestPdu): PduRTransmissionConfirmation=false, PduRDestPduRef=PduCollection/BMS_Tem_5_Can_Network_CANNODE_0_PduR2CanIf
          BMS_19_Can_Network_CANNODE_0_Com2CanIf
            BMS_19_Can_Network_CANNODE_0_Com2PduR (PduRSrcPdu): PduRSrcPduRef=PduCollection/BMS_19_Can_Network_CANNODE_0_Com2PduR
            BMS_19_Can_Network_CANNODE_0_PduR2CanIf (PduRDestPdu): PduRTransmissionConfirmation=false, PduRDestPduRef=PduCollection/BMS_19_Can_Network_CANNODE_0_PduR2CanIf
          Diag_BMS_RES_Can_Network_CANNODE_0_Dcm2CanTp
            Diag_BMS_RES_Can_Network_CANNODE_0_Phys_Dcm2PduR (PduRSrcPdu): PduRSrcPduRef=PduCollection/Diag_BMS_RES_Can_Network_CANNODE_0_Phys_Dcm2PduR
            Diag_BMS_RES_Can_Network_CANNODE_0_Phys_PduR2CanTp (PduRDestPdu): PduRTransmissionConfirmation=false, PduRDestPduRef=PduCollection/Diag_BMS_RES_Can_Network_CANNODE_0_Phys_PduR2CanTp
          BMS_18_Can_Network_CANNODE_0_Com2CanIf
            BMS_18_Can_Network_CANNODE_0_Com2PduR (PduRSrcPdu): PduRSrcPduRef=PduCollection/BMS_18_Can_Network_CANNODE_0_Com2PduR
            BMS_18_Can_Network_CANNODE_0_PduR2CanIf (PduRDestPdu): PduRTransmissionConfirmation=false, PduRDestPduRef=PduCollection/BMS_18_Can_Network_CANNODE_0_PduR2CanIf
          BMS_17_Can_Network_CANNODE_0_Com2CanIf
            BMS_17_Can_Network_CANNODE_0_Com2PduR (PduRSrcPdu): PduRSrcPduRef=PduCollection/BMS_17_Can_Network_CANNODE_0_Com2PduR
            BMS_17_Can_Network_CANNODE_0_PduR2CanIf (PduRDestPdu): PduRTransmissionConfirmation=false, PduRDestPduRef=PduCollection/BMS_17_Can_Network_CANNODE_0_PduR2CanIf
          BMS_Tem_4_Can_Network_CANNODE_0_Com2CanIf
            BMS_Tem_4_Can_Network_CANNODE_0_Com2PduR (PduRSrcPdu): PduRSrcPduRef=PduCollection/BMS_Tem_4_Can_Network_CANNODE_0_Com2PduR
            BMS_Tem_4_Can_Network_CANNODE_0_PduR2CanIf (PduRDestPdu): PduRTransmissionConfirmation=false, PduRDestPduRef=PduCollection/BMS_Tem_4_Can_Network_CANNODE_0_PduR2CanIf
          BMS_Tem_3_Can_Network_CANNODE_0_Com2CanIf
            BMS_Tem_3_Can_Network_CANNODE_0_Com2PduR (PduRSrcPdu): PduRSrcPduRef=PduCollection/BMS_Tem_3_Can_Network_CANNODE_0_Com2PduR
            BMS_Tem_3_Can_Network_CANNODE_0_PduR2CanIf (PduRDestPdu): PduRTransmissionConfirmation=false, PduRDestPduRef=PduCollection/BMS_Tem_3_Can_Network_CANNODE_0_PduR2CanIf
          BMS_16_Can_Network_CANNODE_0_Com2CanIf
            BMS_16_Can_Network_CANNODE_0_Com2PduR (PduRSrcPdu): PduRSrcPduRef=PduCollection/BMS_16_Can_Network_CANNODE_0_Com2PduR
            BMS_16_Can_Network_CANNODE_0_PduR2CanIf (PduRDestPdu): PduRTransmissionConfirmation=false, PduRDestPduRef=PduCollection/BMS_16_Can_Network_CANNODE_0_PduR2CanIf
          BMS_Tem_2_Can_Network_CANNODE_0_Com2CanIf
            BMS_Tem_2_Can_Network_CANNODE_0_Com2PduR (PduRSrcPdu): PduRSrcPduRef=PduCollection/BMS_Tem_2_Can_Network_CANNODE_0_Com2PduR
            BMS_Tem_2_Can_Network_CANNODE_0_PduR2CanIf (PduRDestPdu): PduRTransmissionConfirmation=false, PduRDestPduRef=PduCollection/BMS_Tem_2_Can_Network_CANNODE_0_PduR2CanIf
          BMS_15_Can_Network_CANNODE_0_Com2CanIf
            BMS_15_Can_Network_CANNODE_0_Com2PduR (PduRSrcPdu): PduRSrcPduRef=PduCollection/BMS_15_Can_Network_CANNODE_0_Com2PduR
            BMS_15_Can_Network_CANNODE_0_PduR2CanIf (PduRDestPdu): PduRTransmissionConfirmation=false, PduRDestPduRef=PduCollection/BMS_15_Can_Network_CANNODE_0_PduR2CanIf
          BMS_Tem_1_Can_Network_CANNODE_0_Com2CanIf
            BMS_Tem_1_Can_Network_CANNODE_0_Com2PduR (PduRSrcPdu): PduRSrcPduRef=PduCollection/BMS_Tem_1_Can_Network_CANNODE_0_Com2PduR
            BMS_Tem_1_Can_Network_CANNODE_0_PduR2CanIf (PduRDestPdu): PduRTransmissionConfirmation=false, PduRDestPduRef=PduCollection/BMS_Tem_1_Can_Network_CANNODE_0_PduR2CanIf
          BMS_14_Can_Network_CANNODE_0_Com2CanIf
            BMS_14_Can_Network_CANNODE_0_Com2PduR (PduRSrcPdu): PduRSrcPduRef=PduCollection/BMS_14_Can_Network_CANNODE_0_Com2PduR
            BMS_14_Can_Network_CANNODE_0_PduR2CanIf (PduRDestPdu): PduRTransmissionConfirmation=false, PduRDestPduRef=PduCollection/BMS_14_Can_Network_CANNODE_0_PduR2CanIf
          BMS_Vol_9_Can_Network_CANNODE_0_Com2CanIf
            BMS_Vol_9_Can_Network_CANNODE_0_Com2PduR (PduRSrcPdu): PduRSrcPduRef=PduCollection/BMS_Vol_9_Can_Network_CANNODE_0_Com2PduR
            BMS_Vol_9_Can_Network_CANNODE_0_PduR2CanIf (PduRDestPdu): PduRTransmissionConfirmation=false, PduRDestPduRef=PduCollection/BMS_Vol_9_Can_Network_CANNODE_0_PduR2CanIf
          BMS_21_Can_Network_CANNODE_0_Com2CanIf
            BMS_21_Can_Network_CANNODE_0_Com2PduR (PduRSrcPdu): PduRSrcPduRef=PduCollection/BMS_21_Can_Network_CANNODE_0_Com2PduR
            BMS_21_Can_Network_CANNODE_0_PduR2CanIf (PduRDestPdu): PduRTransmissionConfirmation=false, PduRDestPduRef=PduCollection/BMS_21_Can_Network_CANNODE_0_PduR2CanIf
          BMS_Vol_8_Can_Network_CANNODE_0_Com2CanIf
            BMS_Vol_8_Can_Network_CANNODE_0_Com2PduR (PduRSrcPdu): PduRSrcPduRef=PduCollection/BMS_Vol_8_Can_Network_CANNODE_0_Com2PduR
            BMS_Vol_8_Can_Network_CANNODE_0_PduR2CanIf (PduRDestPdu): PduRTransmissionConfirmation=false, PduRDestPduRef=PduCollection/BMS_Vol_8_Can_Network_CANNODE_0_PduR2CanIf
          BMS_20_Can_Network_CANNODE_0_Com2CanIf
            BMS_20_Can_Network_CANNODE_0_Com2PduR (PduRSrcPdu): PduRSrcPduRef=PduCollection/BMS_20_Can_Network_CANNODE_0_Com2PduR
            BMS_20_Can_Network_CANNODE_0_PduR2CanIf (PduRDestPdu): PduRTransmissionConfirmation=false, PduRDestPduRef=PduCollection/BMS_20_Can_Network_CANNODE_0_PduR2CanIf
          BMS_Vol_7_Can_Network_CANNODE_0_Com2CanIf
            BMS_Vol_7_Can_Network_CANNODE_0_Com2PduR (PduRSrcPdu): PduRSrcPduRef=PduCollection/BMS_Vol_7_Can_Network_CANNODE_0_Com2PduR
            BMS_Vol_7_Can_Network_CANNODE_0_PduR2CanIf (PduRDestPdu): PduRTransmissionConfirmation=false, PduRDestPduRef=PduCollection/BMS_Vol_7_Can_Network_CANNODE_0_PduR2CanIf
          BMS_Vol_6_Can_Network_CANNODE_0_Com2CanIf
            BMS_Vol_6_Can_Network_CANNODE_0_Com2PduR (PduRSrcPdu): PduRSrcPduRef=PduCollection/BMS_Vol_6_Can_Network_CANNODE_0_Com2PduR
            BMS_Vol_6_Can_Network_CANNODE_0_PduR2CanIf (PduRDestPdu): PduRTransmissionConfirmation=false, PduRDestPduRef=PduCollection/BMS_Vol_6_Can_Network_CANNODE_0_PduR2CanIf
          BMS_Vol_5_Can_Network_CANNODE_0_Com2CanIf
            BMS_Vol_5_Can_Network_CANNODE_0_Com2PduR (PduRSrcPdu): PduRSrcPduRef=PduCollection/BMS_Vol_5_Can_Network_CANNODE_0_Com2PduR
            BMS_Vol_5_Can_Network_CANNODE_0_PduR2CanIf (PduRDestPdu): PduRTransmissionConfirmation=false, PduRDestPduRef=PduCollection/BMS_Vol_5_Can_Network_CANNODE_0_PduR2CanIf
          BMS_Vol_4_Can_Network_CANNODE_0_Com2CanIf
            BMS_Vol_4_Can_Network_CANNODE_0_Com2PduR (PduRSrcPdu): PduRSrcPduRef=PduCollection/BMS_Vol_4_Can_Network_CANNODE_0_Com2PduR
            BMS_Vol_4_Can_Network_CANNODE_0_PduR2CanIf (PduRDestPdu): PduRTransmissionConfirmation=false, PduRDestPduRef=PduCollection/BMS_Vol_4_Can_Network_CANNODE_0_PduR2CanIf
          BMS_Vol_3_Can_Network_CANNODE_0_Com2CanIf
            BMS_Vol_3_Can_Network_CANNODE_0_Com2PduR (PduRSrcPdu): PduRSrcPduRef=PduCollection/BMS_Vol_3_Can_Network_CANNODE_0_Com2PduR
            BMS_Vol_3_Can_Network_CANNODE_0_PduR2CanIf (PduRDestPdu): PduRTransmissionConfirmation=false, PduRDestPduRef=PduCollection/BMS_Vol_3_Can_Network_CANNODE_0_PduR2CanIf
          BMS_8_Can_Network_CANNODE_0_Com2CanIf
            BMS_8_Can_Network_CANNODE_0_Com2PduR (PduRSrcPdu): PduRSrcPduRef=PduCollection/BMS_8_Can_Network_CANNODE_0_Com2PduR
            BMS_8_Can_Network_CANNODE_0_PduR2CanIf (PduRDestPdu): PduRTransmissionConfirmation=false, PduRDestPduRef=PduCollection/BMS_8_Can_Network_CANNODE_0_PduR2CanIf
          BMS_Vol_2_Can_Network_CANNODE_0_Com2CanIf
            BMS_Vol_2_Can_Network_CANNODE_0_Com2PduR (PduRSrcPdu): PduRSrcPduRef=PduCollection/BMS_Vol_2_Can_Network_CANNODE_0_Com2PduR
            BMS_Vol_2_Can_Network_CANNODE_0_PduR2CanIf (PduRDestPdu): PduRTransmissionConfirmation=false, PduRDestPduRef=PduCollection/BMS_Vol_2_Can_Network_CANNODE_0_PduR2CanIf
          BMS_Vol_1_Can_Network_CANNODE_0_Com2CanIf
            BMS_Vol_1_Can_Network_CANNODE_0_Com2PduR (PduRSrcPdu): PduRSrcPduRef=PduCollection/BMS_Vol_1_Can_Network_CANNODE_0_Com2PduR
            BMS_Vol_1_Can_Network_CANNODE_0_PduR2CanIf (PduRDestPdu): PduRTransmissionConfirmation=false, PduRDestPduRef=PduCollection/BMS_Vol_1_Can_Network_CANNODE_0_PduR2CanIf
          BMS_1_Can_Network_CANNODE_0_Com2CanIf
            BMS_1_Can_Network_CANNODE_0_Com2PduR (PduRSrcPdu): PduRSrcPduRef=PduCollection/BMS_1_Can_Network_CANNODE_0_Com2PduR
            BMS_1_Can_Network_CANNODE_0_PduR2CanIf (PduRDestPdu): PduRTransmissionConfirmation=false, PduRDestPduRef=PduCollection/BMS_1_Can_Network_CANNODE_0_PduR2CanIf
          BMS_Vol_20_Can_Network_CANNODE_0_Com2CanIf
            BMS_Vol_20_Can_Network_CANNODE_0_Com2PduR (PduRSrcPdu): PduRSrcPduRef=PduCollection/BMS_Vol_20_Can_Network_CANNODE_0_Com2PduR
            BMS_Vol_20_Can_Network_CANNODE_0_PduR2CanIf (PduRDestPdu): PduRTransmissionConfirmation=false, PduRDestPduRef=PduCollection/BMS_Vol_20_Can_Network_CANNODE_0_PduR2CanIf
          BMS_Vol_19_Can_Network_CANNODE_0_Com2CanIf
            BMS_Vol_19_Can_Network_CANNODE_0_Com2PduR (PduRSrcPdu): PduRSrcPduRef=PduCollection/BMS_Vol_19_Can_Network_CANNODE_0_Com2PduR
            BMS_Vol_19_Can_Network_CANNODE_0_PduR2CanIf (PduRDestPdu): PduRTransmissionConfirmation=false, PduRDestPduRef=PduCollection/BMS_Vol_19_Can_Network_CANNODE_0_PduR2CanIf
          BMS_Vol_18_Can_Network_CANNODE_0_Com2CanIf
            BMS_Vol_18_Can_Network_CANNODE_0_Com2PduR (PduRSrcPdu): PduRSrcPduRef=PduCollection/BMS_Vol_18_Can_Network_CANNODE_0_Com2PduR
            BMS_Vol_18_Can_Network_CANNODE_0_PduR2CanIf (PduRDestPdu): PduRTransmissionConfirmation=false, PduRDestPduRef=PduCollection/BMS_Vol_18_Can_Network_CANNODE_0_PduR2CanIf
          BMS_Vol_17_Can_Network_CANNODE_0_Com2CanIf
            BMS_Vol_17_Can_Network_CANNODE_0_Com2PduR (PduRSrcPdu): PduRSrcPduRef=PduCollection/BMS_Vol_17_Can_Network_CANNODE_0_Com2PduR
            BMS_Vol_17_Can_Network_CANNODE_0_PduR2CanIf (PduRDestPdu): PduRTransmissionConfirmation=false, PduRDestPduRef=PduCollection/BMS_Vol_17_Can_Network_CANNODE_0_PduR2CanIf
          BMS_5_Can_Network_CANNODE_0_Com2CanIf
            BMS_5_Can_Network_CANNODE_0_Com2PduR (PduRSrcPdu): PduRSrcPduRef=PduCollection/BMS_5_Can_Network_CANNODE_0_Com2PduR
            BMS_5_Can_Network_CANNODE_0_PduR2CanIf (PduRDestPdu): PduRTransmissionConfirmation=false, PduRDestPduRef=PduCollection/BMS_5_Can_Network_CANNODE_0_PduR2CanIf
          BMS_9_Can_Network_CANNODE_0_Com2CanIf
            BMS_9_Can_Network_CANNODE_0_Com2PduR (PduRSrcPdu): PduRSrcPduRef=PduCollection/BMS_9_Can_Network_CANNODE_0_Com2PduR
            BMS_9_Can_Network_CANNODE_0_PduR2CanIf (PduRDestPdu): PduRTransmissionConfirmation=false, PduRDestPduRef=PduCollection/BMS_9_Can_Network_CANNODE_0_PduR2CanIf
          BMS_Vol_16_Can_Network_CANNODE_0_Com2CanIf
            BMS_Vol_16_Can_Network_CANNODE_0_Com2PduR (PduRSrcPdu): PduRSrcPduRef=PduCollection/BMS_Vol_16_Can_Network_CANNODE_0_Com2PduR
            BMS_Vol_16_Can_Network_CANNODE_0_PduR2CanIf (PduRDestPdu): PduRTransmissionConfirmation=false, PduRDestPduRef=PduCollection/BMS_Vol_16_Can_Network_CANNODE_0_PduR2CanIf
          BMS_Vol_15_Can_Network_CANNODE_0_Com2CanIf
            BMS_Vol_15_Can_Network_CANNODE_0_Com2PduR (PduRSrcPdu): PduRSrcPduRef=PduCollection/BMS_Vol_15_Can_Network_CANNODE_0_Com2PduR
            BMS_Vol_15_Can_Network_CANNODE_0_PduR2CanIf (PduRDestPdu): PduRTransmissionConfirmation=false, PduRDestPduRef=PduCollection/BMS_Vol_15_Can_Network_CANNODE_0_PduR2CanIf
          BMS_Vol_14_Can_Network_CANNODE_0_Com2CanIf
            BMS_Vol_14_Can_Network_CANNODE_0_Com2PduR (PduRSrcPdu): PduRSrcPduRef=PduCollection/BMS_Vol_14_Can_Network_CANNODE_0_Com2PduR
            BMS_Vol_14_Can_Network_CANNODE_0_PduR2CanIf (PduRDestPdu): PduRTransmissionConfirmation=false, PduRDestPduRef=PduCollection/BMS_Vol_14_Can_Network_CANNODE_0_PduR2CanIf
          BMS_2_Can_Network_CANNODE_0_Com2CanIf
            BMS_2_Can_Network_CANNODE_0_Com2PduR (PduRSrcPdu): PduRSrcPduRef=PduCollection/BMS_2_Can_Network_CANNODE_0_Com2PduR
            BMS_2_Can_Network_CANNODE_0_PduR2CanIf (PduRDestPdu): PduRTransmissionConfirmation=false, PduRDestPduRef=PduCollection/BMS_2_Can_Network_CANNODE_0_PduR2CanIf
          BMS_Vol_13_Can_Network_CANNODE_0_Com2CanIf
            BMS_Vol_13_Can_Network_CANNODE_0_Com2PduR (PduRSrcPdu): PduRSrcPduRef=PduCollection/BMS_Vol_13_Can_Network_CANNODE_0_Com2PduR
            BMS_Vol_13_Can_Network_CANNODE_0_PduR2CanIf (PduRDestPdu): PduRTransmissionConfirmation=false, PduRDestPduRef=PduCollection/BMS_Vol_13_Can_Network_CANNODE_0_PduR2CanIf
          BMS_Vol_12_Can_Network_CANNODE_0_Com2CanIf
            BMS_Vol_12_Can_Network_CANNODE_0_Com2PduR (PduRSrcPdu): PduRSrcPduRef=PduCollection/BMS_Vol_12_Can_Network_CANNODE_0_Com2PduR
            BMS_Vol_12_Can_Network_CANNODE_0_PduR2CanIf (PduRDestPdu): PduRTransmissionConfirmation=false, PduRDestPduRef=PduCollection/BMS_Vol_12_Can_Network_CANNODE_0_PduR2CanIf
          BMS_23_Can_Network_CANNODE_0_Com2CanIf
            BMS_23_Can_Network_CANNODE_0_Com2PduR (PduRSrcPdu): PduRSrcPduRef=PduCollection/BMS_23_Can_Network_CANNODE_0_Com2PduR
            BMS_23_Can_Network_CANNODE_0_PduR2CanIf (PduRDestPdu): PduRTransmissionConfirmation=false, PduRDestPduRef=PduCollection/BMS_23_Can_Network_CANNODE_0_PduR2CanIf
          BMS_Vol_11_Can_Network_CANNODE_0_Com2CanIf
            BMS_Vol_11_Can_Network_CANNODE_0_Com2PduR (PduRSrcPdu): PduRSrcPduRef=PduCollection/BMS_Vol_11_Can_Network_CANNODE_0_Com2PduR
            BMS_Vol_11_Can_Network_CANNODE_0_PduR2CanIf (PduRDestPdu): PduRTransmissionConfirmation=false, PduRDestPduRef=PduCollection/BMS_Vol_11_Can_Network_CANNODE_0_PduR2CanIf
          BMS_25_Can_Network_CANNODE_0_Com2CanIf
            BMS_25_Can_Network_CANNODE_0_Com2PduR (PduRSrcPdu): PduRSrcPduRef=PduCollection/BMS_25_Can_Network_CANNODE_0_Com2PduR
            BMS_25_Can_Network_CANNODE_0_PduR2CanIf (PduRDestPdu): PduRTransmissionConfirmation=false, PduRDestPduRef=PduCollection/BMS_25_Can_Network_CANNODE_0_PduR2CanIf
          BMS_Vol_10_Can_Network_CANNODE_0_Com2CanIf
            BMS_Vol_10_Can_Network_CANNODE_0_Com2PduR (PduRSrcPdu): PduRSrcPduRef=PduCollection/BMS_Vol_10_Can_Network_CANNODE_0_Com2PduR
            BMS_Vol_10_Can_Network_CANNODE_0_PduR2CanIf (PduRDestPdu): PduRTransmissionConfirmation=false, PduRDestPduRef=PduCollection/BMS_Vol_10_Can_Network_CANNODE_0_PduR2CanIf
          BMS_22_Can_Network_CANNODE_0_Com2CanIf
            BMS_22_Can_Network_CANNODE_0_Com2PduR (PduRSrcPdu): PduRSrcPduRef=PduCollection/BMS_22_Can_Network_CANNODE_0_Com2PduR
            BMS_22_Can_Network_CANNODE_0_PduR2CanIf (PduRDestPdu): PduRTransmissionConfirmation=false, PduRDestPduRef=PduCollection/BMS_22_Can_Network_CANNODE_0_PduR2CanIf
          BMS_6_Can_Network_CANNODE_0_Com2CanIf
            BMS_6_Can_Network_CANNODE_0_Com2PduR (PduRSrcPdu): PduRSrcPduRef=PduCollection/BMS_6_Can_Network_CANNODE_0_Com2PduR
            BMS_6_Can_Network_CANNODE_0_PduR2CanIf (PduRDestPdu): PduRTransmissionConfirmation=false, PduRDestPduRef=PduCollection/BMS_6_Can_Network_CANNODE_0_PduR2CanIf
          BMS_13_Can_Network_CANNODE_0_Com2CanIf
            BMS_13_Can_Network_CANNODE_0_Com2PduR (PduRSrcPdu): PduRSrcPduRef=PduCollection/BMS_13_Can_Network_CANNODE_0_Com2PduR
            BMS_13_Can_Network_CANNODE_0_PduR2CanIf (PduRDestPdu): PduRTransmissionConfirmation=false, PduRDestPduRef=PduCollection/BMS_13_Can_Network_CANNODE_0_PduR2CanIf
          BMS_12_Can_Network_CANNODE_0_Com2CanIf
            BMS_12_Can_Network_CANNODE_0_Com2PduR (PduRSrcPdu): PduRSrcPduRef=PduCollection/BMS_12_Can_Network_CANNODE_0_Com2PduR
            BMS_12_Can_Network_CANNODE_0_PduR2CanIf (PduRDestPdu): PduRTransmissionConfirmation=false, PduRDestPduRef=PduCollection/BMS_12_Can_Network_CANNODE_0_PduR2CanIf
          BMS_7_Can_Network_CANNODE_0_Com2CanIf
            BMS_7_Can_Network_CANNODE_0_Com2PduR (PduRSrcPdu): PduRSrcPduRef=PduCollection/BMS_7_Can_Network_CANNODE_0_Com2PduR
            BMS_7_Can_Network_CANNODE_0_PduR2CanIf (PduRDestPdu): PduRTransmissionConfirmation=false, PduRDestPduRef=PduCollection/BMS_7_Can_Network_CANNODE_0_PduR2CanIf
          BMS_10_Can_Network_CANNODE_0_Com2CanIf
            BMS_10_Can_Network_CANNODE_0_Com2PduR (PduRSrcPdu): PduRSrcPduRef=PduCollection/BMS_10_Can_Network_CANNODE_0_Com2PduR
            BMS_10_Can_Network_CANNODE_0_PduR2CanIf (PduRDestPdu): PduRTransmissionConfirmation=false, PduRDestPduRef=PduCollection/BMS_10_Can_Network_CANNODE_0_PduR2CanIf
          BMS_3_Can_Network_CANNODE_0_Com2CanIf
            BMS_3_Can_Network_CANNODE_0_Com2PduR (PduRSrcPdu): PduRSrcPduRef=PduCollection/BMS_3_Can_Network_CANNODE_0_Com2PduR
            BMS_3_Can_Network_CANNODE_0_PduR2CanIf (PduRDestPdu): PduRTransmissionConfirmation=false, PduRDestPduRef=PduCollection/BMS_3_Can_Network_CANNODE_0_PduR2CanIf
          BMS_Vol_24_Can_Network_CANNODE_0_Com2CanIf
            BMS_Vol_24_Can_Network_CANNODE_0_Com2PduR (PduRSrcPdu): PduRSrcPduRef=PduCollection/BMS_Vol_24_Can_Network_CANNODE_0_Com2PduR
            BMS_Vol_24_Can_Network_CANNODE_0_PduR2CanIf (PduRDestPdu): PduRTransmissionConfirmation=false, PduRDestPduRef=PduCollection/BMS_Vol_24_Can_Network_CANNODE_0_PduR2CanIf
          BMS_Vol_23_Can_Network_CANNODE_0_Com2CanIf
            BMS_Vol_23_Can_Network_CANNODE_0_Com2PduR (PduRSrcPdu): PduRSrcPduRef=PduCollection/BMS_Vol_23_Can_Network_CANNODE_0_Com2PduR
            BMS_Vol_23_Can_Network_CANNODE_0_PduR2CanIf (PduRDestPdu): PduRTransmissionConfirmation=false, PduRDestPduRef=PduCollection/BMS_Vol_23_Can_Network_CANNODE_0_PduR2CanIf
          BMS_Vol_22_Can_Network_CANNODE_0_Com2CanIf
            BMS_Vol_22_Can_Network_CANNODE_0_Com2PduR (PduRSrcPdu): PduRSrcPduRef=PduCollection/BMS_Vol_22_Can_Network_CANNODE_0_Com2PduR
            BMS_Vol_22_Can_Network_CANNODE_0_PduR2CanIf (PduRDestPdu): PduRTransmissionConfirmation=false, PduRDestPduRef=PduCollection/BMS_Vol_22_Can_Network_CANNODE_0_PduR2CanIf
          BMS_Vol_21_Can_Network_CANNODE_0_Com2CanIf
            BMS_Vol_21_Can_Network_CANNODE_0_Com2PduR (PduRSrcPdu): PduRSrcPduRef=PduCollection/BMS_Vol_21_Can_Network_CANNODE_0_Com2PduR
            BMS_Vol_21_Can_Network_CANNODE_0_PduR2CanIf (PduRDestPdu): PduRTransmissionConfirmation=false, PduRDestPduRef=PduCollection/BMS_Vol_21_Can_Network_CANNODE_0_PduR2CanIf
          BMS_4_Can_Network_CANNODE_0_Com2CanIf
            BMS_4_Can_Network_CANNODE_0_Com2PduR (PduRSrcPdu): PduRSrcPduRef=PduCollection/BMS_4_Can_Network_CANNODE_0_Com2PduR
            BMS_4_Can_Network_CANNODE_0_PduR2CanIf (PduRDestPdu): PduRTransmissionConfirmation=false, PduRDestPduRef=PduCollection/BMS_4_Can_Network_CANNODE_0_PduR2CanIf
          BMS_11_Can_Network_CANNODE_0_Com2CanIf
            BMS_11_Can_Network_CANNODE_0_Com2PduR (PduRSrcPdu): PduRSrcPduRef=PduCollection/BMS_11_Can_Network_CANNODE_0_Com2PduR
            BMS_11_Can_Network_CANNODE_0_PduR2CanIf (PduRDestPdu): PduRTransmissionConfirmation=false, PduRDestPduRef=PduCollection/BMS_11_Can_Network_CANNODE_0_PduR2CanIf
    4 x PduRBswModules, all with PduRCancelReceive=0, PduRChangeParameterApi=0, PduRRetransmission=0, PduRUseTag=0:
      CanIf: PduRCancelTransmit=0, PduRCommunicationInterface=1, PduRLowerModule=1, PduRTransportProtocol=0, PduRTriggertransmit=0, PduRTxConfirmation=1, PduRUpperModule=0, PduRBswModuleRef=CanIf
      Com: PduRCancelTransmit=0, PduRCommunicationInterface=1, PduRLowerModule=0, PduRTransportProtocol=1, PduRTriggertransmit=1, PduRTxConfirmation=0, PduRUpperModule=1, PduRBswModuleRef=Com
      CanTp: PduRCancelTransmit=1, PduRCommunicationInterface=0, PduRLowerModule=1, PduRTransportProtocol=1, PduRTriggertransmit=0, PduRTxConfirmation=1, PduRUpperModule=0
        PduRInvalidHandlers: PduRIHCancelReceive=false, PduRIHCancelTransmit=false
      Dcm: PduRCancelTransmit=1, PduRCommunicationInterface=0, PduRLowerModule=0, PduRTransportProtocol=1, PduRTriggertransmit=0, PduRTxConfirmation=1, PduRUpperModule=1
  module config EcuC: implementation-config-variant=VARIANT-PRE-COMPILE
    EcucConfigSet
      PduCollection (EcucPduCollection): PduIdTypeEnum=uint16, PduLengthTypeEnum=uint16
        165 x Pdu:
          TMR_3_Can_Network_CANNODE_0_CanIf2PduR: PduLength=8
          TMR_3_Can_Network_CANNODE_0_PduR2Com: PduLength=8
          EMS_4_G_Can_Network_CANNODE_0_CanIf2PduR: PduLength=8
          EMS_4_G_Can_Network_CANNODE_0_PduR2Com: PduLength=8
          OBC_2_Can_Network_CANNODE_0_CanIf2PduR: PduLength=8
          OBC_2_Can_Network_CANNODE_0_PduR2Com: PduLength=8
          OBC_4_Can_Network_CANNODE_0_CanIf2PduR: PduLength=8
          OBC_4_Can_Network_CANNODE_0_PduR2Com: PduLength=8
          ABS_ESP_G_Can_Network_CANNODE_0_CanIf2PduR: PduLength=7
          ABS_ESP_G_Can_Network_CANNODE_0_PduR2Com: PduLength=7
          TMR_1_Can_Network_CANNODE_0_CanIf2PduR: PduLength=8
          TMR_1_Can_Network_CANNODE_0_PduR2Com: PduLength=8
          OBC_1_Can_Network_CANNODE_0_CanIf2PduR: PduLength=8
          OBC_1_Can_Network_CANNODE_0_PduR2Com: PduLength=8
          TMF_3_Can_Network_CANNODE_0_CanIf2PduR: PduLength=8
          TMF_3_Can_Network_CANNODE_0_PduR2Com: PduLength=8
          EMS_28_Can_Network_CANNODE_0_CanIf2PduR: PduLength=8
          EMS_28_Can_Network_CANNODE_0_PduR2Com: PduLength=8
          CLM_2_Can_Network_CANNODE_0_CanIf2PduR: PduLength=8
          CLM_2_Can_Network_CANNODE_0_PduR2Com: PduLength=8
          HCU_1_G_Can_Network_CANNODE_0_CanIf2PduR: PduLength=8
          HCU_1_G_Can_Network_CANNODE_0_PduR2Com: PduLength=8
          TBOX_3_Can_Network_CANNODE_0_CanIf2PduR: PduLength=8
          TBOX_3_Can_Network_CANNODE_0_PduR2Com: PduLength=8
          DCDC_2_Can_Network_CANNODE_0_CanIf2PduR: PduLength=8
          DCDC_2_Can_Network_CANNODE_0_PduR2Com: PduLength=8
          Diag_BMS_REQ_Can_Network_CANNODE_0_CanIf2CanTp: PduLength=8
          Diag_BMS_REQ_Can_Network_CANNODE_0_CanTp2PduR: PduLength=8
          Diag_BMS_REQ_Can_Network_CANNODE_0_PduR2Dcm: PduLength=8
          ICM_1_Can_Network_CANNODE_0_CanIf2PduR: PduLength=8
          ICM_1_Can_Network_CANNODE_0_PduR2Com: PduLength=8
          HCU_7_Can_Network_CANNODE_0_CanIf2PduR: PduLength=8
          HCU_7_Can_Network_CANNODE_0_PduR2Com: PduLength=8
          EMS_1_G_Can_Network_CANNODE_0_CanIf2PduR: PduLength=8
          EMS_1_G_Can_Network_CANNODE_0_PduR2Com: PduLength=8
          DCDC_1_Can_Network_CANNODE_0_CanIf2PduR: PduLength=8
          DCDC_1_Can_Network_CANNODE_0_PduR2Com: PduLength=8
          DIAG_OBD_REQ_Broadcast_Can_Network_CANNODE_0_CanIf2CanTp: PduLength=8
          DIAG_OBD_REQ_Broadcast_Can_Network_CANNODE_0_CanTp2PduR: PduLength=8
          DIAG_OBD_REQ_Broadcast_Can_Network_CANNODE_0_PduR2Dcm: PduLength=8
          ISGF_3_Can_Network_CANNODE_0_CanIf2PduR: PduLength=8
          ISGF_3_Can_Network_CANNODE_0_PduR2Com: PduLength=8
          TBOX_2_Can_Network_CANNODE_0_CanIf2PduR: PduLength=8
          TBOX_2_Can_Network_CANNODE_0_PduR2Com: PduLength=8
          ISGF_1_Can_Network_CANNODE_0_CanIf2PduR: PduLength=8
          ISGF_1_Can_Network_CANNODE_0_PduR2Com: PduLength=8
          OBC_3_Can_Network_CANNODE_0_CanIf2PduR: PduLength=8
          OBC_3_Can_Network_CANNODE_0_PduR2Com: PduLength=8
          TMF_1_Can_Network_CANNODE_0_CanIf2PduR: PduLength=8
          TMF_1_Can_Network_CANNODE_0_PduR2Com: PduLength=8
          ABM_1_Can_Network_CANNODE_0_CanIf2PduR: PduLength=4
          ABM_1_Can_Network_CANNODE_0_PduR2Com: PduLength=4
          BMS_24_Can_Network_CANNODE_0_Com2PduR: PduLength=8
          BMS_24_Can_Network_CANNODE_0_PduR2CanIf: PduLength=8
          BMS_Tem_6_Can_Network_CANNODE_0_Com2PduR: PduLength=8
          BMS_Tem_6_Can_Network_CANNODE_0_PduR2CanIf: PduLength=8
          BMS_Tem_5_Can_Network_CANNODE_0_Com2PduR: PduLength=8
          BMS_Tem_5_Can_Network_CANNODE_0_PduR2CanIf: PduLength=8
          BMS_19_Can_Network_CANNODE_0_Com2PduR: PduLength=8
          BMS_19_Can_Network_CANNODE_0_PduR2CanIf: PduLength=8
          Diag_BMS_RES_Can_Network_CANNODE_0_Phys_Dcm2PduR: PduLength=8
          Diag_BMS_RES_Can_Network_CANNODE_0_Phys_PduR2CanTp: PduLength=8
          Diag_BMS_RES_Can_Network_CANNODE_0_Phys_CanTp2CanIf: PduLength=8
          BMS_18_Can_Network_CANNODE_0_Com2PduR: PduLength=8
          BMS_18_Can_Network_CANNODE_0_PduR2CanIf: PduLength=8
          BMS_17_Can_Network_CANNODE_0_Com2PduR: PduLength=8
          BMS_17_Can_Network_CANNODE_0_PduR2CanIf: PduLength=8
          BMS_Tem_4_Can_Network_CANNODE_0_Com2PduR: PduLength=8
          BMS_Tem_4_Can_Network_CANNODE_0_PduR2CanIf: PduLength=8
          BMS_Tem_3_Can_Network_CANNODE_0_Com2PduR: PduLength=8
          BMS_Tem_3_Can_Network_CANNODE_0_PduR2CanIf: PduLength=8
          BMS_16_Can_Network_CANNODE_0_Com2PduR: PduLength=8
          BMS_16_Can_Network_CANNODE_0_PduR2CanIf: PduLength=8
          BMS_Tem_2_Can_Network_CANNODE_0_Com2PduR: PduLength=8
          BMS_Tem_2_Can_Network_CANNODE_0_PduR2CanIf: PduLength=8
          BMS_15_Can_Network_CANNODE_0_Com2PduR: PduLength=8
          BMS_15_Can_Network_CANNODE_0_PduR2CanIf: PduLength=8
          BMS_Tem_1_Can_Network_CANNODE_0_Com2PduR: PduLength=8
          BMS_Tem_1_Can_Network_CANNODE_0_PduR2CanIf: PduLength=8
          BMS_14_Can_Network_CANNODE_0_Com2PduR: PduLength=8
          BMS_14_Can_Network_CANNODE_0_PduR2CanIf: PduLength=8
          BMS_Vol_9_Can_Network_CANNODE_0_Com2PduR: PduLength=8
          BMS_Vol_9_Can_Network_CANNODE_0_PduR2CanIf: PduLength=8
          BMS_21_Can_Network_CANNODE_0_Com2PduR: PduLength=8
          BMS_21_Can_Network_CANNODE_0_PduR2CanIf: PduLength=8
          BMS_Vol_8_Can_Network_CANNODE_0_Com2PduR: PduLength=8
          BMS_Vol_8_Can_Network_CANNODE_0_PduR2CanIf: PduLength=8
          BMS_20_Can_Network_CANNODE_0_Com2PduR: PduLength=8
          BMS_20_Can_Network_CANNODE_0_PduR2CanIf: PduLength=8
          BMS_Vol_7_Can_Network_CANNODE_0_Com2PduR: PduLength=8
          BMS_Vol_7_Can_Network_CANNODE_0_PduR2CanIf: PduLength=8
          BMS_Vol_6_Can_Network_CANNODE_0_Com2PduR: PduLength=8
          BMS_Vol_6_Can_Network_CANNODE_0_PduR2CanIf: PduLength=8
          BMS_Vol_5_Can_Network_CANNODE_0_Com2PduR: PduLength=8
          BMS_Vol_5_Can_Network_CANNODE_0_PduR2CanIf: PduLength=8
          BMS_Vol_4_Can_Network_CANNODE_0_Com2PduR: PduLength=8
          BMS_Vol_4_Can_Network_CANNODE_0_PduR2CanIf: PduLength=8
          BMS_Vol_3_Can_Network_CANNODE_0_Com2PduR: PduLength=8
          BMS_Vol_3_Can_Network_CANNODE_0_PduR2CanIf: PduLength=8
          BMS_8_Can_Network_CANNODE_0_Com2PduR: PduLength=8
          BMS_8_Can_Network_CANNODE_0_PduR2CanIf: PduLength=8
          BMS_Vol_2_Can_Network_CANNODE_0_Com2PduR: PduLength=8
          BMS_Vol_2_Can_Network_CANNODE_0_PduR2CanIf: PduLength=8
          BMS_Vol_1_Can_Network_CANNODE_0_Com2PduR: PduLength=8
          BMS_Vol_1_Can_Network_CANNODE_0_PduR2CanIf: PduLength=8
          BMS_1_Can_Network_CANNODE_0_Com2PduR: PduLength=8
          BMS_1_Can_Network_CANNODE_0_PduR2CanIf: PduLength=8
          BMS_Vol_20_Can_Network_CANNODE_0_Com2PduR: PduLength=8
          BMS_Vol_20_Can_Network_CANNODE_0_PduR2CanIf: PduLength=8
          BMS_Vol_19_Can_Network_CANNODE_0_Com2PduR: PduLength=8
          BMS_Vol_19_Can_Network_CANNODE_0_PduR2CanIf: PduLength=8
          BMS_Vol_18_Can_Network_CANNODE_0_Com2PduR: PduLength=8
          BMS_Vol_18_Can_Network_CANNODE_0_PduR2CanIf: PduLength=8
          BMS_Vol_17_Can_Network_CANNODE_0_Com2PduR: PduLength=8
          BMS_Vol_17_Can_Network_CANNODE_0_PduR2CanIf: PduLength=8
          BMS_5_Can_Network_CANNODE_0_Com2PduR: PduLength=8
          BMS_5_Can_Network_CANNODE_0_PduR2CanIf: PduLength=8
          BMS_9_Can_Network_CANNODE_0_Com2PduR: PduLength=8
          BMS_9_Can_Network_CANNODE_0_PduR2CanIf: PduLength=8
          BMS_Vol_16_Can_Network_CANNODE_0_Com2PduR: PduLength=8
          BMS_Vol_16_Can_Network_CANNODE_0_PduR2CanIf: PduLength=8
          BMS_Vol_15_Can_Network_CANNODE_0_Com2PduR: PduLength=8
          BMS_Vol_15_Can_Network_CANNODE_0_PduR2CanIf: PduLength=8
          BMS_Vol_14_Can_Network_CANNODE_0_Com2PduR: PduLength=8
          BMS_Vol_14_Can_Network_CANNODE_0_PduR2CanIf: PduLength=8
          BMS_2_Can_Network_CANNODE_0_Com2PduR: PduLength=8
          BMS_2_Can_Network_CANNODE_0_PduR2CanIf: PduLength=8
          BMS_Vol_13_Can_Network_CANNODE_0_Com2PduR: PduLength=8
          BMS_Vol_13_Can_Network_CANNODE_0_PduR2CanIf: PduLength=8
          BMS_Vol_12_Can_Network_CANNODE_0_Com2PduR: PduLength=8
          BMS_Vol_12_Can_Network_CANNODE_0_PduR2CanIf: PduLength=8
          BMS_23_Can_Network_CANNODE_0_Com2PduR: PduLength=8
          BMS_23_Can_Network_CANNODE_0_PduR2CanIf: PduLength=8
          BMS_Vol_11_Can_Network_CANNODE_0_Com2PduR: PduLength=8
          BMS_Vol_11_Can_Network_CANNODE_0_PduR2CanIf: PduLength=8
          BMS_25_Can_Network_CANNODE_0_Com2PduR: PduLength=8
          BMS_25_Can_Network_CANNODE_0_PduR2CanIf: PduLength=8
          BMS_Vol_10_Can_Network_CANNODE_0_Com2PduR: PduLength=8
          BMS_Vol_10_Can_Network_CANNODE_0_PduR2CanIf: PduLength=8
          BMS_22_Can_Network_CANNODE_0_Com2PduR: PduLength=8
          BMS_22_Can_Network_CANNODE_0_PduR2CanIf: PduLength=8
          BMS_6_Can_Network_CANNODE_0_Com2PduR: PduLength=8
          BMS_6_Can_Network_CANNODE_0_PduR2CanIf: PduLength=8
          BMS_13_Can_Network_CANNODE_0_Com2PduR: PduLength=8
          BMS_13_Can_Network_CANNODE_0_PduR2CanIf: PduLength=8
          BMS_12_Can_Network_CANNODE_0_Com2PduR: PduLength=8
          BMS_12_Can_Network_CANNODE_0_PduR2CanIf: PduLength=8
          BMS_7_Can_Network_CANNODE_0_Com2PduR: PduLength=8
          BMS_7_Can_Network_CANNODE_0_PduR2CanIf: PduLength=8
          BMS_10_Can_Network_CANNODE_0_Com2PduR: PduLength=8
          BMS_10_Can_Network_CANNODE_0_PduR2CanIf: PduLength=8
          BMS_3_Can_Network_CANNODE_0_Com2PduR: PduLength=8
          BMS_3_Can_Network_CANNODE_0_PduR2CanIf: PduLength=8
          BMS_Vol_24_Can_Network_CANNODE_0_Com2PduR: PduLength=8
          BMS_Vol_24_Can_Network_CANNODE_0_PduR2CanIf: PduLength=8
          BMS_Vol_23_Can_Network_CANNODE_0_Com2PduR: PduLength=8
          BMS_Vol_23_Can_Network_CANNODE_0_PduR2CanIf: PduLength=8
          BMS_Vol_22_Can_Network_CANNODE_0_Com2PduR: PduLength=8
          BMS_Vol_22_Can_Network_CANNODE_0_PduR2CanIf: PduLength=8
          BMS_Vol_21_Can_Network_CANNODE_0_Com2PduR: PduLength=8
          BMS_Vol_21_Can_Network_CANNODE_0_PduR2CanIf: PduLength=8
          BMS_4_Can_Network_CANNODE_0_Com2PduR: PduLength=8
          BMS_4_Can_Network_CANNODE_0_PduR2CanIf: PduLength=8
          BMS_11_Can_Network_CANNODE_0_Com2PduR: PduLength=8
          BMS_11_Can_Network_CANNODE_0_PduR2CanIf: PduLength=8
    EcuCRbSettings: EcuCRbArRelease=AR42_Rev2, EcuCRbRteInUse=true
