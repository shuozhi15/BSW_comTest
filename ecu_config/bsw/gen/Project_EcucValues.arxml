AUTOSAR XML (schema 4-2-2)
package /ETAS_Project/EcucModuleConfigurationValuess
  module config CanNm: implementation-config-variant=VARIANT-PRE-COMPILE
    CanNmGlobalConfig:
      CanNmComUserDataSupport = false
      CanNmImmediateRestartEnabled = false
      CanNmImmediateTxconfEnabled = false
      CanNmVersionInfoApi = false
      CanNmBusLoadReductionEnabled = false
      CanNmBusSynchronizationEnabled = false
      CanNmComControlEnabled = false
      CanNmCoordinatorSyncSupport = false
      CanNmMainFunctionPeriod = 0.01
      CanNmNodeDetectionEnabled = false
      CanNmNodeIdEnabled = false
      CanNmPassiveModeEnabled = false
      CanNmPduRxIndicationEnabled = false
      CanNmRemoteSleepIndEnabled = false
      CanNmRepeatMsgIndEnabled = false
      CanNmStateChangeIndEnabled = false
      CanNmUserDataEnabled = false
      CanNmDevErrorDetect = false
      CanNmChannelConfig_NmConfig_0_CanNmCluster_0 (CanNmChannelConfig):
        CanNmBusLoadReductionActive = false
        CanNmCarWakeUpRxEnabled = false
        CanNmImmediateNmCycleTime = 0.01
        CanNmImmediateNmTransmissions = 0
        CanNmMsgCycleOffset = 0.0
        CanNmMsgCycleTime = 0.01
        CanNmMsgReducedTime = 0.01
        CanNmMsgTimeoutTime = 0.01
        CanNmNodeId = 1
        CanNmPduCbvPosition = CANNM_PDU_BYTE_1
        CanNmPduNidPosition = CANNM_PDU_BYTE_0
        CanNmRemoteSleepIndTime = 0.01
        CanNmRepeatMessageTime = 0.0
        CanNmTimeoutTime = 0.02
        CanNmWaitBusSleepTime = 0.01
        CanNmComMNetworkHandleRef = ComMChannel_Can_Network_Channel
        3 x CanNmRxPdu:
          CanNmRxPdu_NMm_HCU_Can_Network_CANNODE_0_CanIf2CanNm: CanNmRxPduRef=NMm_HCU_Can_Network_CANNODE_0_CanIf2CanNm
          CanNmRxPdu_NMm_CDU_Can_Network_CANNODE_0_CanIf2CanNm: CanNmRxPduRef=NMm_CDU_Can_Network_CANNODE_0_CanIf2CanNm
          CanNmRxPdu_NMm_MCUR_Can_Network_CANNODE_0_CanIf2CanNm: CanNmRxPduRef=NMm_MCUR_Can_Network_CANNODE_0_CanIf2CanNm
        CanNmTxPdu_NMm_BMS_Can_Network_CANNODE_0_CanNm2CanIf (CanNmTxPdu): CanNmTxPduRef=NMm_BMS_Can_Network_CANNODE_0_CanNm2CanIf
  module config ComM: implementation-config-variant=VARIANT-PRE-COMPILE
    ComMGeneral:
      ComMEcuGroupClassification = 0
      ComMModeLimitationEnabled = false
      ComMTMinFullComModeDuration = 0.01
      ComMVersionInfoApi = false
      ComMWakeupInhibitionEnabled = false
      ComMPncGatewayEnabled = false
      ComMPncSupport = false
      ComMResetAfterForcingNoComm = false
      ComMSynchronousWakeUp = false
      ComMRteEnabled = false
      ComMDevErrorDetect = false
    ComMConfigSet
      ComMUser_Can_Network_Channel (ComMUser)
      ComMChannel_Can_Network_Channel (ComMChannel):
        ComMMainFunctionPeriod = 0.01
        ComMFullCommRequestNotificationEnabled = false
        ComMNoCom = true
        ComMNoWakeUpInhibitionNvmStorage = false
        ComMNoWakeup = true
        ComMBusType = COMM_BUS_TYPE_CAN
        ComMNetworkManagement: ComMNmLightTimeout=10, ComMPncNmRequest=false, ComMNmVariant=FULL
        ComMUserPerChannel_Can_Network_Channel (ComMUserPerChannel): ComMUserChannel=ComMUser_Can_Network_Channel
  module config CanIf: implementation-config-variant=VARIANT-PRE-COMPILE
    CanIfInitCfg: CanIfInitCfgSet=0
      CanIfInitHohCfg
        5 x CanIfHrhCfg, all with CanIfHrhCanCtrlIdRef=Can_Network_CANNODE_0:
          Can_Network_CANNODE_0_Rx_Std_MailBox_{1..5}: CanIfHrhIdSymRef=Can_Network_CANNODE_0_Rx_Std_MailBox_{1..5}
        3 x CanIfHthCfg, all with CanIfHthCanCtrlIdRef=Can_Network_CANNODE_0:
          Can_Network_CANNODE_0_Tx_Std_MailBox_{1..3}: CanIfHthIdSymRef=Can_Network_CANNODE_0_Tx_Std_MailBox_{1..3}
      5 x CanIfRxPduCfg, all with CanIfRxPduReadData=false, CanIfRxPduReadNotifyStatus=true, CanIfRxPduCanIdType=STANDARD_CAN, CanIfRxPduDlc=8:
        TMR_3_Can_Network_CANNODE_0: CanIfRxPduCanId=808, CanIfRxPduUserRxIndicationName=PduR_CanIfRxIndication, CanIfRxPduUserRxIndicationUL=PDUR, CanIfRxPduHrhIdRef=Can_Network_CANNODE_0_Rx_Std_MailBox_1, CanIfRxPduRef=PduCollection/TMR_3_Can_Network_CANNODE_0_CanIf2PduR
        NMm_HCU_Can_Network_CANNODE_0: CanIfRxPduCanId=1550, CanIfRxPduUserRxIndicationUL=CAN_NM, CanIfRxPduHrhIdRef=Can_Network_CANNODE_0_Rx_Std_MailBox_2, CanIfRxPduRef=NMm_HCU_Can_Network_CANNODE_0_CanIf2CanNm
        NMm_CDU_Can_Network_CANNODE_0: CanIfRxPduCanId=1583, CanIfRxPduUserRxIndicationUL=CAN_NM, CanIfRxPduHrhIdRef=Can_Network_CANNODE_0_Rx_Std_MailBox_3, CanIfRxPduRef=NMm_CDU_Can_Network_CANNODE_0_CanIf2CanNm
        NMm_MCUR_Can_Network_CANNODE_0: CanIfRxPduCanId=1582, CanIfRxPduUserRxIndicationUL=CAN_NM, CanIfRxPduHrhIdRef=Can_Network_CANNODE_0_Rx_Std_MailBox_4, CanIfRxPduRef=NMm_MCUR_Can_Network_CANNODE_0_CanIf2CanNm
        OBC_1_Can_Network_CANNODE_0: CanIfRxPduCanId=1061, CanIfRxPduUserRxIndicationName=PduR_CanIfRxIndication, CanIfRxPduUserRxIndicationUL=PDUR, CanIfRxPduHrhIdRef=Can_Network_CANNODE_0_Rx_Std_MailBox_5, CanIfRxPduRef=PduCollection/OBC_1_Can_Network_CANNODE_0_CanIf2PduR
      Buffer_Can_Network_CANNODE_0_Tx_Std_MailBox_1 (CanIfBufferCfg): CanIfBufferSize=0, CanIfBufferHthRef=Can_Network_CANNODE_0_Tx_Std_MailBox_1
      BMS_Vol_8_Can_Network_CANNODE_0 (CanIfTxPduCfg):
        CanIfTxPduReadNotifyStatus = false
        CanIfTxPduType = STATIC
        CanIfTxPduTruncation = false
        CanIfTxPduCanIdType = STANDARD_CAN
        CanIfTxPduCanId = 1351
        CanIfTxPduUserTxConfirmationUL = PDUR
        CanIfTxPduBufferRef = Buffer_Can_Network_CANNODE_0_Tx_Std_MailBox_1
        CanIfTxPduRef = PduCollection/BMS_Vol_8_Can_Network_CANNODE_0_PduR2CanIf
      Buffer_Can_Network_CANNODE_0_Tx_Std_MailBox_2 (CanIfBufferCfg): CanIfBufferSize=0, CanIfBufferHthRef=Can_Network_CANNODE_0_Tx_Std_MailBox_2
      BMS_20_Can_Network_CANNODE_0 (CanIfTxPduCfg):
        CanIfTxPduReadNotifyStatus = false
        CanIfTxPduType = STATIC
        CanIfTxPduTruncation = false
        CanIfTxPduCanIdType = STANDARD_CAN
        CanIfTxPduCanId = 1472
        CanIfTxPduUserTxConfirmationUL = PDUR
        CanIfTxPduBufferRef = Buffer_Can_Network_CANNODE_0_Tx_Std_MailBox_2
        CanIfTxPduRef = PduCollection/BMS_20_Can_Network_CANNODE_0_PduR2CanIf
      Buffer_Can_Network_CANNODE_0_Tx_Std_MailBox_3 (CanIfBufferCfg): CanIfBufferSize=0, CanIfBufferHthRef=Can_Network_CANNODE_0_Tx_Std_MailBox_3
      NMm_BMS_Can_Network_CANNODE_0 (CanIfTxPduCfg):
        CanIfTxPduReadNotifyStatus = false
        CanIfTxPduType = STATIC
        CanIfTxPduTruncation = false
        CanIfTxPduCanIdType = STANDARD_CAN
        CanIfTxPduCanId = 1551
        CanIfTxPduUserTxConfirmationUL = CAN_NM
        CanIfTxPduBufferRef = Buffer_Can_Network_CANNODE_0_Tx_Std_MailBox_3
        CanIfTxPduRef = NMm_BMS_Can_Network_CANNODE_0_CanNm2CanIf
    CanIfCtrlDrvCfg: CanIfRbCtrlDrvPrefix=CanConf_CanHardwareObject, CanIfCtrlDrvNameRef=CanGeneral, CanIfCtrlDrvInitHohConfigRef=CanIfInitHohCfg
      Can_Network_CANNODE_0 (CanIfCtrlCfg): CanIfCtrlWakeupSupport=false, CanIfCtrlCanCtrlRef=Can_Network_CANNODE_0
    CanIfDispatchCfg: CanIfDispatchUserCtrlBusOffUL=CAN_SM, CanIfDispatchUserCtrlModeIndicationUL=CAN_SM, CanIfDispatchUserTrcvModeIndicationName=CAN_SM
    CanIfPrivateCfg: CanIfPrivateDlcCheck=false
    CanIfPublicCfg:
      CanIfPublicReadRxPduDataApi = false
      CanIfPublicReadRxPduNotifyStatusApi = true
      CanIfPublicReadTxPduNotifyStatusApi = true
      CanIfPublicSetDynamicTxIdApi = false
      CanIfPublicTxBuffering = false
      CanIfPublicTxConfirmPollingSupport = false
      CanIfPublicVersionInfoApi = false
      CanIfPublicCancelTransmitSupport = false
      CanIfPublicErrorPassiveSupport = false
      CanIfPublicCanIfLiteConfiguration = false
      CanIfPublicUserTpTxInOfflineMode = false
      CanIfPublicWakeupCheckValidSupport = false
      CanIfPublicPnSupport = false
      CanIfPublicBusoffRecoveryfromRxIndication = false
      CanIfTriggerTransmitSupport = false
      CanIfTxOfflineActiveSupport = false
      CanIfWakeupSupport = false
      CanIfPublicDevErrorDetect = false
  module config CanSM: implementation-config-variant=VARIANT-PRE-COMPILE
    CanSMConfiguration: CanSMModeRequestRepetitionMax=5, CanSMModeRequestRepetitionTime=0.07
      CanSMManagerNetwork_Can_Network (CanSMManagerNetwork):
        CanSMBorTxConfirmationPolling = false
        CanSMBorCounterL1ToL2 = 0
        CanSMBorTimeL1 = 0.04
        CanSMBorTimeL2 = 0.1
        CanSMBorTimeTxEnsured = 0.02
        CanSMComMNetworkHandleRef = ComMChannel_Can_Network_Channel
        CanSMDemEventParameterRefs: CanSMRbDynCreate_CANSM_E_BUS_OFF=Standard
        CanSMController_Can_Network_CANNODE_0 (CanSMController): CanSMControllerId=Can_Network_CANNODE_0
    CanSMGeneral: CanSMMainFunctionTimePeriod=0.01, CanSMVersionInfoApi=false, CanSMDevErrorDetect=false
  module config PduR: implementation-config-variant=VARIANT-PRE-COMPILE
    PduRGeneral:
      PduRVersionInfoApi = false
      PduRZeroCostOperation = false
      PduRFifoTxBufferSupport = false
      PduRIFGatewayOperation = false
      PduRTPGatewayOperation = false
      PduRMemorySize = 0
      PduRMinimumRoutingLoRxPduId = 0
      PduRMinimumRoutingLoTxPduId = 0
      PduRMinimumRoutingUpRxPduId = 0
      PduRMinimumRoutingUpTxPduId = 0
      PduRMulticastFromIfSupport = false
      PduRMulticastFromTpSupport = false
      PduRMulticastToIfSupport = false
      PduRMulticastToTpSupport = false
      PduRSbTxBufferSupport = false
      PduRQueueingSupport = false
      PduRCanTpChangeParameterRequestApi = false
      PduRFrTpChangeParameterRequestApi = false
      PduRGwTpWithLimitedBuffer = false
      PduRDevErrorDetect = false
    PduRRoutingTables: PduRConfigurationId=0
      PduRRoutingTable
        4 x PduRRoutingPath:
          TMR_3_Can_Network_CANNODE_0_CanIf2Com
            TMR_3_Can_Network_CANNODE_0_CanIf2PduR (PduRSrcPdu): PduRSrcPduRef=PduCollection/TMR_3_Can_Network_CANNODE_0_CanIf2PduR
            TMR_3_Can_Network_CANNODE_0_PduR2Com (PduRDestPdu): PduRTransmissionConfirmation=false, PduRDestPduRef=PduCollection/TMR_3_Can_Network_CANNODE_0_PduR2Com
          OBC_1_Can_Network_CANNODE_0_CanIf2Com
            OBC_1_Can_Network_CANNODE_0_CanIf2PduR (PduRSrcPdu): PduRSrcPduRef=PduCollection/OBC_1_Can_Network_CANNODE_0_CanIf2PduR
            OBC_1_Can_Network_CANNODE_0_PduR2Com (PduRDestPdu): PduRTransmissionConfirmation=false, PduRDestPduRef=PduCollection/OBC_1_Can_Network_CANNODE_0_PduR2Com
          BMS_Vol_8_Can_Network_CANNODE_0_Com2CanIf
            BMS_Vol_8_Can_Network_CANNODE_0_Com2PduR (PduRSrcPdu): PduRSrcPduRef=PduCollection/BMS_Vol_8_Can_Network_CANNODE_0_Com2PduR
            BMS_Vol_8_Can_Network_CANNODE_0_PduR2CanIf (PduRDestPdu): PduRTransmissionConfirmation=false, PduRDestPduRef=PduCollection/BMS_Vol_8_Can_Network_CANNODE_0_PduR2CanIf
          BMS_20_Can_Network_CANNODE_0_Com2CanIf
            BMS_20_Can_Network_CANNODE_0_Com2PduR (PduRSrcPdu): PduRSrcPduRef=PduCollection/BMS_20_Can_Network_CANNODE_0_Com2PduR
            BMS_20_Can_Network_CANNODE_0_PduR2CanIf (PduRDestPdu): PduRTransmissionConfirmation=false, PduRDestPduRef=PduCollection/BMS_20_Can_Network_CANNODE_0_PduR2CanIf
    3 x PduRBswModules, all with PduRCancelReceive=0, PduRCancelTransmit=0, PduRChangeParameterApi=0, PduRCommunicationInterface=1, PduRRetransmission=0, PduRUseTag=0:
      CanNm: PduRLowerModule=1, PduRTransportProtocol=0, PduRTriggertransmit=1, PduRTxConfirmation=1, PduRUpperModule=0, PduRBswModuleRef=CanNm
      CanIf: PduRLowerModule=1, PduRTransportProtocol=0, PduRTriggertransmit=0, PduRTxConfirmation=1, PduRUpperModule=0, PduRBswModuleRef=CanIf
      Com: PduRLowerModule=0, PduRTransportProtocol=1, PduRTriggertransmit=1, PduRTxConfirmation=0, PduRUpperModule=1, PduRBswModuleRef=Com
  module config EcuC: implementation-config-variant=VARIANT-PRE-COMPILE
    EcucConfigSet
      PduCollection (EcucPduCollection): PduIdTypeEnum=uint16, PduLengthTypeEnum=uint16
        12 x Pdu, all with PduLength=8:
          TMR_3_Can_Network_CANNODE_0_CanIf2PduR
          TMR_3_Can_Network_CANNODE_0_PduR2Com
          NMm_HCU_Can_Network_CANNODE_0_CanIf2CanNm
          NMm_CDU_Can_Network_CANNODE_0_CanIf2CanNm
          NMm_MCUR_Can_Network_CANNODE_0_CanIf2CanNm
          OBC_1_Can_Network_CANNODE_0_CanIf2PduR
          OBC_1_Can_Network_CANNODE_0_PduR2Com
          BMS_Vol_8_Can_Network_CANNODE_0_Com2PduR
          BMS_Vol_8_Can_Network_CANNODE_0_PduR2CanIf
          BMS_20_Can_Network_CANNODE_0_Com2PduR
          BMS_20_Can_Network_CANNODE_0_PduR2CanIf
          NMm_BMS_Can_Network_CANNODE_0_CanNm2CanIf
    EcuCRbSettings: EcuCRbArRelease=AR42_Rev2, EcuCRbRteInUse=true
  module config Com: implementation-config-variant=VARIANT-PRE-COMPILE
    ComConfig_0 (ComConfig)
      ComTimeBase: ComGwTimeBase=0.005, ComRxTimeBase=0.01, ComTxTimeBase=0.01
      ComIPduGroup_Rx (ComIPduGroup)
      TMR_3_Can_Network_CANNODE_0 (ComIPdu):
        ComIPduSignalProcessing = IMMEDIATE
        ComIPduType = NORMAL
        ComIPduDirection = RECEIVE
        ComIPduGroupRef = ComIPduGroup_Rx
        ComPduIdRef = PduCollection/TMR_3_Can_Network_CANNODE_0_PduR2Com
        ComIPduSignalRef = TMR_VoltageHV
        ComIPduSignalRef = TMR_CurrentHV
      TMR_VoltageHV (ComSignal):
        ComSignalInitValue = 0
        ComSignalType = UINT16
        ComSignalEndianness = BIG_ENDIAN
        ComBitSize = 10
        ComBitPosition = 12
        ComUpdateBitPosition = -1
        ComTransferProperty = TRIGGERED
        ComSystemTemplateSystemSignalRef = TMR_VoltageHV
      TMR_CurrentHV (ComSignal):
        ComSignalInitValue = 1023
        ComSignalType = UINT16
        ComSignalEndianness = BIG_ENDIAN
        ComBitSize = 11
        ComBitPosition = 7
        ComUpdateBitPosition = -1
        ComTransferProperty = TRIGGERED
        ComSystemTemplateSystemSignalRef = TMR_CurrentHV
      OBC_1_Can_Network_CANNODE_0 (ComIPdu):
        ComIPduSignalProcessing = IMMEDIATE
        ComIPduType = NORMAL
        ComIPduDirection = RECEIVE
        ComIPduGroupRef = ComIPduGroup_Rx
        ComPduIdRef = PduCollection/OBC_1_Can_Network_CANNODE_0_PduR2Com
        ComIPduSignalRef = OBC_FaultLevelSts
        ComIPduSignalRef = OBC_ChgSts
        ComIPduSignalRef = OBC_OutputPowerLimt
        ComIPduSignalRef = OBC_ChgVolt
        ComIPduSignalRef = OBC_ChgCurr
      5 x ComSignal, all with ComSignalInitValue=0, ComSignalEndianness=BIG_ENDIAN, ComUpdateBitPosition=-1, ComTransferProperty=TRIGGERED:
        OBC_FaultLevelSts: ComSignalType=UINT8, ComBitSize=3, ComBitPosition=41, ComSystemTemplateSystemSignalRef=OBC_FaultLevelSts
        OBC_ChgSts: ComSignalType=UINT8, ComBitSize=3, ComBitPosition=54, ComSystemTemplateSystemSignalRef=OBC_ChgSts
        OBC_OutputPowerLimt: ComSignalType=UINT16, ComBitSize=12, ComBitPosition=39, ComSystemTemplateSystemSignalRef=OBC_OutputPowerLimt
        OBC_ChgVolt: ComSignalType=UINT16, ComBitSize=16, ComBitPosition=23, ComSystemTemplateSystemSignalRef=OBC_ChgVolt
        OBC_ChgCurr: ComSignalType=UINT16, ComBitSize=16, ComBitPosition=7, ComSystemTemplateSystemSignalRef=OBC_ChgCurr
      ComIPduGroup_Tx (ComIPduGroup)
      BMS_Vol_8_Can_Network_CANNODE_0 (ComIPdu):
        ComIPduSignalProcessing = IMMEDIATE
        ComIPduType = NORMAL
        ComIPduDirection = SEND
        ComFirstTimeout = 1.0
        ComTimeout = 1.0
        ComIPduGroupRef = ComIPduGroup_Tx
        ComPduIdRef = PduCollection/BMS_Vol_8_Can_Network_CANNODE_0_Com2PduR
        ComIPduSignalRef = BMS_BattCellOrder32Vol
        ComIPduSignalRef = BMS_BattCellOrder31Vol
        ComIPduSignalRef = BMS_BattCellOrder30Vol
        ComIPduSignalRef = BMS_BattCellOrder29Vol
        ComTxIPdu: ComMinimumDelayTime=0.0, ComTxIPduUnusedAreasDefault=255
          ComTxModeTrue
            ComTxMode: ComTxModeTimePeriod=1.0, ComTxModeMode=PERIODIC, ComTxModeNumberOfRepetitions=0, ComTxModeRepetitionPeriod=0, ComTxModeTimeOffset=0.0
          ComTxModeFalse
            ComTxMode: ComTxModeTimePeriod=1.0, ComTxModeMode=PERIODIC, ComTxModeNumberOfRepetitions=0, ComTxModeRepetitionPeriod=0, ComTxModeTimeOffset=0.0
      4 x ComSignal, all with ComSignalInitValue=0, ComSignalType=UINT16, ComSignalEndianness=BIG_ENDIAN, ComBitSize=16, ComUpdateBitPosition=-1, ComTransferProperty=TRIGGERED:
        BMS_BattCellOrder32Vol: ComBitPosition=55, ComSystemTemplateSystemSignalRef=BMS_BattCellOrder32Vol
        BMS_BattCellOrder31Vol: ComBitPosition=39, ComSystemTemplateSystemSignalRef=BMS_BattCellOrder31Vol
        BMS_BattCellOrder30Vol: ComBitPosition=23, ComSystemTemplateSystemSignalRef=BMS_BattCellOrder30Vol
        BMS_BattCellOrder29Vol: ComBitPosition=7, ComSystemTemplateSystemSignalRef=BMS_BattCellOrder29Vol
      BMS_20_Can_Network_CANNODE_0 (ComIPdu):
        ComIPduSignalProcessing = IMMEDIATE
        ComIPduType = NORMAL
        ComIPduDirection = SEND
        ComFirstTimeout = 1.0
        ComTimeout = 1.0
        ComIPduGroupRef = ComIPduGroup_Tx
        ComPduIdRef = PduCollection/BMS_20_Can_Network_CANNODE_0_Com2PduR
        ComIPduSignalRef = BMSH_19_Reserved1
        ComIPduSignalRef = BMSH_CellSensor_TotalNum
        ComIPduSignalRef = BMSH_SingleFeedbackEnergy
        ComIPduSignalRef = BMSH_SingleDisChargeEnergy
        ComIPduSignalRef = BMSH_SingleChargeEnergy
        ComTxIPdu: ComMinimumDelayTime=0.0, ComTxIPduUnusedAreasDefault=255
          ComTxModeTrue
            ComTxMode: ComTxModeTimePeriod=1.0, ComTxModeMode=PERIODIC, ComTxModeNumberOfRepetitions=0, ComTxModeRepetitionPeriod=0, ComTxModeTimeOffset=0.0
          ComTxModeFalse
            ComTxMode: ComTxModeTimePeriod=1.0, ComTxModeMode=PERIODIC, ComTxModeNumberOfRepetitions=0, ComTxModeRepetitionPeriod=0, ComTxModeTimeOffset=0.0
      5 x ComSignal, all with ComSignalInitValue=0, ComSignalEndianness=BIG_ENDIAN, ComUpdateBitPosition=-1, ComTransferProperty=TRIGGERED:
        BMSH_19_Reserved1: ComSignalType=UINT8, ComBitSize=8, ComBitPosition=63, ComSystemTemplateSystemSignalRef=BMSH_19_Reserved1
        BMSH_CellSensor_TotalNum: ComSignalType=UINT8, ComBitSize=8, ComBitPosition=55, ComSystemTemplateSystemSignalRef=BMSH_CellSensor_TotalNum
        BMSH_SingleFeedbackEnergy: ComSignalType=UINT16, ComBitSize=16, ComBitPosition=39, ComSystemTemplateSystemSignalRef=BMSH_SingleFeedbackEnergy
        BMSH_SingleDisChargeEnergy: ComSignalType=UINT16, ComBitSize=16, ComBitPosition=23, ComSystemTemplateSystemSignalRef=BMSH_SingleDisChargeEnergy
        BMSH_SingleChargeEnergy: ComSignalType=UINT16, ComBitSize=16, ComBitPosition=7, ComSystemTemplateSystemSignalRef=BMSH_SingleChargeEnergy
    ComGeneral:
      ComVersionInfoApi = false
      ComCommonIPduTxPeriodFeature = false
      ComEnableJitterFilter = false
      ComEnableSignalGroupArrayApi = false
      ComCancellationSupport = false
      ComConfigurationUseDet = false
  module config Nm: implementation-config-variant=VARIANT-PRE-COMPILE
    NmGlobalConfig
      NmGlobalConstants: NmNumberOfChannels=1, NmRemoteSleepCancelCallback=TestNm_RemoteSleepCancellation, NmRemoteSleepIndCallback=TestNm_RemoteSleepIndication
      NmGlobalProperties: NmVersionInfoApi=true, NmCycletimeMainFunction=0.01, NmDevErrorDetect=false
      NmGlobalFeatures:
        NmCarWakeUpRxEnabled = false
        NmComUserDataSupport = false
        NmCoordinatorSupportEnabled = false
        NmBusSynchronizationEnabled = false
        NmComControlEnabled = false
        NmCoordinatorSyncSupport = false
        NmNodeDetectionEnabled = false
        NmNodeIdEnabled = false
        NmPassiveModeEnabled = false
        NmPduRxIndicationEnabled = false
        NmRemoteSleepIndEnabled = false
        NmRepeatMsgIndEnabled = false
        NmUserDataEnabled = false
        NmStateChangeIndEnabled = false
    NmChannelConfig_Can_Network_Channel (NmChannelConfig):
      NmChannelSleepMaster = false
      NmStateReportEnabled = false
      NmSynchronizingNetwork = false
      NmShutdownDelayTimer = 0.0
      NmComMChannelRef = ComMChannel_Can_Network_Channel
      NmBusType
        NmStandardBusNmConfig: NmStandardBusType=NM_BUSNM_CANNM
