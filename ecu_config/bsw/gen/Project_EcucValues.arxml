AUTOSAR XML (schema 4-2-2)
package /ETAS_Project/EcucModuleConfigurationValuess
  module config CanNm: implementation-config-variant=VARIANT-PRE-COMPILE
    CanNmGlobalConfig:
      CanNmComUserDataSupport = false
      CanNmImmediateRestartEnabled = false
      CanNmImmediateTxconfEnabled = false
      CanNmVersionInfoApi = false
      CanNmBusLoadReductionEnabled = false
      CanNmBusSynchronizationEnabled = false
      CanNmComControlEnabled = true
      CanNmCoordinatorSyncSupport = false
      CanNmMainFunctionPeriod = 0.01
      CanNmNodeDetectionEnabled = true
      CanNmNodeIdEnabled = true
      CanNmPassiveModeEnabled = false
      CanNmPduRxIndicationEnabled = true
      CanNmRemoteSleepIndEnabled = false
      CanNmRepeatMsgIndEnabled = true
      CanNmStateChangeIndEnabled = true
      CanNmUserDataEnabled = true
      CanNmDevErrorDetect = false
      CanNmChannelConfig_NmConfig_0_CanNmCluster_0 (CanNmChannelConfig):
        CanNmBusLoadReductionActive = false
        CanNmCarWakeUpRxEnabled = false
        CanNmImmediateNmCycleTime = 0.1
        CanNmImmediateNmTransmissions = 5
        CanNmMsgCycleOffset = 0.0
        CanNmMsgCycleTime = 0.2
        CanNmMsgReducedTime = 0.2
        CanNmMsgTimeoutTime = 2.0
        CanNmNodeId = 1
        CanNmPduCbvPosition = CANNM_PDU_BYTE_1
        CanNmPduNidPosition = CANNM_PDU_BYTE_0
        CanNmRemoteSleepIndTime = 0.01
        CanNmRepeatMessageTime = 0.0
        CanNmTimeoutTime = 0.02
        CanNmWaitBusSleepTime = 0.01
        CanNmActiveWakeupBitEnabled = true
        CanNmComMNetworkHandleRef = ComMChannel_Can_NCluster_Channel
        CanNmRxPdu_NMm_CDU_CANNODE_0_CanIf2CanNm (CanNmRxPdu): CanNmRxPduRef=NMm_CDU_CANNODE_0_CanIf2CanNm
        CanNmTxPdu_NMm_BMS_CANNODE_0_CanNm2CanIf (CanNmTxPdu): CanNmTxPduRef=NMm_BMS_CANNODE_0_CanNm2CanIf
  module config ComM: implementation-config-variant=VARIANT-PRE-COMPILE
    ComMGeneral:
      ComMEcuGroupClassification = 0
      ComMModeLimitationEnabled = false
      ComMTMinFullComModeDuration = 0.01
      ComMVersionInfoApi = false
      ComMWakeupInhibitionEnabled = false
      ComMPncGatewayEnabled = false
      ComMPncSupport = false
      ComMResetAfterForcingNoComm = false
      ComMSynchronousWakeUp = false
      ComMRteEnabled = false
      ComMDevErrorDetect = false
    ComMConfigSet
      ComMUser_Can_NCluster_Channel (ComMUser)
      ComMChannel_Can_NCluster_Channel (ComMChannel):
        ComMMainFunctionPeriod = 0.01
        ComMFullCommRequestNotificationEnabled = false
        ComMNoCom = true
        ComMNoWakeUpInhibitionNvmStorage = false
        ComMNoWakeup = true
        ComMBusType = COMM_BUS_TYPE_CAN
        ComMNetworkManagement: ComMNmLightTimeout=10, ComMPncNmRequest=false, ComMNmVariant=FULL
        ComMUserPerChannel_Can_NCluster_Channel (ComMUserPerChannel): ComMUserChannel=ComMUser_Can_NCluster_Channel
  module config CanIf: implementation-config-variant=VARIANT-PRE-COMPILE
    CanIfInitCfg: CanIfInitCfgSet=0
      CanIfInitHohCfg
        3 x CanIfHrhCfg, all with CanIfHrhCanCtrlIdRef=CANNODE_0:
          CANNODE_0_Rx_Std_MailBox_{1..3}: CanIfHrhIdSymRef=CANNODE_0_Rx_Std_MailBox_{1..3}
        CANNODE_0_Tx_Std_MailBox_1 (CanIfHthCfg): CanIfHthIdSymRef=CANNODE_0_Tx_Std_MailBox_1, CanIfHthCanCtrlIdRef=CANNODE_0
        CANNODE_0_Tx_Std_MailBox_2 (CanIfHthCfg): CanIfHthIdSymRef=CANNODE_0_Tx_Std_MailBox_2, CanIfHthCanCtrlIdRef=CANNODE_0
      3 x CanIfRxPduCfg, all with CanIfRxPduReadData=false, CanIfRxPduReadNotifyStatus=true, CanIfRxPduCanIdType=STANDARD_CAN, CanIfRxPduDlc=8:
        TMR_3_CANNODE_0: CanIfRxPduCanId=808, CanIfRxPduUserRxIndicationName=PduR_CanIfRxIndication, CanIfRxPduUserRxIndicationUL=PDUR, CanIfRxPduHrhIdRef=CANNODE_0_Rx_Std_MailBox_1, CanIfRxPduRef=PduCollection/TMR_3_CANNODE_0_CanIf2PduR
        NMm_CDU_CANNODE_0: CanIfRxPduCanId=1583, CanIfRxPduUserRxIndicationUL=CAN_NM, CanIfRxPduHrhIdRef=CANNODE_0_Rx_Std_MailBox_2, CanIfRxPduRef=NMm_CDU_CANNODE_0_CanIf2CanNm
        OBC_4_CANNODE_0: CanIfRxPduCanId=1084, CanIfRxPduUserRxIndicationName=PduR_CanIfRxIndication, CanIfRxPduUserRxIndicationUL=PDUR, CanIfRxPduHrhIdRef=CANNODE_0_Rx_Std_MailBox_3, CanIfRxPduRef=PduCollection/OBC_4_CANNODE_0_CanIf2PduR
      Buffer_CANNODE_0_Tx_Std_MailBox_1 (CanIfBufferCfg): CanIfBufferSize=0, CanIfBufferHthRef=CANNODE_0_Tx_Std_MailBox_1
      BMS_Vol_5_CANNODE_0 (CanIfTxPduCfg):
        CanIfTxPduReadNotifyStatus = false
        CanIfTxPduType = STATIC
        CanIfTxPduTruncation = false
        CanIfTxPduCanIdType = STANDARD_CAN
        CanIfTxPduCanId = 1348
        CanIfTxPduUserTxConfirmationUL = PDUR
        CanIfTxPduBufferRef = Buffer_CANNODE_0_Tx_Std_MailBox_1
        CanIfTxPduRef = PduCollection/BMS_Vol_5_CANNODE_0_PduR2CanIf
      Buffer_CANNODE_0_Tx_Std_MailBox_2 (CanIfBufferCfg): CanIfBufferSize=0, CanIfBufferHthRef=CANNODE_0_Tx_Std_MailBox_2
      NMm_BMS_CANNODE_0 (CanIfTxPduCfg):
        CanIfTxPduReadNotifyStatus = false
        CanIfTxPduType = STATIC
        CanIfTxPduTruncation = false
        CanIfTxPduCanIdType = STANDARD_CAN
        CanIfTxPduCanId = 1551
        CanIfTxPduUserTxConfirmationUL = CAN_NM
        CanIfTxPduBufferRef = Buffer_CANNODE_0_Tx_Std_MailBox_2
        CanIfTxPduRef = NMm_BMS_CANNODE_0_CanNm2CanIf
    CanIfCtrlDrvCfg: CanIfRbCtrlDrvPrefix=CanConf_CanHardwareObject, CanIfCtrlDrvNameRef=CanGeneral, CanIfCtrlDrvInitHohConfigRef=CanIfInitHohCfg
      CANNODE_0 (CanIfCtrlCfg): CanIfCtrlWakeupSupport=false, CanIfCtrlCanCtrlRef=CANNODE_0
    CanIfDispatchCfg: CanIfDispatchUserCtrlBusOffUL=CAN_SM, CanIfDispatchUserCtrlModeIndicationUL=CAN_SM, CanIfDispatchUserTrcvModeIndicationName=CAN_SM
    CanIfPrivateCfg: CanIfPrivateDlcCheck=false
    CanIfPublicCfg:
      CanIfPublicReadRxPduDataApi = false
      CanIfPublicReadRxPduNotifyStatusApi = true
      CanIfPublicReadTxPduNotifyStatusApi = true
      CanIfPublicSetDynamicTxIdApi = false
      CanIfPublicTxBuffering = false
      CanIfPublicTxConfirmPollingSupport = false
      CanIfPublicVersionInfoApi = false
      CanIfPublicCancelTransmitSupport = false
      CanIfPublicErrorPassiveSupport = false
      CanIfPublicCanIfLiteConfiguration = false
      CanIfPublicUserTpTxInOfflineMode = false
      CanIfPublicWakeupCheckValidSupport = false
      CanIfPublicPnSupport = false
      CanIfPublicBusoffRecoveryfromRxIndication = false
      CanIfTriggerTransmitSupport = false
      CanIfTxOfflineActiveSupport = false
      CanIfWakeupSupport = false
      CanIfPublicDevErrorDetect = false
  module config CanSM: implementation-config-variant=VARIANT-PRE-COMPILE
    CanSMConfiguration: CanSMModeRequestRepetitionMax=5, CanSMModeRequestRepetitionTime=0.07
      CanSMManagerNetwork_Can_NCluster (CanSMManagerNetwork):
        CanSMBorTxConfirmationPolling = false
        CanSMBorCounterL1ToL2 = 0
        CanSMBorTimeL1 = 0.04
        CanSMBorTimeL2 = 0.1
        CanSMBorTimeTxEnsured = 0.02
        CanSMComMNetworkHandleRef = ComMChannel_Can_NCluster_Channel
        CanSMDemEventParameterRefs: CanSMRbDynCreate_CANSM_E_BUS_OFF=Standard
        CanSMController_CANNODE_0 (CanSMController): CanSMControllerId=CANNODE_0
    CanSMGeneral: CanSMMainFunctionTimePeriod=0.01, CanSMVersionInfoApi=false, CanSMDevErrorDetect=false
  module config PduR: implementation-config-variant=VARIANT-PRE-COMPILE
    PduRGeneral:
      PduRVersionInfoApi = false
      PduRZeroCostOperation = false
      PduRFifoTxBufferSupport = false
      PduRIFGatewayOperation = false
      PduRTPGatewayOperation = false
      PduRMemorySize = 0
      PduRMinimumRoutingLoRxPduId = 0
      PduRMinimumRoutingLoTxPduId = 0
      PduRMinimumRoutingUpRxPduId = 0
      PduRMinimumRoutingUpTxPduId = 0
      PduRMulticastFromIfSupport = false
      PduRMulticastFromTpSupport = false
      PduRMulticastToIfSupport = false
      PduRMulticastToTpSupport = false
      PduRSbTxBufferSupport = false
      PduRQueueingSupport = false
      PduRCanTpChangeParameterRequestApi = false
      PduRFrTpChangeParameterRequestApi = false
      PduRGwTpWithLimitedBuffer = false
      PduRDevErrorDetect = false
    PduRRoutingTables: PduRConfigurationId=0
      PduRRoutingTable
        3 x PduRRoutingPath:
          TMR_3_CANNODE_0_CanIf2Com
            TMR_3_CANNODE_0_CanIf2PduR (PduRSrcPdu): PduRSrcPduRef=PduCollection/TMR_3_CANNODE_0_CanIf2PduR
            TMR_3_CANNODE_0_PduR2Com (PduRDestPdu): PduRTransmissionConfirmation=false, PduRDestPduRef=PduCollection/TMR_3_CANNODE_0_PduR2Com
          OBC_4_CANNODE_0_CanIf2Com
            OBC_4_CANNODE_0_CanIf2PduR (PduRSrcPdu): PduRSrcPduRef=PduCollection/OBC_4_CANNODE_0_CanIf2PduR
            OBC_4_CANNODE_0_PduR2Com (PduRDestPdu): PduRTransmissionConfirmation=false, PduRDestPduRef=PduCollection/OBC_4_CANNODE_0_PduR2Com
          BMS_Vol_5_CANNODE_0_Com2CanIf
            BMS_Vol_5_CANNODE_0_Com2PduR (PduRSrcPdu): PduRSrcPduRef=PduCollection/BMS_Vol_5_CANNODE_0_Com2PduR
            BMS_Vol_5_CANNODE_0_PduR2CanIf (PduRDestPdu): PduRTransmissionConfirmation=false, PduRDestPduRef=PduCollection/BMS_Vol_5_CANNODE_0_PduR2CanIf
    3 x PduRBswModules, all with PduRCancelReceive=0, PduRCancelTransmit=0, PduRChangeParameterApi=0, PduRCommunicationInterface=1, PduRRetransmission=0, PduRUseTag=0:
      CanNm: PduRLowerModule=1, PduRTransportProtocol=0, PduRTriggertransmit=1, PduRTxConfirmation=1, PduRUpperModule=0, PduRBswModuleRef=CanNm
      CanIf: PduRLowerModule=1, PduRTransportProtocol=0, PduRTriggertransmit=0, PduRTxConfirmation=1, PduRUpperModule=0, PduRBswModuleRef=CanIf
      Com: PduRLowerModule=0, PduRTransportProtocol=1, PduRTriggertransmit=1, PduRTxConfirmation=0, PduRUpperModule=1, PduRBswModuleRef=Com
  module config EcuC: implementation-config-variant=VARIANT-PRE-COMPILE
    EcucConfigSet
      PduCollection (EcucPduCollection): PduIdTypeEnum=uint16, PduLengthTypeEnum=uint16
        8 x Pdu, all with PduLength=8:
          TMR_3_CANNODE_0_CanIf2PduR
          TMR_3_CANNODE_0_PduR2Com
          NMm_CDU_CANNODE_0_CanIf2CanNm
          OBC_4_CANNODE_0_CanIf2PduR
          OBC_4_CANNODE_0_PduR2Com
          BMS_Vol_5_CANNODE_0_Com2PduR
          BMS_Vol_5_CANNODE_0_PduR2CanIf
          NMm_BMS_CANNODE_0_CanNm2CanIf
    EcuCRbSettings: EcuCRbArRelease=AR42_Rev2, EcuCRbRteInUse=true
  module config Com: implementation-config-variant=VARIANT-PRE-COMPILE
    ComConfig_0 (ComConfig)
      ComTimeBase: ComGwTimeBase=0.005, ComRxTimeBase=0.01, ComTxTimeBase=0.01
      ComIPduGroup_Rx (ComIPduGroup)
      TMR_3_CANNODE_0 (ComIPdu):
        ComIPduSignalProcessing = IMMEDIATE
        ComIPduType = NORMAL
        ComIPduDirection = RECEIVE
        ComIPduGroupRef = ComIPduGroup_Rx
        ComPduIdRef = PduCollection/TMR_3_CANNODE_0_PduR2Com
        ComIPduSignalRef = TMR_VoltageHV
        ComIPduSignalRef = TMR_CurrentHV
      TMR_VoltageHV (ComSignal):
        ComSignalInitValue = 0
        ComSignalType = UINT16
        ComSignalEndianness = BIG_ENDIAN
        ComBitSize = 10
        ComBitPosition = 12
        ComUpdateBitPosition = -1
        ComTransferProperty = TRIGGERED
        ComSystemTemplateSystemSignalRef = TMR_VoltageHV
      TMR_CurrentHV (ComSignal):
        ComSignalInitValue = 1023
        ComSignalType = UINT16
        ComSignalEndianness = BIG_ENDIAN
        ComBitSize = 11
        ComBitPosition = 7
        ComUpdateBitPosition = -1
        ComTransferProperty = TRIGGERED
        ComSystemTemplateSystemSignalRef = TMR_CurrentHV
      OBC_4_CANNODE_0 (ComIPdu):
        ComIPduSignalProcessing = IMMEDIATE
        ComIPduType = NORMAL
        ComIPduDirection = RECEIVE
        ComIPduGroupRef = ComIPduGroup_Rx
        ComPduIdRef = PduCollection/OBC_4_CANNODE_0_PduR2Com
        ComIPduSignalRef = OBC_ChargeSourceMode
        ComIPduSignalRef = OBC_FaultCode
        ComIPduSignalRef = OBC_MaxOutputVoltage
        ComIPduSignalRef = OBC_MaxOutputCurrent
      4 x ComSignal, all with ComSignalInitValue=0, ComSignalEndianness=BIG_ENDIAN, ComUpdateBitPosition=-1, ComTransferProperty=TRIGGERED:
        OBC_ChargeSourceMode: ComSignalType=UINT8, ComBitSize=2, ComBitPosition=53, ComSystemTemplateSystemSignalRef=OBC_ChargeSourceMode
        OBC_FaultCode: ComSignalType=UINT8, ComBitSize=8, ComBitPosition=39, ComSystemTemplateSystemSignalRef=OBC_FaultCode
        OBC_MaxOutputVoltage: ComSignalType=UINT16, ComBitSize=16, ComBitPosition=23, ComSystemTemplateSystemSignalRef=OBC_MaxOutputVoltage
        OBC_MaxOutputCurrent: ComSignalType=UINT16, ComBitSize=16, ComBitPosition=7, ComSystemTemplateSystemSignalRef=OBC_MaxOutputCurrent
      ComIPduGroup_Tx (ComIPduGroup)
      BMS_Vol_5_CANNODE_0 (ComIPdu):
        ComIPduSignalProcessing = IMMEDIATE
        ComIPduType = NORMAL
        ComIPduDirection = SEND
        ComFirstTimeout = 1.0
        ComTimeout = 1.0
        ComIPduGroupRef = ComIPduGroup_Tx
        ComPduIdRef = PduCollection/BMS_Vol_5_CANNODE_0_Com2PduR
        ComIPduSignalRef = BMS_BattCellOrder20Vol
        ComIPduSignalRef = BMS_BattCellOrder19Vol
        ComIPduSignalRef = BMS_BattCellOrder18Vol
        ComIPduSignalRef = BMS_BattCellOrder17Vol
        ComTxIPdu: ComMinimumDelayTime=0.0, ComTxIPduUnusedAreasDefault=255
          ComTxModeTrue
            ComTxMode: ComTxModeTimePeriod=1.0, ComTxModeMode=PERIODIC, ComTxModeNumberOfRepetitions=0, ComTxModeRepetitionPeriod=0, ComTxModeTimeOffset=0.0
          ComTxModeFalse
            ComTxMode: ComTxModeTimePeriod=1.0, ComTxModeMode=PERIODIC, ComTxModeNumberOfRepetitions=0, ComTxModeRepetitionPeriod=0, ComTxModeTimeOffset=0.0
      4 x ComSignal, all with ComSignalInitValue=0, ComSignalType=UINT16, ComSignalEndianness=BIG_ENDIAN, ComBitSize=16, ComUpdateBitPosition=-1, ComTransferProperty=TRIGGERED:
        BMS_BattCellOrder20Vol: ComBitPosition=55, ComSystemTemplateSystemSignalRef=BMS_BattCellOrder20Vol
        BMS_BattCellOrder19Vol: ComBitPosition=39, ComSystemTemplateSystemSignalRef=BMS_BattCellOrder19Vol
        BMS_BattCellOrder18Vol: ComBitPosition=23, ComSystemTemplateSystemSignalRef=BMS_BattCellOrder18Vol
        BMS_BattCellOrder17Vol: ComBitPosition=7, ComSystemTemplateSystemSignalRef=BMS_BattCellOrder17Vol
    ComGeneral:
      ComVersionInfoApi = false
      ComCommonIPduTxPeriodFeature = false
      ComEnableJitterFilter = false
      ComEnableSignalGroupArrayApi = false
      ComCancellationSupport = false
      ComConfigurationUseDet = false
  module config Nm: implementation-config-variant=VARIANT-PRE-COMPILE
    NmGlobalConfig
      NmGlobalConstants: NmNumberOfChannels=1, NmRemoteSleepCancelCallback=TestNm_RemoteSleepCancellation, NmRemoteSleepIndCallback=TestNm_RemoteSleepIndication
      NmGlobalProperties: NmVersionInfoApi=true, NmCycletimeMainFunction=0.01, NmDevErrorDetect=false
      NmGlobalFeatures:
        NmCarWakeUpRxEnabled = false
        NmComUserDataSupport = false
        NmCoordinatorSupportEnabled = false
        NmBusSynchronizationEnabled = false
        NmComControlEnabled = false
        NmCoordinatorSyncSupport = false
        NmNodeDetectionEnabled = false
        NmNodeIdEnabled = false
        NmPassiveModeEnabled = false
        NmPduRxIndicationEnabled = false
        NmRemoteSleepIndEnabled = false
        NmRepeatMsgIndEnabled = false
        NmUserDataEnabled = false
        NmStateChangeIndEnabled = false
    NmChannelConfig_Can_NCluster_Channel (NmChannelConfig):
      NmChannelSleepMaster = false
      NmStateReportEnabled = false
      NmSynchronizingNetwork = false
      NmShutdownDelayTimer = 0.0
      NmComMChannelRef = ComMChannel_Can_NCluster_Channel
      NmBusType
        NmStandardBusNmConfig: NmStandardBusType=NM_BUSNM_CANNM
