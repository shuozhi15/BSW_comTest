AUTOSAR XML (schema 4-2-2)
package /ETAS_Project/EcucModuleConfigurationValuess
  module config ComM: implementation-config-variant=VARIANT-PRE-COMPILE
    ComMGeneral:
      ComMEcuGroupClassification = 0
      ComMModeLimitationEnabled = false
      ComMTMinFullComModeDuration = 0.01
      ComMVersionInfoApi = false
      ComMWakeupInhibitionEnabled = false
      ComMPncGatewayEnabled = false
      ComMPncSupport = false
      ComMResetAfterForcingNoComm = false
      ComMSynchronousWakeUp = false
      ComMRteEnabled = false
      ComMDevErrorDetect = false
    ComMConfigSet
      ComMUser_Can_Network_Channel (ComMUser)
      ComMChannel_Can_Network_Channel (ComMChannel):
        ComMMainFunctionPeriod = 0.01
        ComMFullCommRequestNotificationEnabled = false
        ComMNoCom = true
        ComMNoWakeUpInhibitionNvmStorage = false
        ComMNoWakeup = true
        ComMBusType = COMM_BUS_TYPE_CAN
        ComMNetworkManagement: ComMNmLightTimeout=10, ComMNmVariant=NONE, ComMPncNmRequest=false
        ComMUserPerChannel_Can_Network_Channel (ComMUserPerChannel): ComMUserChannel=ComMUser_Can_Network_Channel
  module config CanIf: implementation-config-variant=VARIANT-PRE-COMPILE
    CanIfInitCfg: CanIfInitCfgSet=0
      CanIfInitHohCfg
        Can_Network_CANNODE_0_Rx_Std_MailBox_1 (CanIfHrhCfg): CanIfHrhIdSymRef=Can_Network_CANNODE_0_Rx_Std_MailBox_1, CanIfHrhCanCtrlIdRef=Can_Network_CANNODE_0
        Can_Network_CANNODE_0_Tx_Std_MailBox_1 (CanIfHthCfg): CanIfHthIdSymRef=Can_Network_CANNODE_0_Tx_Std_MailBox_1, CanIfHthCanCtrlIdRef=Can_Network_CANNODE_0
      TMR_3_Can_Network_CANNODE_0 (CanIfRxPduCfg):
        CanIfRxPduReadData = false
        CanIfRxPduReadNotifyStatus = true
        CanIfRxPduCanId = 808
        CanIfRxPduCanIdType = STANDARD_CAN
        CanIfRxPduDlc = 8
        CanIfRxPduUserRxIndicationName = PduR_CanIfRxIndication
        CanIfRxPduUserRxIndicationUL = PDUR
        CanIfRxPduHrhIdRef = Can_Network_CANNODE_0_Rx_Std_MailBox_1
        CanIfRxPduRef = PduCollection/TMR_3_Can_Network_CANNODE_0_CanIf2PduR
      Buffer_Can_Network_CANNODE_0_Tx_Std_MailBox_1 (CanIfBufferCfg): CanIfBufferSize=0, CanIfBufferHthRef=Can_Network_CANNODE_0_Tx_Std_MailBox_1
      BMS_14_Can_Network_CANNODE_0 (CanIfTxPduCfg):
        CanIfTxPduReadNotifyStatus = false
        CanIfTxPduType = STATIC
        CanIfTxPduTruncation = false
        CanIfTxPduCanIdType = STANDARD_CAN
        CanIfTxPduCanId = 1452
        CanIfTxPduUserTxConfirmationUL = PDUR
        CanIfTxPduBufferRef = Buffer_Can_Network_CANNODE_0_Tx_Std_MailBox_1
        CanIfTxPduRef = PduCollection/BMS_14_Can_Network_CANNODE_0_PduR2CanIf
    CanIfCtrlDrvCfg: CanIfRbCtrlDrvPrefix=CanConf_CanHardwareObject, CanIfCtrlDrvNameRef=CanGeneral, CanIfCtrlDrvInitHohConfigRef=CanIfInitHohCfg
      Can_Network_CANNODE_0 (CanIfCtrlCfg): CanIfCtrlWakeupSupport=false, CanIfCtrlCanCtrlRef=Can_Network_CANNODE_0
    CanIfDispatchCfg: CanIfDispatchUserCtrlBusOffUL=CAN_SM, CanIfDispatchUserCtrlModeIndicationUL=CAN_SM, CanIfDispatchUserTrcvModeIndicationName=CAN_SM
    CanIfPrivateCfg: CanIfPrivateDlcCheck=false
    CanIfPublicCfg:
      CanIfPublicReadRxPduDataApi = false
      CanIfPublicReadRxPduNotifyStatusApi = true
      CanIfPublicReadTxPduNotifyStatusApi = true
      CanIfPublicSetDynamicTxIdApi = false
      CanIfPublicTxBuffering = false
      CanIfPublicTxConfirmPollingSupport = false
      CanIfPublicVersionInfoApi = false
      CanIfPublicCancelTransmitSupport = false
      CanIfPublicErrorPassiveSupport = false
      CanIfPublicCanIfLiteConfiguration = false
      CanIfPublicUserTpTxInOfflineMode = false
      CanIfPublicWakeupCheckValidSupport = false
      CanIfPublicPnSupport = false
      CanIfPublicBusoffRecoveryfromRxIndication = false
      CanIfTriggerTransmitSupport = false
      CanIfTxOfflineActiveSupport = false
      CanIfWakeupSupport = false
      CanIfPublicDevErrorDetect = false
  module config CanSM: implementation-config-variant=VARIANT-PRE-COMPILE
    CanSMConfiguration: CanSMModeRequestRepetitionMax=5, CanSMModeRequestRepetitionTime=0.07
      CanSMManagerNetwork_Can_Network (CanSMManagerNetwork):
        CanSMBorTxConfirmationPolling = false
        CanSMBorCounterL1ToL2 = 0
        CanSMBorTimeL1 = 0.04
        CanSMBorTimeL2 = 0.1
        CanSMBorTimeTxEnsured = 0.02
        CanSMComMNetworkHandleRef = ComMChannel_Can_Network_Channel
        CanSMDemEventParameterRefs: CanSMRbDynCreate_CANSM_E_BUS_OFF=Standard
        CanSMController_Can_Network_CANNODE_0 (CanSMController): CanSMControllerId=Can_Network_CANNODE_0
    CanSMGeneral: CanSMMainFunctionTimePeriod=0.01, CanSMVersionInfoApi=false, CanSMDevErrorDetect=false
  module config PduR: implementation-config-variant=VARIANT-PRE-COMPILE
    PduRGeneral:
      PduRVersionInfoApi = false
      PduRZeroCostOperation = false
      PduRFifoTxBufferSupport = false
      PduRIFGatewayOperation = false
      PduRTPGatewayOperation = false
      PduRMemorySize = 0
      PduRMinimumRoutingLoRxPduId = 0
      PduRMinimumRoutingLoTxPduId = 0
      PduRMinimumRoutingUpRxPduId = 0
      PduRMinimumRoutingUpTxPduId = 0
      PduRMulticastFromIfSupport = false
      PduRMulticastFromTpSupport = false
      PduRMulticastToIfSupport = false
      PduRMulticastToTpSupport = false
      PduRSbTxBufferSupport = false
      PduRQueueingSupport = false
      PduRCanTpChangeParameterRequestApi = false
      PduRFrTpChangeParameterRequestApi = false
      PduRGwTpWithLimitedBuffer = false
      PduRDevErrorDetect = false
    PduRRoutingTables: PduRConfigurationId=0
      PduRRoutingTable
        TMR_3_Can_Network_CANNODE_0_CanIf2Com (PduRRoutingPath)
          TMR_3_Can_Network_CANNODE_0_CanIf2PduR (PduRSrcPdu): PduRSrcPduRef=PduCollection/TMR_3_Can_Network_CANNODE_0_CanIf2PduR
          TMR_3_Can_Network_CANNODE_0_PduR2Com (PduRDestPdu): PduRTransmissionConfirmation=false, PduRDestPduRef=PduCollection/TMR_3_Can_Network_CANNODE_0_PduR2Com
        BMS_14_Can_Network_CANNODE_0_Com2CanIf (PduRRoutingPath)
          BMS_14_Can_Network_CANNODE_0_Com2PduR (PduRSrcPdu): PduRSrcPduRef=PduCollection/BMS_14_Can_Network_CANNODE_0_Com2PduR
          BMS_14_Can_Network_CANNODE_0_PduR2CanIf (PduRDestPdu): PduRTransmissionConfirmation=false, PduRDestPduRef=PduCollection/BMS_14_Can_Network_CANNODE_0_PduR2CanIf
    CanIf (PduRBswModules):
      PduRCancelReceive = 0
      PduRCancelTransmit = 0
      PduRChangeParameterApi = 0
      PduRCommunicationInterface = 1
      PduRLowerModule = 1
      PduRRetransmission = 0
      PduRTransportProtocol = 0
      PduRTriggertransmit = 0
      PduRTxConfirmation = 1
      PduRUpperModule = 0
      PduRUseTag = 0
      PduRBswModuleRef = CanIf
    Com (PduRBswModules):
      PduRCancelReceive = 0
      PduRCancelTransmit = 0
      PduRChangeParameterApi = 0
      PduRCommunicationInterface = 1
      PduRLowerModule = 0
      PduRRetransmission = 0
      PduRTransportProtocol = 1
      PduRTriggertransmit = 1
      PduRTxConfirmation = 0
      PduRUpperModule = 1
      PduRUseTag = 0
      PduRBswModuleRef = Com
  module config EcuC: implementation-config-variant=VARIANT-PRE-COMPILE
    EcucConfigSet
      PduCollection (EcucPduCollection): PduIdTypeEnum=uint16, PduLengthTypeEnum=uint16
        4 x Pdu, all with PduLength=8:
          TMR_3_Can_Network_CANNODE_0_CanIf2PduR
          TMR_3_Can_Network_CANNODE_0_PduR2Com
          BMS_14_Can_Network_CANNODE_0_Com2PduR
          BMS_14_Can_Network_CANNODE_0_PduR2CanIf
    EcuCRbSettings: EcuCRbArRelease=AR42_Rev2, EcuCRbRteInUse=true
  module config Com: implementation-config-variant=VARIANT-PRE-COMPILE
    ComConfig_0 (ComConfig)
      ComTimeBase: ComGwTimeBase=0.005, ComRxTimeBase=0.01, ComTxTimeBase=0.01
      ComIPduGroup_Rx (ComIPduGroup)
      TMR_3_Can_Network_CANNODE_0 (ComIPdu):
        ComIPduSignalProcessing = IMMEDIATE
        ComIPduType = NORMAL
        ComIPduDirection = RECEIVE
        ComIPduGroupRef = ComIPduGroup_Rx
        ComPduIdRef = PduCollection/TMR_3_Can_Network_CANNODE_0_PduR2Com
        ComIPduSignalRef = TMR_VoltageHV
        ComIPduSignalRef = TMR_CurrentHV
      TMR_VoltageHV (ComSignal):
        ComSignalInitValue = 0
        ComSignalType = UINT16
        ComSignalEndianness = BIG_ENDIAN
        ComBitSize = 10
        ComBitPosition = 12
        ComUpdateBitPosition = -1
        ComTransferProperty = TRIGGERED
        ComSystemTemplateSystemSignalRef = TMR_VoltageHV
      TMR_CurrentHV (ComSignal):
        ComSignalInitValue = 1023
        ComSignalType = UINT16
        ComSignalEndianness = BIG_ENDIAN
        ComBitSize = 11
        ComBitPosition = 7
        ComUpdateBitPosition = -1
        ComTransferProperty = TRIGGERED
        ComSystemTemplateSystemSignalRef = TMR_CurrentHV
      ComIPduGroup_Tx (ComIPduGroup)
      BMS_14_Can_Network_CANNODE_0 (ComIPdu):
        ComIPduSignalProcessing = IMMEDIATE
        ComIPduType = NORMAL
        ComIPduDirection = SEND
        ComFirstTimeout = 1.0
        ComTimeout = 1.0
        ComIPduGroupRef = ComIPduGroup_Tx
        ComPduIdRef = PduCollection/BMS_14_Can_Network_CANNODE_0_Com2PduR
        ComIPduSignalRef = BMS_SubsymCodeOrder12
        ComIPduSignalRef = BMS_SubsymCodeOrder11
        ComIPduSignalRef = BMS_SubsymCodeOrder10
        ComIPduSignalRef = BMS_SubsymCodeOrder9
        ComIPduSignalRef = BMS_SubsymCodeOrder8
        ComIPduSignalRef = BMS_SubsymCodeOrder7
        ComIPduSignalRef = BMS_SubsymCodeFrameTotalNum
        ComIPduSignalRef = BMS_SubsymCodeFrameOrder2
        ComTxIPdu: ComMinimumDelayTime=0.0, ComTxIPduUnusedAreasDefault=255
          ComTxModeTrue
            ComTxMode: ComTxModeTimePeriod=1.0, ComTxModeMode=PERIODIC, ComTxModeNumberOfRepetitions=0, ComTxModeRepetitionPeriod=0, ComTxModeTimeOffset=0.0
          ComTxModeFalse
            ComTxMode: ComTxModeTimePeriod=1.0, ComTxModeMode=PERIODIC, ComTxModeNumberOfRepetitions=0, ComTxModeRepetitionPeriod=0, ComTxModeTimeOffset=0.0
      8 x ComSignal, all with ComSignalInitValue=0, ComSignalType=UINT8, ComSignalEndianness=BIG_ENDIAN, ComBitSize=8, ComUpdateBitPosition=-1, ComTransferProperty=TRIGGERED:
        BMS_SubsymCodeOrder12: ComBitPosition=63, ComSystemTemplateSystemSignalRef=BMS_SubsymCodeOrder12
        BMS_SubsymCodeOrder11: ComBitPosition=55, ComSystemTemplateSystemSignalRef=BMS_SubsymCodeOrder11
        BMS_SubsymCodeOrder10: ComBitPosition=47, ComSystemTemplateSystemSignalRef=BMS_SubsymCodeOrder10
        BMS_SubsymCodeOrder9: ComBitPosition=39, ComSystemTemplateSystemSignalRef=BMS_SubsymCodeOrder9
        BMS_SubsymCodeOrder8: ComBitPosition=31, ComSystemTemplateSystemSignalRef=BMS_SubsymCodeOrder8
        BMS_SubsymCodeOrder7: ComBitPosition=23, ComSystemTemplateSystemSignalRef=BMS_SubsymCodeOrder7
        BMS_SubsymCodeFrameTotalNum: ComBitPosition=15, ComSystemTemplateSystemSignalRef=BMS_SubsymCodeFrameTotalNum
        BMS_SubsymCodeFrameOrder2: ComBitPosition=7, ComSystemTemplateSystemSignalRef=BMS_SubsymCodeFrameOrder2
    ComGeneral:
      ComVersionInfoApi = false
      ComCommonIPduTxPeriodFeature = false
      ComEnableJitterFilter = false
      ComEnableSignalGroupArrayApi = false
      ComCancellationSupport = false
      ComConfigurationUseDet = false
