AUTOSAR XML (schema 4-2-2)
package /Can
  module config Can: implementation-config-variant=VARIANT-PRE-COMPILE
    CanGeneral:
      CanMainFunctionBusoffPeriod = 0.0010
      CanMainFunctionModePeriod = 0.0010
      CanMultiplexedTransmission = false
      CanVersionInfoApi = false
      CanIndex = 0
      CanPublicIcomSupport = false
      CanTimeoutDuration = 1
      CanDevErrorDetection = false
    CanConfigSet
      Can_Network_CANNODE_0 (CanController):
        CanBusoffProcessing = POLLING
        CanControllerActivation = true
        CanControllerBaseAddress = 0
        CanTxProcessing = POLLING
        CanWakeupFunctionalityAPI = false
        CanWakeupProcessing = POLLING
        CanWakeupSupport = false
        CanControllerId = 0
        CanRxProcessing = POLLING
        CanControllerDefaultBaudrate = Can_Network_CANNODE_0/Can_Network_CANNODE_0
        Can_Network_CANNODE_0 (CanControllerBaudrateConfig):
          CanControllerBaudRateConfigID = 1
          CanControllerBaudRate = 500
          CanControllerPropSeg = 2
          CanControllerSeg1 = 12
          CanControllerSeg2 = 5
          CanControllerSyncJumpWidth = 1
      81 x CanHardwareObject, all with CanHwObjectCount=1, CanHandleType=FULL, CanIdType=STANDARD, CanControllerRef=CanConfigSet/Can_Network_CANNODE_0:
        Can_Network_CANNODE_0_Rx_Std_MailBox_1: CanObjectType=RECEIVE, CanObjectId=0
          CanHwFilter: CanHwFilterCode=808, CanHwFilterMask=2047
        Can_Network_CANNODE_0_Rx_Std_MailBox_2: CanObjectType=RECEIVE, CanObjectId=1
          CanHwFilter: CanHwFilterCode=1241, CanHwFilterMask=2047
        Can_Network_CANNODE_0_Rx_Std_MailBox_3: CanObjectType=RECEIVE, CanObjectId=2
          CanHwFilter: CanHwFilterCode=1064, CanHwFilterMask=2047
        Can_Network_CANNODE_0_Rx_Std_MailBox_4: CanObjectType=RECEIVE, CanObjectId=3
          CanHwFilter: CanHwFilterCode=1084, CanHwFilterMask=2047
        Can_Network_CANNODE_0_Rx_Std_MailBox_5: CanObjectType=RECEIVE, CanObjectId=4
          CanHwFilter: CanHwFilterCode=1282, CanHwFilterMask=2047
        Can_Network_CANNODE_0_Rx_Std_MailBox_6: CanObjectType=RECEIVE, CanObjectId=5
          CanHwFilter: CanHwFilterCode=371, CanHwFilterMask=2047
        Can_Network_CANNODE_0_Rx_Std_MailBox_7: CanObjectType=RECEIVE, CanObjectId=6
          CanHwFilter: CanHwFilterCode=1061, CanHwFilterMask=2047
        Can_Network_CANNODE_0_Rx_Std_MailBox_8: CanObjectType=RECEIVE, CanObjectId=7
          CanHwFilter: CanHwFilterCode=795, CanHwFilterMask=2047
        Can_Network_CANNODE_0_Rx_Std_MailBox_9: CanObjectType=RECEIVE, CanObjectId=8
          CanHwFilter: CanHwFilterCode=1213, CanHwFilterMask=2047
        Can_Network_CANNODE_0_Rx_Std_MailBox_10: CanObjectType=RECEIVE, CanObjectId=9
          CanHwFilter: CanHwFilterCode=1333, CanHwFilterMask=2047
        Can_Network_CANNODE_0_Rx_Std_MailBox_11: CanObjectType=RECEIVE, CanObjectId=10
          CanHwFilter: CanHwFilterCode=1034, CanHwFilterMask=2047
        Can_Network_CANNODE_0_Rx_Std_MailBox_12: CanObjectType=RECEIVE, CanObjectId=11
          CanHwFilter: CanHwFilterCode=856, CanHwFilterMask=2047
        Can_Network_CANNODE_0_Rx_Std_MailBox_13: CanObjectType=RECEIVE, CanObjectId=12
          CanHwFilter: CanHwFilterCode=1054, CanHwFilterMask=2047
        Can_Network_CANNODE_0_Rx_Std_MailBox_14: CanObjectType=RECEIVE, CanObjectId=13
          CanHwFilter: CanHwFilterCode=2021, CanHwFilterMask=2047
        Can_Network_CANNODE_0_Rx_Std_MailBox_15: CanObjectType=RECEIVE, CanObjectId=14
          CanHwFilter: CanHwFilterCode=1072, CanHwFilterMask=2047
        Can_Network_CANNODE_0_Rx_Std_MailBox_16: CanObjectType=RECEIVE, CanObjectId=15
          CanHwFilter: CanHwFilterCode=264, CanHwFilterMask=2047
        Can_Network_CANNODE_0_Rx_Std_MailBox_17: CanObjectType=RECEIVE, CanObjectId=16
          CanHwFilter: CanHwFilterCode=640, CanHwFilterMask=2047
        Can_Network_CANNODE_0_Rx_Std_MailBox_18: CanObjectType=RECEIVE, CanObjectId=17
          CanHwFilter: CanHwFilterCode=1048, CanHwFilterMask=2047
        Can_Network_CANNODE_0_Rx_Std_MailBox_19: CanObjectType=RECEIVE, CanObjectId=18
          CanHwFilter: CanHwFilterCode=2015, CanHwFilterMask=2047
        Can_Network_CANNODE_0_Rx_Std_MailBox_20: CanObjectType=RECEIVE, CanObjectId=19
          CanHwFilter: CanHwFilterCode=786, CanHwFilterMask=2047
        Can_Network_CANNODE_0_Rx_Std_MailBox_21: CanObjectType=RECEIVE, CanObjectId=20
          CanHwFilter: CanHwFilterCode=1266, CanHwFilterMask=2047
        Can_Network_CANNODE_0_Rx_Std_MailBox_22: CanObjectType=RECEIVE, CanObjectId=21
          CanHwFilter: CanHwFilterCode=326, CanHwFilterMask=2047
        Can_Network_CANNODE_0_Rx_Std_MailBox_23: CanObjectType=RECEIVE, CanObjectId=22
          CanHwFilter: CanHwFilterCode=1067, CanHwFilterMask=2047
        Can_Network_CANNODE_0_Rx_Std_MailBox_24: CanObjectType=RECEIVE, CanObjectId=23
          CanHwFilter: CanHwFilterCode=348, CanHwFilterMask=2047
        Can_Network_CANNODE_0_Rx_Std_MailBox_25: CanObjectType=RECEIVE, CanObjectId=24
          CanHwFilter: CanHwFilterCode=800, CanHwFilterMask=2047
        Can_Network_CANNODE_0_Tx_Std_MailBox_1: CanObjectType=TRANSMIT, CanObjectId=25
        Can_Network_CANNODE_0_Tx_Std_MailBox_2: CanObjectType=TRANSMIT, CanObjectId=26
        Can_Network_CANNODE_0_Tx_Std_MailBox_3: CanObjectType=TRANSMIT, CanObjectId=27
        Can_Network_CANNODE_0_Tx_Std_MailBox_4: CanObjectType=TRANSMIT, CanObjectId=28
        Can_Network_CANNODE_0_Tx_Std_MailBox_5: CanObjectType=TRANSMIT, CanObjectId=29
        Can_Network_CANNODE_0_Tx_Std_MailBox_6: CanObjectType=TRANSMIT, CanObjectId=30
        Can_Network_CANNODE_0_Tx_Std_MailBox_7: CanObjectType=TRANSMIT, CanObjectId=31
        Can_Network_CANNODE_0_Tx_Std_MailBox_8: CanObjectType=TRANSMIT, CanObjectId=32
        Can_Network_CANNODE_0_Tx_Std_MailBox_9: CanObjectType=TRANSMIT, CanObjectId=33
        Can_Network_CANNODE_0_Tx_Std_MailBox_10: CanObjectType=TRANSMIT, CanObjectId=34
        Can_Network_CANNODE_0_Tx_Std_MailBox_11: CanObjectType=TRANSMIT, CanObjectId=35
        Can_Network_CANNODE_0_Tx_Std_MailBox_12: CanObjectType=TRANSMIT, CanObjectId=36
        Can_Network_CANNODE_0_Tx_Std_MailBox_13: CanObjectType=TRANSMIT, CanObjectId=37
        Can_Network_CANNODE_0_Tx_Std_MailBox_14: CanObjectType=TRANSMIT, CanObjectId=38
        Can_Network_CANNODE_0_Tx_Std_MailBox_15: CanObjectType=TRANSMIT, CanObjectId=39
        Can_Network_CANNODE_0_Tx_Std_MailBox_16: CanObjectType=TRANSMIT, CanObjectId=40
        Can_Network_CANNODE_0_Tx_Std_MailBox_17: CanObjectType=TRANSMIT, CanObjectId=41
        Can_Network_CANNODE_0_Tx_Std_MailBox_18: CanObjectType=TRANSMIT, CanObjectId=42
        Can_Network_CANNODE_0_Tx_Std_MailBox_19: CanObjectType=TRANSMIT, CanObjectId=43
        Can_Network_CANNODE_0_Tx_Std_MailBox_20: CanObjectType=TRANSMIT, CanObjectId=44
        Can_Network_CANNODE_0_Tx_Std_MailBox_21: CanObjectType=TRANSMIT, CanObjectId=45
        Can_Network_CANNODE_0_Tx_Std_MailBox_22: CanObjectType=TRANSMIT, CanObjectId=46
        Can_Network_CANNODE_0_Tx_Std_MailBox_23: CanObjectType=TRANSMIT, CanObjectId=47
        Can_Network_CANNODE_0_Tx_Std_MailBox_24: CanObjectType=TRANSMIT, CanObjectId=48
        Can_Network_CANNODE_0_Tx_Std_MailBox_25: CanObjectType=TRANSMIT, CanObjectId=49
        Can_Network_CANNODE_0_Tx_Std_MailBox_26: CanObjectType=TRANSMIT, CanObjectId=50
        Can_Network_CANNODE_0_Tx_Std_MailBox_27: CanObjectType=TRANSMIT, CanObjectId=51
        Can_Network_CANNODE_0_Tx_Std_MailBox_28: CanObjectType=TRANSMIT, CanObjectId=52
        Can_Network_CANNODE_0_Tx_Std_MailBox_29: CanObjectType=TRANSMIT, CanObjectId=53
        Can_Network_CANNODE_0_Tx_Std_MailBox_30: CanObjectType=TRANSMIT, CanObjectId=54
        Can_Network_CANNODE_0_Tx_Std_MailBox_31: CanObjectType=TRANSMIT, CanObjectId=55
        Can_Network_CANNODE_0_Tx_Std_MailBox_32: CanObjectType=TRANSMIT, CanObjectId=56
        Can_Network_CANNODE_0_Tx_Std_MailBox_33: CanObjectType=TRANSMIT, CanObjectId=57
        Can_Network_CANNODE_0_Tx_Std_MailBox_34: CanObjectType=TRANSMIT, CanObjectId=58
        Can_Network_CANNODE_0_Tx_Std_MailBox_35: CanObjectType=TRANSMIT, CanObjectId=59
        Can_Network_CANNODE_0_Tx_Std_MailBox_36: CanObjectType=TRANSMIT, CanObjectId=60
        Can_Network_CANNODE_0_Tx_Std_MailBox_37: CanObjectType=TRANSMIT, CanObjectId=61
        Can_Network_CANNODE_0_Tx_Std_MailBox_38: CanObjectType=TRANSMIT, CanObjectId=62
        Can_Network_CANNODE_0_Tx_Std_MailBox_39: CanObjectType=TRANSMIT, CanObjectId=63
        Can_Network_CANNODE_0_Tx_Std_MailBox_40: CanObjectType=TRANSMIT, CanObjectId=64
        Can_Network_CANNODE_0_Tx_Std_MailBox_41: CanObjectType=TRANSMIT, CanObjectId=65
        Can_Network_CANNODE_0_Tx_Std_MailBox_42: CanObjectType=TRANSMIT, CanObjectId=66
        Can_Network_CANNODE_0_Tx_Std_MailBox_43: CanObjectType=TRANSMIT, CanObjectId=67
        Can_Network_CANNODE_0_Tx_Std_MailBox_44: CanObjectType=TRANSMIT, CanObjectId=68
        Can_Network_CANNODE_0_Tx_Std_MailBox_45: CanObjectType=TRANSMIT, CanObjectId=69
        Can_Network_CANNODE_0_Tx_Std_MailBox_46: CanObjectType=TRANSMIT, CanObjectId=70
        Can_Network_CANNODE_0_Tx_Std_MailBox_47: CanObjectType=TRANSMIT, CanObjectId=71
        Can_Network_CANNODE_0_Tx_Std_MailBox_48: CanObjectType=TRANSMIT, CanObjectId=72
        Can_Network_CANNODE_0_Tx_Std_MailBox_49: CanObjectType=TRANSMIT, CanObjectId=73
        Can_Network_CANNODE_0_Tx_Std_MailBox_50: CanObjectType=TRANSMIT, CanObjectId=74
        Can_Network_CANNODE_0_Tx_Std_MailBox_51: CanObjectType=TRANSMIT, CanObjectId=75
        Can_Network_CANNODE_0_Tx_Std_MailBox_52: CanObjectType=TRANSMIT, CanObjectId=76
        Can_Network_CANNODE_0_Tx_Std_MailBox_53: CanObjectType=TRANSMIT, CanObjectId=77
        Can_Network_CANNODE_0_Tx_Std_MailBox_54: CanObjectType=TRANSMIT, CanObjectId=78
        Can_Network_CANNODE_0_Tx_Std_MailBox_55: CanObjectType=TRANSMIT, CanObjectId=79
        Can_Network_CANNODE_0_Tx_Std_MailBox_56: CanObjectType=TRANSMIT, CanObjectId=80
