AUTOSAR XML (schema 4-2-2)
package /Can
  module config Can: implementation-config-variant=VARIANT-PRE-COMPILE
    CanGeneral:
      CanMainFunctionBusoffPeriod = 0.0010
      CanMainFunctionModePeriod = 0.0010
      CanMultiplexedTransmission = false
      CanVersionInfoApi = false
      CanIndex = 0
      CanPublicIcomSupport = false
      CanTimeoutDuration = 1
      CanDevErrorDetection = false
    CanConfigSet
      Can_Network_CANNODE_0 (CanController):
        CanBusoffProcessing = POLLING
        CanControllerActivation = true
        CanControllerBaseAddress = 0
        CanTxProcessing = POLLING
        CanWakeupFunctionalityAPI = false
        CanWakeupProcessing = POLLING
        CanWakeupSupport = false
        CanControllerId = 0
        CanRxProcessing = POLLING
        CanControllerDefaultBaudrate = Can_Network_CANNODE_0/Can_Network_CANNODE_0
        Can_Network_CANNODE_0 (CanControllerBaudrateConfig):
          CanControllerBaudRateConfigID = 1
          CanControllerBaudRate = 500
          CanControllerPropSeg = 2
          CanControllerSeg1 = 12
          CanControllerSeg2 = 5
          CanControllerSyncJumpWidth = 1
      4 x CanHardwareObject, all with CanHwObjectCount=1, CanHandleType=FULL, CanIdType=STANDARD, CanControllerRef=CanConfigSet/Can_Network_CANNODE_0:
        Can_Network_CANNODE_0_Rx_Std_MailBox_1: CanObjectType=RECEIVE, CanObjectId=0
          CanHwFilter: CanHwFilterCode=1583, CanHwFilterMask=2047
        Can_Network_CANNODE_0_Rx_Std_MailBox_2: CanObjectType=RECEIVE, CanObjectId=1
          CanHwFilter: CanHwFilterCode=1084, CanHwFilterMask=2047
        Can_Network_CANNODE_0_Tx_Std_MailBox_1: CanObjectType=TRANSMIT, CanObjectId=2
        Can_Network_CANNODE_0_Tx_Std_MailBox_2: CanObjectType=TRANSMIT, CanObjectId=3
