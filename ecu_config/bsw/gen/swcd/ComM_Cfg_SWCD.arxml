AUTOSAR XML (schema 4-2-2)
package /AUTOSAR_ComM/SwcImplementations
  swc implementation ComM_Imp: programming-language=C, sw-version=5.4.0, vendor-id=6, behavior=ComM_Int
    code-descriptors:
      code ComM_Imp_Code: artifact-descriptors=autosar-engineering-object={short-label=Code, category=SWSRC}
    resource consumption ResourceConsumption_ResourceConsumption
package /AUTOSAR_ComM/SwComponentTypes
  service sw component type ComM
    behavior ComM_Int
      5 x runnable:
        RequestComMode: symbol=ComM_RequestComMode
        MainFunction_ComMChannel_Can_NCluster_Channel: can-be-invoked-concurrently=true, symbol=ComM_MainFunction_ComMChannel_Can_NCluster_Channel
        GetMaxComMode: can-be-invoked-concurrently=true, symbol=ComM_GetMaxComMode
        GetRequestedComMode: can-be-invoked-concurrently=true, symbol=ComM_GetRequestedComMode
        GetCurrentComMode: can-be-invoked-concurrently=true, symbol=ComM_GetCurrentComMode
package /AUTOSAR_ComM/SwcBswMappings/SwcBswmapping
  swc bsw mapping SwcBswMapping_ComM: bsw-behavior=BswInternalBehavior, swc-bsw-runnable-mapping{bsw-entity=BSWSE_MainFunction_ComMChannel_Can_NCluster_Channel, swc-runnable=MainFunction_ComMChannel_Can_NCluster_Channel}, swc-behavior=ComM_Int
