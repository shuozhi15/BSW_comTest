AUTOSAR XML (schema 4-2-2)
package /AUTOSAR_CanNm/BswModuleDescriptions
  bsw module description CanNm: category=BSW_MODULE, module-id=31, outgoing-callbacks=[CanNm_TxConfirmation, CanNm_RxIndication]  # CAN Network Management
    provided-entrys:
      CanNm_Init
      CanNm_PassiveStartUp
      CanNm_NetworkRequest
      CanNm_NetworkRelease
      CanNm_DisableCommunication
      CanNm_EnableCommunication
      CanNm_SetUserData
      CanNm_GetUserData
      CanNm_Transmit
      CanNm_GetNodeIdentifier
      CanNm_GetLocalNodeIdentifier
      CanNm_RepeatMessageRequest
      CanNm_GetPduData
      CanNm_GetState
      CanNm_GetVersionInfo
      CanNm_RequestBusSynchronization
      CanNm_CheckRemoteSleepIndication
      CanNm_SetSleepReadyBit
      CanNm_MainFunction
      CanNm_ConfirmPnAvailability
package /AUTOSAR_CanNm/BswModuleEntrys
  22 x bsw module entry, all with sw-service-impl-policy=STANDARD:
    CanNm_GetVersionInfo: service-id=0xf1, is-reentrant=true, is-synchronous=true, call-type=REGULAR, execution-context=UNSPECIFIED  # This service returns the version information of this module.
      sw service arg VersionInfo: category=DATA_REFERENCE, direction=OUT, sw-pointer-target-props={target-category=STRUCTURE, implementation-data-type=Std_VersionInfoType}  # Pointer to where to store the version information of this module
    CanNm_Init: service-id=0x00, is-reentrant=false, is-synchronous=true, call-type=REGULAR, execution-context=UNSPECIFIED  # Initialize the CanNm module.
      sw service arg cannmConfigPtr: category=DATA_REFERENCE, direction=IN, sw-pointer-target-props={target-category=STRUCTURE, implementation-data-type=CanNm_ConfigType, sw-impl-policy=CONST}  # Pointer to a selected configuration structure
    CanNm_PassiveStartUp: service-id=0x01, is-reentrant=true, is-synchronous=false, call-type=REGULAR, execution-context=UNSPECIFIED  # Passive startup of the AUTOSAR CAN NM. It triggers the transition from Bus-Sleep Mode or Prepare Bus Sleep Mode to the Network Mode in Repeat Message State.
      return type Returnvalue: implementation-data-type=Std_ReturnType  # E_OK: No error E_NOT_OK: Passive startup of network management has failed
      sw service arg nmChannelHandle: direction=IN, implementation-data-type=NetworkHandleType  # Identification of the NM-channel
    CanNm_NetworkRequest: service-id=0x02, is-reentrant=true, is-synchronous=false, call-type=REGULAR, execution-context=UNSPECIFIED  # Request the network, since ECU needs to communicate on the bus.
      return type Returnvalue: implementation-data-type=Std_ReturnType  # E_OK: No error E_NOT_OK: Requesting of network has failed
      sw service arg nmChannelHandle: direction=IN, implementation-data-type=NetworkHandleType  # Identification of the NM-channel
    CanNm_NetworkRelease: service-id=0x03, is-reentrant=true, is-synchronous=false, call-type=REGULAR, execution-context=UNSPECIFIED  # Release the network, since ECU doesn't have to communicate on the bus.
      return type Returnvalue: implementation-data-type=Std_ReturnType  # E_OK: No error E_NOT_OK: Releasing of network has failed
      sw service arg nmChannelHandle: direction=IN, implementation-data-type=NetworkHandleType  # Identification of the NM-channel
    CanNm_DisableCommunication: service-id=0x0c, is-reentrant=true, is-synchronous=false, call-type=REGULAR, execution-context=UNSPECIFIED  # Disable the NM PDU transmission ability due to a ISO14229 Communication Control (28hex) service
      return type ReturnValue: implementation-data-type=Std_ReturnType  # E_OK: No error E_NOT_OK: Disabling of NM PDU transmission ability has failed
      sw service arg nmChannelHandle: direction=IN, implementation-data-type=NetworkHandleType  # Identification of the NM-channel
    CanNm_EnableCommunication: service-id=0x0d, is-reentrant=true, is-synchronous=false, call-type=REGULAR, execution-context=UNSPECIFIED  # Enable the NM PDU transmission ability due to a ISO14229 Communication Control (28hex) service
      return type Returnvalue: implementation-data-type=Std_ReturnType  # E_OK: No error E_NOT_OK: Enabling of NM PDU transmission ability has failed
      sw service arg nmChannelHandle: direction=IN, implementation-data-type=NetworkHandleType  # Identification of the NM-channel
    CanNm_SetUserData: service-id=0x04, is-reentrant=true, is-synchronous=true, call-type=REGULAR, execution-context=UNSPECIFIED  # Set user data for NM PDUs transmitted next on the bus.
      return type Returnvalue: implementation-data-type=Std_ReturnType  # E_OK: No error E_NOT_OK: Setting of user data has failed
      sw service arg nmChannelHandle: direction=IN, implementation-data-type=NetworkHandleType  # Identification of the NM-channel
      sw service arg nmUserDataPtr: category=DATA_REFERENCE, direction=IN, sw-pointer-target-props={target-category=VALUE, implementation-data-type=uint8, sw-impl-policy=CONST}  # Pointer where the user data for the next transmitted NM PDU shall be copied from
    CanNm_GetUserData: service-id=0x05, is-reentrant=true, is-synchronous=true, call-type=REGULAR, execution-context=UNSPECIFIED  # Get user data out of the most recently received NM PDU.
      return type Returnvalue: implementation-data-type=Std_ReturnType  # E_OK: No error E_NOT_OK: Getting of user data has failed
      sw service arg nmChannelHandle: direction=IN, implementation-data-type=NetworkHandleType  # Identification of the NM-channel
      sw service arg nmUserDataPtr: category=DATA_REFERENCE, direction=OUT, sw-pointer-target-props={target-category=VALUE, implementation-data-type=uint8}  # Pointer where user data out of the most recently received NM PDU shall be copied to
    CanNm_Transmit: service-id=0x14, is-reentrant=true, is-synchronous=true, call-type=REGULAR, execution-context=UNSPECIFIED  # This function is used by the PduR to trigger a spontaneous transmission of an NM PDU with the provided NM User Data.
      return type Returnvalue: implementation-data-type=Std_ReturnType  # E_OK: Transmit request has been accepted E_NOT_OK: Transmit request has not been accepted (CanNm is not in Repeat Message or Normal Operation State)
      sw service arg CanNmTxPduId: direction=IN, implementation-data-type=PduIdType  # Handle of the CanNm user data PDU.
      sw service arg PduInfoPtr: category=DATA_REFERENCE, direction=IN, sw-pointer-target-props={target-category=STRUCTURE, implementation-data-type=PduInfoType, sw-impl-policy=CONST}  # Pointer to a structure containing the pointer to the NM user data buffer and the related DLC.
    CanNm_GetNodeIdentifier: service-id=0x06, is-reentrant=true, is-synchronous=true, call-type=REGULAR, execution-context=UNSPECIFIED  # Get node identifier out of the most recently received NM PDU.
      return type Returnvalue: implementation-data-type=Std_ReturnType  # E_OK: No error E_NOT_OK: Getting of the node identifier out of the most recently received NM PDU has failed
      sw service arg nmChannelHandle: direction=IN, implementation-data-type=NetworkHandleType  # Identification of the NM-channel
      sw service arg nmNodeIdPtr: category=TYPE_REFERENCE, direction=OUT, sw-pointer-target-props={target-category=VALUE, implementation-data-type=uint8}  # Pointer where node identifier out of the most recently received NM PDU shall be copied to
    CanNm_GetLocalNodeIdentifier: service-id=0x07, is-reentrant=true, is-synchronous=true, call-type=REGULAR, execution-context=UNSPECIFIED  # Get node identifier configured for the local node.
      return type Returnvalue: implementation-data-type=Std_ReturnType  # E_OK: No error E_NOT_OK: Getting of the node identifier of the local node has failed
      sw service arg nmChannelHandle: direction=IN, implementation-data-type=NetworkHandleType  # Identification of the NM-channel
      sw service arg nmNodeIdPtr: category=TYPE_REFERENCE, direction=OUT, sw-pointer-target-props={target-category=VALUE, implementation-data-type=uint8}  # Pointer where node identifier of the local node shall be copied to
    CanNm_RepeatMessageRequest: service-id=0x08, is-reentrant=true, is-synchronous=false, call-type=REGULAR, execution-context=UNSPECIFIED  # Set Repeat Message Request Bit for NM PDUs transmitted next on the bus.
      return type Returnvalue: implementation-data-type=Std_ReturnType  # E_OK: No error E_NOT_OK: Setting of Repeat Message Request Bit has failed
      sw service arg nmChannelHandle: direction=IN, implementation-data-type=NetworkHandleType  # Identification of the NM-channel
    CanNm_GetPduData: service-id=0x0a, is-reentrant=true, is-synchronous=true, call-type=REGULAR, execution-context=UNSPECIFIED  # Get the whole PDU data out of the most recently received NM PDU.
      return type Returnvalue: implementation-data-type=Std_ReturnType  # E_OK: No error E_NOT_OK:Getting of NM PDU data has failed
      sw service arg nmChannelHandle: direction=IN, implementation-data-type=NetworkHandleType  # Identification of the NM-channel
      sw service arg nmPduDataPtr: category=DATA_REFERENCE, direction=OUT, sw-pointer-target-props={target-category=VALUE, implementation-data-type=uint8}  # Pointer where NM PDU shall be copied to
    CanNm_GetState: service-id=0x0b, is-reentrant=true, is-synchronous=true, call-type=REGULAR, execution-context=UNSPECIFIED  # Returns the state and the mode of the network management.
      return type Returnvalue: implementation-data-type=Std_ReturnType  # E_OK: No error E_NOT_OK: Getting of NM state has failed
      sw service arg nmChannelHandle: direction=IN, implementation-data-type=NetworkHandleType  # Identification of the NM-channel
      sw service arg nmStatePtr: category=TYPE_REFERENCE, direction=OUT, sw-pointer-target-props={target-category=VALUE, implementation-data-type=uint8}  # Pointer where state of the network management shall be copied to
      sw service arg nmModePtr: category=TYPE_REFERENCE, direction=OUT, sw-pointer-target-props={target-category=VALUE, implementation-data-type=uint8}  # Pointer where the mode of the network management shall be copied to
    CanNm_RequestBusSynchronization: service-id=0xc0, is-reentrant=false, is-synchronous=true, call-type=REGULAR, execution-context=UNSPECIFIED  # Request bus synchronization.
      return type Returnvalue: implementation-data-type=Std_ReturnType  # E_OK: No error E_NOT_OK: Requesting of bus synchronization has failed
      sw service arg nmChannelHandle: direction=IN, implementation-data-type=NetworkHandleType  # Identification of the NM-channel
    CanNm_CheckRemoteSleepIndication: service-id=0xd0, is-reentrant=true, is-synchronous=true, call-type=REGULAR, execution-context=UNSPECIFIED  # Check if remote sleep indication takes place or not.
      return type Returnvalue: implementation-data-type=Std_ReturnType  # E_OK: No error E_NOT_OK: Checking of remote sleep indication bits has failed
      sw service arg nmChannelHandle: direction=IN, implementation-data-type=NetworkHandleType  # Identification of the NM-channel
      sw service arg nmRemoteSleepIndPtr: category=TYPE_REFERENCE, direction=OUT, sw-pointer-target-props={target-category=VALUE, implementation-data-type=boolean}  # Pointer where check result of remote sleep indication shall be copied to
    CanNm_SetSleepReadyBit: service-id=0x17, is-reentrant=true, is-synchronous=true, call-type=REGULAR, execution-context=UNSPECIFIED  # Set the NM Coordinator Sleep Ready bit in the Control Bit Vector
      return type Returnvalue: implementation-data-type=Std_ReturnType  # E_OK: No error E_NOT_OK: Writing of remote sleep indication bit has failed
      sw service arg nmChannelHandle: direction=IN, implementation-data-type=NetworkHandleType  # Identification of the NM-channel
      sw service arg nmSleepReadyBit: direction=IN, implementation-data-type=boolean  # Value written to ReadySleep Bit in CBV
    CanNm_TxConfirmation: service-id=0x40, is-reentrant=true, is-synchronous=true, call-type=CALLBACK, execution-context=UNSPECIFIED  # The lower layer communication interface module confirms the transmission of an I-PDU.
      sw service arg TxPduId: direction=IN, implementation-data-type=PduIdType  # ID of the I-PDU that has been transmitted.
    CanNm_RxIndication: service-id=0x42, is-reentrant=true, is-synchronous=true, call-type=CALLBACK, execution-context=UNSPECIFIED  # Indication of a received I-PDU from a lower layer communication interface module.
      sw service arg RxPduId: direction=IN, implementation-data-type=PduIdType  # ID of the received I-PDU.
      sw service arg PduInfoPtr: category=DATA_REFERENCE, direction=IN, sw-pointer-target-props={target-category=STRUCTURE, implementation-data-type=PduInfoType, sw-impl-policy=CONST}  # Contains the length (SduLength) of the received I-PDU and a pointer to a buffer (SduDataPtr) containing the I-PDU.
    CanNm_ConfirmPnAvailability: service-id=0x16, is-reentrant=true, is-synchronous=true, call-type=REGULAR, execution-context=UNSPECIFIED  # Enables the PN filter functionality on the indicated NM channel. Availability: The API is only available if CanNmPnEnabled is TRUE.
      sw service arg nmChannelHandle: direction=IN, implementation-data-type=NetworkHandleType  # Identification of the NM-channel
    CanNm_MainFunction: service-id=0x13, is-reentrant=false, is-synchronous=true, call-type=SCHEDULED, execution-context=TASK  # Main function of the CanNm which processes the algorithm describes in that document.
package /AUTOSAR_CanNm/ImplementationDataTypes
  impl type CanNm_ConfigType: category=STRUCTURE, type-emitter=HEADER_FILE  # This type shall contain at least all parameters that are post-build able
    element CanNm_ConfigData: category=DATA_REFERENCE, sw-pointer-target-props={target-category=VALUE, base-type=void, sw-impl-policy=CONST}
    element versionInfo: category=DATA_REFERENCE, sw-pointer-target-props={target-category=VALUE, base-type=uint16, sw-impl-policy=CONST}
