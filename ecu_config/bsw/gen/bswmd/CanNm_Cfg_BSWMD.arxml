AUTOSAR XML (schema 4-2-2)
package /AUTOSAR_CanNm/BswImplementations
  bsw implementation CanNm: programming-language=C, sw-version=3.4.0, ar-release-version=4.2.2, behavior=BswInternalBehavior, vendor-specific-module-def=CanNm
    code-descriptors:
      code CodeDescriptor: artifact-descriptors=autosar-engineering-object={short-label=ArEngObj, category=SWSRC}
package /AUTOSAR_CanNm/BswModuleDescriptions
  bsw module description CanNm: category=BSW_MODULE, module-id=31  # CanNetworkManagement
    bsw internal behavior BswInternalBehavior
      bsw called entity BSWCE_Init: implemented-entry=CanNm_Init
      bsw schedulable entity BSWSE_MainFunction: implemented-entry=CanNm_MainFunction
      bsw timing event EV_BSWSE_MainFunction: starts-on-event=BSWSE_MainFunction, period=0.01
package /AUTOSAR_CanNm/Units
  unit NoUnit: display-name=noUnit, factor-si-to-unit=1.0, offset-si-to-unit=0.0, physical-dimension=NoUnit  # No Unit
package /AUTOSAR_CanNm/PhysicalDimensions
  physical dimension NoUnit: length-exp=0
