AUTOSAR XML (schema 4-2-2)
package /AUTOSAR_BswM/BswModuleEntrys
  5 x bsw module entry, all with execution-context=TASK, sw-service-impl-policy=STANDARD:
    BswM_Deinit: service-id=0x04, is-reentrant=false, is-synchronous=true, call-type=REGULAR  # API to Deinitialize the BSW Mode Manager | Function call to deinitialize the BSW Mode Manager | After execution of this routine no mode processing shall be performed by BswM even if any mode requests are made or the BswM main function is called.
    BswM_Init: service-id=0x00, is-reentrant=false, is-synchronous=true, call-type=REGULAR  # API to Initialize the BSW Mode Manager | Function call to Initialize the BSW Mode Manager | This API will initialise the BSW Mode Manager module by intializing the global variables with the data provided by the configuration pointer.
      sw service arg ConfigPtr: category=DATA_REFERENCE, direction=INOUT, sw-impl-policy=CONST, sw-pointer-target-props={target-category=VALUE, implementation-data-type=BswM_ConfigType}  # Pointer to post-build configuration data
    BswM_GetVersionInfo: service-id=0x01, is-reentrant=true, is-synchronous=true, call-type=REGULAR  # API to Return the version information of BswM module | Returns the version information of BswM module | This API will return the version information of BswM module
      sw service arg VersionInfo: category=DATA_REFERENCE, direction=INOUT, sw-pointer-target-props={target-category=VALUE, implementation-data-type=Std_VersionInfoType}  # Pointer to where to store the version information of the module
    BswM_RequestMode: service-id=0x02, is-reentrant=true, is-synchronous=true, call-type=REGULAR  # API to sevice Generic Request. | Generic function call to request modes. This function shall only be used by other BSW modules that does not have a specific mode request interface. | The corresponding configuration container for this API is BswMGenericRequest, i.e. this mode request originates from a requester that is not among the list of standardized mode requesters.
      sw service arg Requesting_user: direction=IN, implementation-data-type=BswM_UserType  # The user that requests the mode.
      sw service arg Requested_mode: direction=IN, implementation-data-type=BswM_ModeType  # The requested mode.
    BswM_MainFunction: is-synchronous=false, call-type=SCHEDULED
package /AUTOSAR_BswM/ImplementationDataTypes
  impl type BswM_ConfigType: category=STRUCTURE, type-emitter=HEADER_FILE
    element dataVersionInfo_st: implementation-data-type=Std_VersionInfoType
  impl type BswM_ModeType: implementation-data-type=uint16
  impl type BswM_UserType: implementation-data-type=uint16
package /AUTOSAR_BswM/BswModuleDescriptions
  bsw module description BswM: category=BSW_MODULE, module-id=42, provided-entrys=[BswM_MainFunction, BswM_Init, BswM_Deinit, BswM_GetVersionInfo, BswM_RequestMode]
    bsw internal behavior IB_BswM
      bsw schedulable entity SE_BswM_MainFunction: implemented-entry=BswM_MainFunction
      bsw timing event TE_BswM_MainFunction: starts-on-event=SE_BswM_MainFunction, period=0.01
package /AUTOSAR_BswM/BswImplementations
  bsw implementation BSWIMPL_BswM: programming-language=C, sw-version=4.0.0, ar-release-version=4.2.2, behavior=IB_BswM
    code-descriptors:
      code CodeDescriptor: artifact-descriptors=autosar-engineering-object={short-label=ArEngObj, category=SWSRC}
