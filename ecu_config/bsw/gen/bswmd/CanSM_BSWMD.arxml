AUTOSAR XML (schema 4-2-2)
package /AUTOSAR_CanSM/BswModuleDescriptions
  bsw module description CanSM: category=BSW_MODULE, module-id=140
    provided-entrys:
      CanSM_Init
      CanSM_RequestComMode
      CanSM_GetCurrentComMode
      CanSM_MainFunction
      CanSM_GetVersionInfo
      CanSM_SetBaudrate
    outgoing-callbacks:
      CanSM_ControllerBusOff
      CanSM_ControllerModeIndication
      CanSM_TransceiverModeIndication
      CanSM_TxTimeoutException
      CanSM_ClearTrcvWufFlagIndication
      CanSM_CheckTransceiverWakeFlagIndication
      CanSM_ConfirmPnAvailability
package /AUTOSAR_CanSM/BswModuleEntrys
  13 x bsw module entry, all with sw-service-impl-policy=STANDARD:
    CanSM_Init: service-id=0x00, is-reentrant=false, is-synchronous=true, call-type=REGULAR, execution-context=UNSPECIFIED  # CanSM service to initialize the CanSM module | Initializes the CanSM module
      sw service arg ConfigPtr: category=DATA_REFERENCE, direction=IN, sw-pointer-target-props={target-category=STRUCTURE, implementation-data-type=CanSM_ConfigType, sw-impl-policy=CONST}  # Pointer to init structure for the post build parameters of the CanSM
    CanSM_RequestComMode: service-id=0x02, is-reentrant=true, is-synchronous=false, call-type=REGULAR, execution-context=UNSPECIFIED  # This service shall change the communication mode of a CAN network to the requested one.
      return type ReturnValue: implementation-data-type=Std_ReturnType  # Returns E_OK if the service is accepted and E_NOT_OK if the service is denied
      sw service arg network: direction=IN, implementation-data-type=NetworkHandleType  # Handle of destined communication network for request
      sw service arg ComM_Mode: direction=IN, implementation-data-type=ComM_ModeType  # Requested communication mode
    CanSM_GetCurrentComMode: service-id=0x03, is-reentrant=true, is-synchronous=true, call-type=REGULAR, execution-context=UNSPECIFIED  # This service shall put out the current communication mode of a CAN network.
      return type ReturnValue: implementation-data-type=Std_ReturnType  # Returns E_OK if service is accepted else returns E_NOT_OK if service is denied
      sw service arg network: direction=IN, implementation-data-type=NetworkHandleType  # Network handle, whose current communication mode shall be put out
      sw service arg ComM_ModePtr: category=DATA_REFERENCE, direction=OUT, sw-pointer-target-props={target-category=VALUE, implementation-data-type=ComM_ModeType, sw-impl-policy=CONST}  # Pointer, where to put out the current communication mode
    CanSM_GetVersionInfo: service-id=0x01, is-reentrant=true, is-synchronous=true, call-type=REGULAR, execution-context=UNSPECIFIED  # This service puts out the version information of this module | This service puts out the version information of this module (module ID, vendor ID, vendor specific version numbers related to BSW00407)
      sw service arg VersionInfo: category=DATA_REFERENCE, direction=OUT, sw-pointer-target-props={target-category=STRUCTURE, implementation-data-type=Std_VersionInfoType}  # Pointer to where to store the version information of this module.
    CanSM_SetBaudrate: service-id=0x0d, is-reentrant=true, is-synchronous=true, call-type=REGULAR, execution-context=UNSPECIFIED  # This servive changes the baud rate for the configured CAN controllers of a certain CAN network. | This service shall start an asynchronous process to change the baud rate for the configured CAN controllers of a certain CAN network. Depending on necessary baud rate modifications the controllers might have to reset.
      return type ReturnValue: implementation-data-type=Std_ReturnType  # Returns E_OK if service request is accepted, setting of (new) baud rate started else returns E_NOT_OK if service request is not accepted
      sw service arg Network: direction=IN, implementation-data-type=NetworkHandleType  # Handle of the addressed CAN network for the baud rate change
      sw service arg BaudRateConfigID: category=DATA_REFERENCE, direction=IN, implementation-data-type=uint16  # references a baud rate configuration by ID (see CanControllerBaudRateConfigID)
    CanSM_ControllerBusOff: service-id=0x04, is-reentrant=true, is-synchronous=true, call-type=CALLBACK, execution-context=UNSPECIFIED  # This callback function notifies the CanSM about a bus-off event on a certain CAN controller. | This callback function notifies the CanSM about a bus-off event on a certain CAN controller, which needs to be considered with the specified bus-off recovery handling for the impacted CAN network.
      sw service arg ControllerId: direction=IN, implementation-data-type=uint8  # CAN controller, which detected a bus-off event
    CanSM_ControllerModeIndication: service-id=0x07, is-reentrant=true, is-synchronous=true, call-type=CALLBACK, execution-context=UNSPECIFIED  # This callback shall notify the CanSM module about a CAN controller mode change.
      sw service arg ControllerId: direction=IN, implementation-data-type=uint8  # CAN controller, whose mode has changed
      sw service arg ControllerMode: direction=IN, implementation-data-type=CanIf_ControllerModeType  # Notified CAN controller mode
    CanSM_TransceiverModeIndication: service-id=0x09, is-reentrant=true, is-synchronous=true, call-type=CALLBACK, execution-context=UNSPECIFIED  # This callback shall notify the CanSM module about a CAN transceiver mode change.
      sw service arg TransceiverId: direction=IN, implementation-data-type=uint8  # CAN transceiver, whose mode has changed
      sw service arg TransceiverMode: direction=IN, implementation-data-type=uint8  # Notified CAN transceiver mode
    CanSM_TxTimeoutException: service-id=0x0b, is-reentrant=true, is-synchronous=true, call-type=CALLBACK, execution-context=UNSPECIFIED  # This function shall notify the CanSM module, that the CanNm has detected for the affected partial CAN network a tx timeout exception | This function shall notify the CanSM module, that the CanNm has detected for the affected partial CAN network a tx timeout exception, which shall be recovered within the respective network state machine of the CanSM module.
      sw service arg Channel: direction=IN, implementation-data-type=NetworkHandleType  # Affected CAN network
    CanSM_ClearTrcvWufFlagIndication: service-id=0x08, is-reentrant=true, is-synchronous=true, call-type=CALLBACK, execution-context=UNSPECIFIED  # This callback function shall indicate the CanIf_ClearTrcvWufFlag API process end for the notified CAN Transceiver. | The lower layer communication interface module confirms the transmission of an I-PDU.
      sw service arg Transceiver: direction=IN, implementation-data-type=uint8  # Requested Transceiver
    CanSM_CheckTransceiverWakeFlagIndication: service-id=0x0a, is-reentrant=true, is-synchronous=true, call-type=CALLBACK, execution-context=UNSPECIFIED  # This callback function indicates the CheckTransceiverWakeFlag API process end for the notified CAN Transceiver.
      sw service arg Transceiver: direction=IN, implementation-data-type=uint8  # Requested Transceiver
    CanSM_ConfirmPnAvailability: service-id=0x06, is-reentrant=true, is-synchronous=true, call-type=CALLBACK, execution-context=UNSPECIFIED  # This callback function indicates that the transceiver is running in PN communication mode. | The lower layer communication interface module confirms the transmission of an I-PDU.
      sw service arg TransceiverId: direction=IN, implementation-data-type=uint8  # CAN transceiver, which was checked for PN availability
    CanSM_MainFunction: service-id=0x05, is-reentrant=false, is-synchronous=true, call-type=SCHEDULED, execution-context=TASK  # Scheduled function of the CanSM
package /AUTOSAR_CanSM/ImplementationDataTypes
  impl type CanSM_ConfigType: category=STRUCTURE, type-emitter=HEADER_FILE  # This type defines a data structure for the post build parameters of the CanSM. At initialization the CanSM gets a pointer to a structure of this type to get access to its configuration data, which is necessary for initialization. | This is the base type for the configuration for Post Build of CanSM module.
    5 x element, all with category=DATA_REFERENCE:
      CanSM_NetworktoCtrlConf_pcu8: sw-pointer-target-props={target-category=VALUE, base-type=uint8, sw-impl-policy=CONST}
      CanSMModeRequestRepetitionTime_u16: sw-pointer-target-props={target-category=VALUE, base-type=uint16, sw-impl-policy=CONST}
      CanSMModeRequestRepetitionMax_u8: sw-pointer-target-props={target-category=VALUE, base-type=uint8, sw-impl-policy=CONST}
      CanSM_SizeOfCanSMNetworks_u8: sw-pointer-target-props={target-category=VALUE, base-type=uint8}
      CanSM_ActiveConfigset_u8: sw-pointer-target-props={target-category=VALUE, base-type=uint8}
  impl type CanSM_StateType: compu {0=CANSM_INITED (CanSM module is initialized.), 1=CANSM_UNINITED (CanSM module is not initialized yet.)}, implementation-data-type=uint8, type-emitter=HEADER_FILE  # Enumeration type for internal states of the CanSM module | Defines the values of the internal states of the CanSM module
  impl type CanSM_BswMCurrentStateType:  # Enumeration type forCan specific communication modes / states notified to the BswM module | Can specific communication modes / states notified to the BswM module
    compu {0=CANSM_BSWM_NO_COMMUNICATION (Can specific communication modes / states notified to the BswM module is CANSM_BSWM_NO_COMMUNICATION.), 1=CANSM_BSWM_SILENT_COMMUNICATION (Can specific communication modes / states notified to the BswM module is CANSM_BSWM_SILENT_COMMUNICATION.), 2=CANSM_BSWM_FULL_COMMUNICATION (Can specific communication modes / states notified to the BswM module is CANSM_BSWM_FULL_COMMUNICATION.), 3=CANSM_BSWM_BUS_OFF (Can specific communication modes / states notified to the BswM module is CANSM_BSWM_BUS_OFF.), 4=CANSM_BSWM_CHANGE_BAUDRATE (CANSM_BSWM_CHANGE_BAUDRATE.)}
    implementation-data-type=uint8
    type-emitter=HEADER_FILE
