AUTOSAR XML (schema 4-2-2)
package /AUTOSAR_Com/BswModuleEntrys
  11 x bsw module entry, all with sw-service-impl-policy=STANDARD:
    Com_MainFunctionRx: is-reentrant=false, is-synchronous=true, call-type=SCHEDULED, execution-context=TASK
    Com_MainFunctionTx: is-reentrant=true, is-synchronous=true, call-type=SCHEDULED, execution-context=TASK
    Com_MainFunctionRouteSignals: is-reentrant=true, is-synchronous=true, call-type=SCHEDULED, execution-context=TASK
    Com_TxConfirmation: is-reentrant=false, is-synchronous=false, call-type=CALLBACK, execution-context=UNSPECIFIED
    Com_RxIndication: is-reentrant=false, is-synchronous=false, call-type=CALLBACK, execution-context=UNSPECIFIED
    Com_TriggerTransmit: is-reentrant=false, is-synchronous=false, call-type=CALLBACK, execution-context=UNSPECIFIED
    Com_TpTxConfirmation: is-reentrant=false, is-synchronous=false, call-type=CALLBACK, execution-context=UNSPECIFIED
    Com_TpRxIndication: is-reentrant=false, is-synchronous=false, call-type=CALLBACK, execution-context=UNSPECIFIED
    Com_StartOfReception: is-reentrant=false, is-synchronous=false, call-type=CALLBACK, execution-context=UNSPECIFIED
    Com_CopyRxData: is-reentrant=false, is-synchronous=false, call-type=CALLBACK, execution-context=UNSPECIFIED
    Com_CopyTxData: is-reentrant=false, is-synchronous=false, call-type=CALLBACK, execution-context=UNSPECIFIED
