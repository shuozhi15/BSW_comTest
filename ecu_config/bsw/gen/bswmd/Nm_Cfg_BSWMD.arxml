AUTOSAR XML (schema 4-2-2)
package /AUTOSAR_Nm/BswImplementations
  bsw implementation Nm: programming-language=C, sw-version=8.0.0, ar-release-version=4.2.2, behavior=BswInternalBehavior, vendor-specific-module-def=Nm
    code-descriptors:
      code CodeDescriptor: artifact-descriptors=autosar-engineering-object={short-label=ArEngObj, category=SWSRC}
package /AUTOSAR_Nm/BswModuleDescriptions
  bsw module description Nm: category=BSW_MODULE, module-id=29  # NetworkManagementInterface
    bsw internal behavior BswInternalBehavior
package /AUTOSAR_Nm/Units
  unit NoUnit: display-name=noUnit, factor-si-to-unit=1.0, offset-si-to-unit=0.0, physical-dimension=NoUnit  # No Unit
package /AUTOSAR_Nm/PhysicalDimensions
  physical dimension NoUnit: length-exp=0
