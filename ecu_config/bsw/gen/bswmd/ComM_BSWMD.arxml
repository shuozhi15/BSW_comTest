AUTOSAR XML (schema 4-0-3)
package /AUTOSAR_ComM/BswModuleEntrys
  bsw module entry ComM_MainFunction_ComMChannel_Can_NCluster_Channel: is-reentrant=false, is-synchronous=true, call-type=SCHEDULED, execution-context=TASK, sw-service-impl-policy=STANDARD
