AUTOSAR XML (schema 4-0-3)
package /AUTOSAR_EcuM/BswModuleDescriptions
  bsw module description EcuM: outgoing-callbacks=[EcuM_SetWakeupEvent, EcuM_CheckWakeup, EcuM_ValidateWakeupEvent, EcuM_EndCheckWakeup]
    provided-entrys:
      EcuM_Init
      EcuM_StartupTwo
      EcuM_GoDown
      EcuM_Shutdown
      EcuM_GoHalt
      EcuM_SelectShutdownCause
      EcuM_GetShutdownCause
      EcuM_SelectShutdownTarget
      EcuM_GetShutdownTarget
      EcuM_GetLastShutdownTarget
      EcuM_SelectBootTarget
      EcuM_GetBootTarget
      EcuM_ClearWakeupEvent
      EcuM_GetExpiredWakeupEvents
      EcuM_GetPendingWakeupEvents
      EcuM_GetValidatedWakeupEvents
      EcuM_GetVersionInfo
      EcuM_MainFunction
      EcuM_Rb_GetEcuType
      EcuM_RbMoGetActivePostBuildVariantIndex
      EcuM_RbMoInitCheckInverse
      EcuM_RbMoInitCheck
      EcuM_RequestRUN
      EcuM_ReleaseRUN
      EcuM_RequestPOST_RUN
      EcuM_ReleasePOST_RUN
      EcuM_SetState
      EcuM_KillAllRUNRequests
      EcuM_KillAllPostRUNRequests
      EcuM_Rb_KillAllRequests
      EcuM_Rb_CurrentState
      EcuM_Rb_GetLastShutdownInfo
    6 x bsw module dependency:
      BswM: target-module-id=42
      ComM: target-module-id=12
      Det: target-module-id=15
      Mcu: target-module-id=101
      NvM: target-module-id=20
      Os: target-module-id=1
package /AUTOSAR_EcuM/BswModuleEntrys
  36 x bsw module entry, all with sw-service-impl-policy=STANDARD:
    EcuM_ClearWakeupEvent: service-id=0x16, is-reentrant=false, is-synchronous=true, call-type=REGULAR, execution-context=UNSPECIFIED  # Service to clear wakeup events | EcuM_ClearWakeupEvent clears all events passed as a bit set in the sources in parameterfrom the internal pending wakeup events variable, the internal validated events variable and the internal expired events variable. | If the passed list contains any unconfigured source then DET will be raised. In the current implementation this service can be used only after EcuM module initialisation. Its recommended to call this service before going for any shutdown activties, so new interrupts can be detected. So integrator should invoke this interface from BswM action list before calling EcuM_GoDown
      sw service arg sources: direction=IN, implementation-data-type=EcuM_WakeupSourceType  # Wakeup sources that to be cleared.
    EcuM_GetPendingWakeupEvents: service-id=0x0d, is-reentrant=false, is-synchronous=true, call-type=REGULAR, execution-context=UNSPECIFIED  # Service to get pending wakeup events. | This function will return wakeup events which have been set to pending but not yet validated as bits set in a EcuM_WakeupSourceType bit mask. | In the current implementation this service can be used only after EcuM module initialisation.
      return type ReturnValue: direction=OUT, implementation-data-type=EcuM_WakeupSourceType  # Wakeup events in pending state
    EcuM_GetValidatedWakeupEvents: service-id=0x15, is-reentrant=false, is-synchronous=true, call-type=REGULAR, execution-context=UNSPECIFIED  # Service to return validated wakeup events. | This function will return wakeup events which have been set to validated in the internal validated events variable as bits set in a EcuMWakeupSourceType bitmask. | In the current implementation this service can be used only after EcuM module initialisation.
      return type ReturnValue: direction=OUT, implementation-data-type=EcuM_WakeupSourceType  # All wakeup events in validated state.
    EcuM_GetExpiredWakeupEvents: service-id=0x19, is-reentrant=false, is-synchronous=true, call-type=REGULAR, execution-context=UNSPECIFIED  # Service to get expired wakeup events. | This function will return wakeup events which have been set to expired in the internal expired events variable as bits set in a EcuM_WakeupSourceType bitmask. That is it will return all the events for which validation timer has expired.In the current implementation this service can be used only after EcuM module initialisation. | If there are multiple wakeup sources in PENDING state, then the validation time period will be the greatest among these sources. Only one timer is implemented for EcuM. So even if a source is about to expire and a new source is detected with more timeout, then the first source also will get more time for validation. The expired information will be updated for all wakeup sources at the same time (for the wakeup source which need to be validated).
      return type ReturnValue: direction=OUT, implementation-data-type=EcuM_WakeupSourceType  # All wakeup events in expired state.
    EcuM_SetWakeupEvent: service-id=0x0c, is-reentrant=false, is-synchronous=true, call-type=CALLBACK, execution-context=UNSPECIFIED  # Service to set the wakeup event. | This function will set wakeup events to pending or validated state depending on configured Wakeup validation timeout. If validation timeout is not configured it will set the passed wakeup source to VALIDATED else to PENDING. | This function will start validation timer for the passed wakeup sources which need validation. If the timer expires, the wakeup event will be moved to expired state. If there is any unknown or un-configured sources in the passed list, then DET will be raised.
      sw service arg sources: direction=IN, implementation-data-type=EcuM_WakeupSourceType  # Sources to be set
    EcuM_CheckWakeup: service-id=0x00, is-reentrant=false, is-synchronous=true, call-type=CALLBACK, execution-context=UNSPECIFIED  # Service to check the wakeup event. | This callout is called by the EcuM to poll a wakeup source. It shall also be called by the ISR of a wakeup source to set up the PLL and check other wakeup sources that may be connected to the same interrupt.
      sw service arg wakeupSource: direction=IN, implementation-data-type=EcuM_WakeupSourceType  # Sources to be checked
    EcuM_EndCheckWakeup: service-id=0x00, is-reentrant=false, is-synchronous=true, call-type=CALLBACK, execution-context=UNSPECIFIED  # Service to cancel CheckWakeupTimer for a WakeupSource. | This API is called by any SW Module whose wakeup source is checked asynchronously (e.g. asynchronous Can Trcv Driver) and the Check of the Wakeup returns a negative Result (no Wakeup by this Source).The API cancels the CheckWakeupTimer for the WakeupSource. If the correponding CheckWakeupTimer is canceled the check of this wakeup source is finished.
      sw service arg wakeupSource: direction=IN, implementation-data-type=EcuM_WakeupSourceType  # Sources to be checked
    EcuM_ValidateWakeupEvent: service-id=0x14, is-reentrant=true, is-synchronous=true, call-type=CALLBACK, execution-context=UNSPECIFIED  # Service to validate wakeup event. | This function is used to indicate to the ECU Manager module that the wakeup event indicated in the sources parameter have been validated. | If there is any unknown or un-configured sources in the passed list, then DET will be raised. For the current implementation this service should be called only after EcuM initialisation else DET will be raised.
      sw service arg sources: direction=IN, implementation-data-type=EcuM_WakeupSourceType  # Events that have been validated.
    EcuM_GetBootTarget: service-id=0x13, is-reentrant=true, is-synchronous=true, call-type=REGULAR, execution-context=UNSPECIFIED  # Service to return boot target | EcuM_GetBootTarget returns the current boot target. EcuM_GetBootTarget is part of the ECU Manager Module port interface. | If there is no boot target selected via EcuM_SelectBootTarget service then ECUM_BOOT_TARGET_OEM_BOOTLOADER will be returned.
      return type ReturnValue: direction=OUT, implementation-data-type=Std_ReturnType  # E_OK: For the positive conditions.E_NOT_OK: if the passed pointer is not valid.
      sw service arg target: category=DATA_REFERENCE, direction=OUT, sw-pointer-target-props={target-category=VALUE, implementation-data-type=EcuM_BootTargetType}  # Target points to a variable of type EcuM_BootTargetType which holds the currently selected boot target.
    EcuM_SelectBootTarget: service-id=0x12, is-reentrant=true, is-synchronous=true, call-type=REGULAR, execution-context=UNSPECIFIED  # Service to select the boot target. | EcuM_SelectBootTarget selects the boot target and it is a part of Ecu State Manager Module Port interface. | The data selected is stored in power on cleared section.This service may depend on the boot loader used. This service is only intended for use by SW-C's related to diagnostics (boot management).
      return type ReturnValue: direction=OUT, implementation-data-type=Std_ReturnType  # E_OK: if the request was accepted by EcuM.E_NOT_OK: if the passed value is not correct. A detailed error report will be reported to Det.
      sw service arg target: direction=IN, implementation-data-type=EcuM_BootTargetType  # The Boot Target to be selected. Valid Boot targets are ECUM_BOOT_TARGET_APP, ECUM_BOOT_TARGET_OEM_BOOTLOADER and ECUM_BOOT_TARGET_SYS_BOOTLOADER.
    EcuM_GetShutdownCause: service-id=0x1c, is-reentrant=true, is-synchronous=true, call-type=REGULAR, execution-context=UNSPECIFIED  # Service to get the shutdown cause. | EcuM_GetShutdownCause returns ShutdownCause as set by EcuM_SelectShutdownCause and it is a part of Ecu State Manager Port interface.
      return type ReturnValue: direction=OUT, implementation-data-type=Std_ReturnType  # E_OK is returned if the service has succeeded.E_NOT_OK is returned if the service has failed, e.g. due to NULL pointer being passed
      sw service arg Cause: category=DATA_REFERENCE, direction=OUT, sw-pointer-target-props={target-category=VALUE, implementation-data-type=EcuM_ShutdownCauseType}  # The parameter points to the variable which contains the selected cause of the next shutdown.
    EcuM_GetShutdownTarget: service-id=0x09, is-reentrant=true, is-synchronous=true, call-type=REGULAR, execution-context=UNSPECIFIED  # Service to return the shutdown target. | EcuM_GetShutdownTarget returns the currently selected shutdown target as set by EcuM_SelectShutdownTarget and it is a part of EcuM Port interface.
      return type ReturnValue: direction=OUT, implementation-data-type=Std_ReturnType  # E_OK is returned if the service has succeeded.E_NOT_OK is returned if the service has failed, e.g. due to NULL pointer being passed
      sw service arg shutdownTarget: category=DATA_REFERENCE, direction=OUT, sw-pointer-target-props={target-category=VALUE, implementation-data-type=EcuM_ShutdownTargetType}  # This parameter points to a variable of type EcuM_StateType. One of these values is returned based on the selected shutdown target: ECUM_STATE_RESET, ECUM_STATE_OFF, ECUM_STATE_SLEEP.
      sw service arg shutdownMode: category=DATA_REFERENCE, direction=OUT, sw-pointer-target-props={target-category=VALUE, implementation-data-type=EcuM_ShutdownModeType}  # This parameter points to a variable of type uint8. When the shutdown Target is ECUM_STATE_RESET, this Mode parameter tells which of the configured reset mode was actually chosen. When the shutdown Target is ECUM_STATE_SLEEP, this Mode parameter tells which of the configured sleep modes was actually chosen.Else this Mode parameter would NOT be updated
    EcuM_SelectShutdownCause: service-id=0x1b, is-reentrant=true, is-synchronous=true, call-type=REGULAR, execution-context=UNSPECIFIED  # Service to select the Cause for a Shutdown. | EcuM_SelectShutdownCause elects the cause for a shutdown. It is part of the ECU Manager Module port interface. | Before going to shutdown EcuM will also keep the shutdown details in NvM , so that the shutdown can be retrived in next cycles. So modifiying the shutdown related information after NvM writing is inhibited. So EcuM_SlecetShutdownCause after NvM_WriteAll will triggere DET error conditions and also return E_NOT_OK.
      return type ReturnValue: direction=OUT, implementation-data-type=Std_ReturnType  # E_OK is returned if the new shutdown Cause was set. E_NOT_OK is returned if the new Shutdown Cause was not set , example - due to EcuM is not initialized or wrong parameter. Detailed error details are forwarded to Det module for further tracking.
      sw service arg shutdownCause: direction=IN, implementation-data-type=EcuM_ShutdownCauseType  # The shutdown cause to be selected for next shutdown. The possible values for this depends on the configuration of EcuMShutdownCause.The shutdown cause ECUM_CAUSE_UNKNOWN is the default shutdown cause.
    EcuM_SelectShutdownTarget: service-id=0x06, is-reentrant=true, is-synchronous=true, call-type=REGULAR, execution-context=UNSPECIFIED  # Service to select the shutdown target. | EcuM_SelectShutdownTarget selects the passed shutdown target for next ECU shutdown. The default target selected by EcuM configuration will be over-written by this interface. It is a part of Ecu Manager Module Port interface | Before going to shutdown EcuM will also keep the shutdown details in NvM , so that the shutdown can be retrived in next cycles. So modifiying the shutdown related information after NvM writing is inhibited. So EcuM_SelectShutdownTarget after NvM_WriteAll will trigger DET error conditions and also return E_NOT_OK.
      return type ReturnValue: direction=OUT, implementation-data-type=Std_ReturnType  # E_OK is returned if the new shutdown target was set.E_NOT_OK is returned if the new Shutdown target was not set due to uninitialized EcuM or invalid parameter.
      sw service arg shutdownTarget: direction=IN, implementation-data-type=EcuM_ShutdownTargetType  # The target to be selected for shutdown. It can be ECUM_STATE_RESET, ECUM_STATE_OFF or ECUM_STATE_SLEEP.
      sw service arg shutdownMode: direction=IN, implementation-data-type=EcuM_ShutdownModeType  # Mode for selected target. This parameter is applicable only for RESET and SLEEP. Valid Reset modes are the one configured in EcuMResetMode container. Valid sleep modes are those configured in EcuMSleepModes container
    EcuM_GetLastShutdownTarget: service-id=0x08, is-reentrant=true, is-synchronous=true, call-type=REGULAR, execution-context=UNSPECIFIED  # Service returns the shutdown target of the previous shutdown cycle. | EcuM_GetLastShutdownTarget returns the ECU state from which the last wakeup or power up ocurred , like OFF, SLEEP or RESET. EcuM_GetLastShutdownTarget is part of the ECU Manager Module port interface. | This service will return the shutdown details only if the EcuM is initialised and NvM reading is completed. If the parameter EcuMRbShutdownInfoStackSize under EcuMGeneral container is not configured or configured as zero the service will be disabled.
      return type ReturnValue: direction=OUT, implementation-data-type=Std_ReturnType  # E_OK is returned if the service succeeded.E_NOT_OK is returned if the service failed e.g. due to NULL POINTER being passed. Detailed error information will be logged to Det module.
      sw service arg shutdownTarget: category=DATA_REFERENCE, direction=OUT, sw-pointer-target-props={target-category=VALUE, implementation-data-type=EcuM_ShutdownTargetType}  # One of these values will be returned - ECUM_STATE_RESET or ECUM_STATE_OFF.
      sw service arg shutdownMode: category=DATA_REFERENCE, direction=OUT, sw-pointer-target-props={target-category=VALUE, implementation-data-type=EcuM_ShutdownModeType}  # The parameter is valid if the last shutdown target was ECUM_STATE_RESET or ECUM_STATE_SLEEP. | Valid Reset modes are the one configured in EcuMResetMode container.
    EcuM_GetVersionInfo: service-id=0x00, is-reentrant=true, is-synchronous=true, call-type=REGULAR, execution-context=UNSPECIFIED  # Service to get the version information of EcuM. | Returns the version information of this module that includes vendor details, module id and software version details. This service is supported only when EcuMVersionInfoApi is Enabled in EcuMGeneral configuration.
      sw service arg versioninfo: category=DATA_REFERENCE, direction=OUT, sw-pointer-target-props={target-category=VALUE, implementation-data-type=Std_VersionInfoType}  # Pointer to Std_VersionInfoType
    EcuM_GoDown: service-id=0x1f, is-reentrant=true, is-synchronous=false, call-type=REGULAR, execution-context=UNSPECIFIED  # Service to initiate power off or reset. | Instructs the ECU State Manager module to perform a power off or a Reset depending on the selected shutdown target | EcuM_GoDown can be called from State Managers or BswM once ECU is ready for shutdown. Before calling this function, all shutdown preperation activities like NvM writing should be completed. EcuM_ClearWakeupEvent function should be called for all configured wakeup sources before entering into shutdown. Only selected users can initiate this service.Refer the Parameter: EcuMGoDownAllowedUsers" For multi-core projects after the positive return from EcuM_GoDown, next EcuM main cycle on multi-core synchronisation will be started. If all the cores are ready for shutdown , then only actual shutdown of OS will be triggered from EcuM. The default value of slave core timeout counter is 100 ms (milli second). If EcuM_MainFunction() is not scheduled at every core then shutdown is delayed atleast by this 100ms.
      return type ReturnValue: direction=OUT, implementation-data-type=Std_ReturnType  # If E_OK returned E_OK shutdown will be initiated.E_NOT_OK is returned if the shutdown request was not accepted
      sw service arg caller: direction=IN, implementation-data-type=uint16  # It contains the Module ID of the calling module. Only special modules are allowed to call this function that should be configured in EcuMGoDownAllowedUsers
    EcuM_Shutdown: service-id=0x02, is-reentrant=true, is-synchronous=true, call-type=REGULAR, execution-context=HOOK  # Service to carry out OffPostOs activities. | After the shutdown of OS, this function takes over execution control and will carry out OffPostOs activities. This will initiated either MCU reset or EcuM_AL_SwitchOff callout based on the selected shutdown targets. | This function should be configured in OS shutdown hook.
    EcuM_GoHalt: service-id=0x20, is-reentrant=true, is-synchronous=true, call-type=REGULAR, execution-context=UNSPECIFIED  # Service to instruct the EcuM module to got into sleep mode. | Instructs the ECU State Manager module to go into a sleep mode where the microcontroller is halted, depending on the selected shutdown target.
      return type ReturnValue: direction=OUT, implementation-data-type=Std_ReturnType  # E_OK is returned if the call successfully returns and the ECU has left sleep again. E_NOT_OK is returned if the request was not accepted e.g. due to a wrong shutdown target.
    EcuM_GoPoll: service-id=0x21, is-reentrant=true, is-synchronous=true, call-type=REGULAR, execution-context=UNSPECIFIED  # Service to instruct the EcuM module to got into sleep mode. | Instructs the ECU State Manager module to go into a polling sleep mode depending on the selected shutdown target.
      return type ReturnValue: direction=OUT, implementation-data-type=Std_ReturnType  # E_OK is returned if the call successfully returns and the ECU has left sleep again. E_NOT_OK is returned if the request was not accepted e.g. due to a wrong shutdown target.
    EcuM_Init: service-id=0x01, is-reentrant=true, is-synchronous=true, call-type=REGULAR, execution-context=UNSPECIFIED  # Service to initialize the module. | Initializes the module and carries out the StartUp One procedure - this includes the other BSW module initialization and starting the OS. In case of multi-core environment all slave cores are started from master core EcuM_Init. EcuM_Init should be called from main(). Typically at the end because from EcuM_Init OS will be started and this call will never return. In case of multi-core environment EcuM_Init should be called from all core main().
    EcuM_StartupTwo: service-id=0x1a, is-reentrant=true, is-synchronous=true, call-type=REGULAR, execution-context=HOOK  # Service to implement Post-Os startup activities. | This function implements StartUp Two activities.
    EcuM_RbMoGetActivePostBuildVariantIndex: service-id=0x22, is-reentrant=false, is-synchronous=true, call-type=REGULAR, execution-context=UNSPECIFIED  # Service to return the active PostBuildVariant. | Returns the active PostBuildVariant selected in EcuM_DeterminePostBuildConfiguration as index. The index is autogenerated and exported as a define with a "symbolic name". Also the bitcomplement is returned.
      return type ReturnValue: direction=OUT, implementation-data-type=Std_ReturnType  # E_OK is returned if a valid index is updated. E_NOT_OK will be returned in case of errors, e.g. null pointer passed, when called before EcuM is returned.
      sw service arg index_cpu8: category=DATA_REFERENCE, direction=OUT, sw-impl-policy=CONST, sw-pointer-target-props={target-category=VALUE, implementation-data-type=uint8}  # The index is a refernce to the EcuMConfiguration containers. That is for each EcuMConfiguration container a symbolic name will be generated - example - if active post-build variant is EcuMConfiguration_4Cyl , then returned index will be EcuMConf_EcuMConfiguration_EcuMConfiguration_4Cyl.
      sw service arg indexBitComplement_cpu8: category=DATA_REFERENCE, direction=OUT, sw-impl-policy=CONST, sw-pointer-target-props={target-category=VALUE, implementation-data-type=uint8}  # bitcomplement of the index_cpu8.
    EcuM_RbMoInitCheck: service-id=0x23, is-reentrant=false, is-synchronous=true, call-type=REGULAR, execution-context=UNSPECIFIED  # Service to monitor the Post-Build pointers active in BSW modules. | This function will check the active post-build pointers in configured BSW modules under EcuMRbMo by calling the corresponding monitoring functions of these modules. | Integrator has to first obtain the active Post-Build index in EcuM by EcuM_RbMoGetActivePostBuildVariantIndex. Then this index should be used with EcuM_RbMoInitCheck service.
      return type ReturnValue: direction=OUT, implementation-data-type=Std_ReturnType  # E_OK is returned if all the monitoring relevant check functions returns E_OK. That is if all the modules are having the correct PB pointers. E_NOT_OK is returned incase of errors, e.g. if one of the monitoring relevant check functions returns E_NOT_OK or when called before EcuM is initialized.The failed service can be checked with debug variable EcuM_RbMoInitCheckDebugInfo_st.NameOfFunction.
      sw service arg index_cu8: direction=IN, implementation-data-type=uint8, sw-impl-policy=CONST  # Index of EcuMConfiguration
    EcuM_RbMoInitCheckInverse: service-id=0x24, is-reentrant=false, is-synchronous=true, call-type=REGULAR, execution-context=UNSPECIFIED  # Service to monitor the Post-Build pointers active in BSW modules against NULL_PTR. | This function will call all configured monitoring relevant check functions with NULL_PTR to ensure that they can return E_NOT_OK. If all functions return E_NOT_OK then EcuM_RbMoInitCheckInverse will return E_OK.
      return type ReturnValue: direction=OUT, implementation-data-type=Std_ReturnType  # E_NOT_OK is returned incase of errors, e.g. if one of the monitoring relevant check functions returns E_OK or when called before EcuM is initialized.E_OK is returned if all the monitoring relevant check functions returns E_NOT_OK.
    EcuM_Rb_GetEcuType: service-id=0x14, is-reentrant=true, is-synchronous=true, call-type=REGULAR, execution-context=UNSPECIFIED  # Service to get the index of PB variant from port-pins status. | This API shall return the index of the Post build variant depending upon the current level of the Portpins.The mapping between the index and pattern is derived from configuration of EcuMRbDeterminePb. | Integrator can configure a port and its pins for the index selection under EcuMRbDeterminePb. A maximum of 3 pins can be configured, that means 8 index values. This function will read the pin status and return the corresponding index by comparing against the pattern in EcuMRbPbVariant container.
      return type ReturnValue: direction=OUT, implementation-data-type=uint8  # This will return the index corresponding to the pin selection. If 255 is returned means there is no matching index - a negative result.
    EcuM_RequestRUN: service-id=0x03, is-reentrant=true, is-synchronous=true, call-type=REGULAR, execution-context=UNSPECIFIED  # Service to request for the RUN state. | Places a request for the RUN state. Requests can be placed by every user made known to the state manager at configuration time.
      return type ReturnValue: direction=OUT, implementation-data-type=Std_ReturnType  # E_OK is returned if the request was accepted by EcuM. E_NOT_OK is returned if the request was not accepted by EcuM, a detailed error condition was sent to DET.
      sw service arg user: direction=IN, implementation-data-type=EcuM_UserType  # user (ID of the entity requesting the RUN state)
    EcuM_ReleasePOST_RUN: service-id=0x0b, is-reentrant=true, is-synchronous=true, call-type=REGULAR, execution-context=UNSPECIFIED  # Service to release POST RUN request. | Releases a POST RUN request previously done with a call to EcuM_RequestPOST_RUN. The service is intended for implementing AUTOSAR ports.
      return type ReturnValue: direction=OUT, implementation-data-type=Std_ReturnType  # E_OK is returned if the request was accepted by EcuM. E_NOT_OK is returned if the request was not accepted by EcuM, a detailed error condition was sent to DET.
      sw service arg user: direction=IN, implementation-data-type=EcuM_UserType  # user (ID of the entity requesting the RUN state).
    EcuM_ReleaseRUN: service-id=0x04, is-reentrant=true, is-synchronous=true, call-type=REGULAR, execution-context=UNSPECIFIED  # Service to release RUN request. | Releases a RUN request previously done with a call to EcuM_RequestRUN. The service is intended for implementing AUTOSAR ports.
      return type ReturnValue: direction=OUT, implementation-data-type=Std_ReturnType  # E_OK is returned if the request was accepted by EcuM. E_NOT_OK is returned if the request was not accepted by EcuM, a detailed error condition was sent to DET.
      sw service arg user: direction=IN, implementation-data-type=EcuM_UserType  # user (ID of the entity requesting the RUN state).
    EcuM_RequestPOST_RUN: service-id=0x0a, is-reentrant=true, is-synchronous=true, call-type=REGULAR, execution-context=UNSPECIFIED  # Service to request for the POST RUN state. | Places a request for the POST RUN state. Requests can be placed by every user made known to the state manager at configuration time. Requests for RUN and POST RUN must be tracked independently (in other words: two independent variables). The service is intended for implementing AUTOSAR ports.
      return type ReturnValue: direction=OUT, implementation-data-type=Std_ReturnType  # E_OK is returned if the request was accepted by EcuM.E_NOT_OK is returned if the request was not accepted by EcuM, a detailed error condition was sent to DET.
      sw service arg user: direction=IN, implementation-data-type=EcuM_UserType  # user (ID of the entity requesting the RUN state)
    EcuM_KillAllRUNRequests: service-id=0x05, is-reentrant=true, is-synchronous=true, call-type=REGULAR, execution-context=UNSPECIFIED  # Service to release pending requests to RUN. | The benefit of this function over an ECU reset is that the shutdown sequence is executed. This function unconditionally releases all pending requests to RUN.
    EcuM_KillAllPostRUNRequests: service-id=0x2a, is-reentrant=true, is-synchronous=true, call-type=REGULAR, execution-context=UNSPECIFIED  # Service to release requests to Post RUN. | This function unconditionally releases all pending requests to Post RUN
    EcuM_Rb_CurrentState: service-id=0x30, is-reentrant=true, is-synchronous=true, call-type=REGULAR, execution-context=UNSPECIFIED  # Service to get current RTE mode. | Function called from RTE Switch acknowledgement event. EcuM_Rb_CurrentState will get the current RTE mode and notify the corresponding State to BswM_EcuM_CurrentState().
    EcuM_Rb_KillAllRequests: service-id=0, is-reentrant=true, is-synchronous=true, call-type=REGULAR, execution-context=UNSPECIFIED  # Service to release all pending requests. | This function unconditionally releases all pending requests to RUN and Post RUN.
    EcuM_SetState: service-id=0x2b, is-reentrant=true, is-synchronous=true, call-type=REGULAR, execution-context=UNSPECIFIED  # Function called by BswM to notify about State Switch. | The EcuM_SetState function shall set the EcuM State to the value of the State parameter. Only the following subset of the EcuM_StateType values are valid State parameter values: ECUM_STATE_STARTUP, ECUM_STATE_APP_RUN, ECUM_STATE_APP_POST_RUN, ECUM_STATE_SHUTDOWN, ECUM_STATE_SLEEP.
      sw service arg state: direction=IN, implementation-data-type=EcuM_StateType  # State indicated by BswM.
    EcuM_Rb_GetLastShutdownInfo: service-id=0x30, is-reentrant=true, is-synchronous=true, call-type=REGULAR, execution-context=UNSPECIFIED  # Function to provide previous shutdown cause and the time measured for startup as well as shutdown. | This function when invoked will return the shutdown cause as well as time taken for the previous shutdown process, if time measurement is enabled
      return type ReturnValue: direction=OUT, implementation-data-type=Std_ReturnType  # E_OK is returned if the service succeeded.E_NOT_OK is returned if the service failed e.g. NvM read operation. Detailed error information will be logged to Det module.
      sw service arg shutdownCauseInfo: category=DATA_REFERENCE, direction=OUT, sw-pointer-target-props={target-category=VALUE, implementation-data-type=EcuM_ShutdownInfoType}  # shutdown cause as well as time taken for the previous shutdown process if time measurement is enabled.
package /AUTOSAR_EcuM/ImplementationDataTypes
  5 x impl type, all with type-emitter=HEADER_FILE:
    EcuM_RunStatusType: compu {0=ECUM_RUNSTATUS_UNKNOWN (Unknown status. Init Value.), 1=ECUM_RUNSTATUS_REQUESTED (Status requested from EcuM), 2=ECUM_RUNSTATUS_RELEASED (Status released from EcuM.)}, implementation-data-type=uint8  # Result of the Run Request Protocol sent to BswM.The ECU Manager module shall inform BswM about the state of the Run Request Protocol as listed in the EcuM_RunStatusType.
    EcuM_StateType: compu {64=ECUM_STATE_SHUTDOWN, 16=ECUM_STATE_STARTUP, 51=ECUM_STATE_APP_POST_RUN, 50=ECUM_STATE_APP_RUN, 15=ECUM_SUBSTATE_MASK, 48=ECUM_STATE_RUN, 128=ECUM_STATE_OFF, 144=ECUM_STATE_RESET}, implementation-data-type=uint8  # EcuM_StateType defines the Autosar specified EcuM States and its corresponding values.BswM shall ask for State switch by calling EWcuM_SetState function with function parameter as any of EcuM_StateType.
    EcuM_WakeupSourceType: compu {1=ECUM_WKSOURCE_POWER (Power cycle (bit 0)), 2=ECUM_WKSOURCE_RESET (Hardware reset (bit 1). If the Mcu driver cannot distinguish between a power cycle and a reset reason, then this shall be the default wakeup source.), 4=ECUM_WKSOURCE_INTERNAL_RESET (Internal reset of μC (bit 2) The internal reset typically only resets the μC core but not peripherals or memory controllers. The exact behavior is hardware specific. This source may also indicate an unhandled exception.), 8=ECUM_WKSOURCE_INTERNAL_WDG (Reset by internal watchdog (bit 3)), 16=ECUM_WKSOURCE_EXTERNAL_WDG (Reset by external watchdog (bit 4))}, implementation-data-type=uint32  # This type defines the Wakeup source.EcuM_WakeupSourceType defines a bitfield with 5 pre-defined positions. The bitfield provides one bit for each wakeup source. In WAKEUP, all bits cleared indicates that no wakeup source is known. In STARTUP, all bits cleared indicates that no reason for restart or reset is known. In this case, ECUM_WKSOURCE_RESET shall be assumed.
    EcuM_WakeupStatusType: compu {0=ECUM_WKSTATUS_NONE (No pending wakeup event was detected), 1=ECUM_WKSTATUS_PENDING (The wakeup event was detected but not yet validated), 2=ECUM_WKSTATUS_VALIDATED (The wakeup event is valid), 3=ECUM_WKSTATUS_EXPIRED (The wakeup event has not been validated and has expired therefore), 6=ECUM_WKSTATUS_ENABLED (The wakeup source is enabled (armed) and is ready to call EcuM_SetWakeupEvent().)}, implementation-data-type=uint8  # The type describes the wakeup source states. The type describes the possible states of a wakeup source. This declaration has to be changed to a mode. The name has to be changed.
    EcuM_ShutdownInfoType: category=STRUCTURE  # This type contains two members: shutdown cause as well as time measured. The second parameter TimeMeasured is conditionally generated, i.e. it is only there if time measurement has been enabled in the module.
      element ShutdownCause: compu-method=EcuM_ShutdownCauseType, implementation-data-type=uint8
      element TimeMeasured: implementation-data-type=uint32
