AUTOSAR XML (schema 4-2-2)
package /ETAS_Project/EcucModuleConfigurationValuess
  module config CanIf
    CanIfInitCfg
      3 x CanIfTxPduCfg:
        BMS_Vol_8_Can_Network_CANNODE_0: CanIfTxPduId=1
        BMS_20_Can_Network_CANNODE_0: CanIfTxPduId=0
        NMm_BMS_Can_Network_CANNODE_0: CanIfTxPduId=2
      5 x CanIfRxPduCfg:
        TMR_3_Can_Network_CANNODE_0: CanIfRxPduId=0
        NMm_HCU_Can_Network_CANNODE_0: CanIfRxPduId=1
        NMm_CDU_Can_Network_CANNODE_0: CanIfRxPduId=2
        NMm_MCUR_Can_Network_CANNODE_0: CanIfRxPduId=3
        OBC_1_Can_Network_CANNODE_0: CanIfRxPduId=4
    CanIfCtrlDrvCfg
      Can_Network_CANNODE_0 (CanIfCtrlCfg): CanIfCtrlId=0
  module config ComM
    ComMConfigSet
      ComMUser_Can_Network_Channel (ComMUser): ComMUserIdentifier=0
      ComMChannel_Can_Network_Channel (ComMChannel): ComMChannelId=0
  module config Nm
    NmChannelConfig_Can_Network_Channel (NmChannelConfig): NmNodeDetectionEnabled=false, NmNodeIdEnabled=false, NmRepeatMsgIndEnabled=false
  module config CanNm
    CanNmGlobalConfig
      CanNmChannelConfig_NmConfig_0_CanNmCluster_0 (CanNmChannelConfig): CanNmNodeDetectionEnabled=false, CanNmNodeIdEnabled=false, CanNmRepeatMsgIndEnabled=false
        3 x CanNmRxPdu, all with CanNmRxPduId=0:
          CanNmRxPdu_NMm_HCU_Can_Network_CANNODE_0_CanIf2CanNm
          CanNmRxPdu_NMm_CDU_Can_Network_CANNODE_0_CanIf2CanNm
          CanNmRxPdu_NMm_MCUR_Can_Network_CANNODE_0_CanIf2CanNm
        CanNmTxPdu_NMm_BMS_Can_Network_CANNODE_0_CanNm2CanIf (CanNmTxPdu): CanNmTxConfirmationPduId=0
  module config CanSM
    CanSMConfiguration
      CanSMManagerNetwork_Can_Network (CanSMManagerNetwork): CanSMNetworkIndex=0
  module config Com
    ComConfig_0 (ComConfig)
      4 x ComIPdu:
        OBC_1_Can_Network_CANNODE_0: ComIPduHandleId=0
        TMR_3_Can_Network_CANNODE_0: ComIPduHandleId=1
        BMS_20_Can_Network_CANNODE_0: ComIPduHandleId=0
        BMS_Vol_8_Can_Network_CANNODE_0: ComIPduHandleId=1
      16 x ComSignal:
        OBC_FaultLevelSts: ComHandleId=0
        OBC_ChgSts: ComHandleId=1
        OBC_OutputPowerLimt: ComHandleId=2
        OBC_ChgVolt: ComHandleId=3
        OBC_ChgCurr: ComHandleId=4
        TMR_VoltageHV: ComHandleId=5
        TMR_CurrentHV: ComHandleId=6
        BMSH_19_Reserved1: ComHandleId=0
        BMSH_CellSensor_TotalNum: ComHandleId=1
        BMSH_SingleFeedbackEnergy: ComHandleId=2
        BMSH_SingleDisChargeEnergy: ComHandleId=3
        BMSH_SingleChargeEnergy: ComHandleId=4
        BMS_BattCellOrder32Vol: ComHandleId=5
        BMS_BattCellOrder31Vol: ComHandleId=6
        BMS_BattCellOrder30Vol: ComHandleId=7
        BMS_BattCellOrder29Vol: ComHandleId=8
      ComIPduGroup_Rx (ComIPduGroup): ComIPduGroupHandleId=0
      ComIPduGroup_Tx (ComIPduGroup): ComIPduGroupHandleId=1
    ComGeneral: ComSupportedIPduGroups=2
  module config PduR
    PduRRoutingTables
      PduRRoutingTable
        4 x PduRRoutingPath:
          OBC_1_Can_Network_CANNODE_0_CanIf2Com
            OBC_1_Can_Network_CANNODE_0_CanIf2PduR (PduRSrcPdu): PduRSourcePduHandleId=0
            OBC_1_Can_Network_CANNODE_0_PduR2Com (PduRDestPdu): PduRDestPduHandleId=0
          TMR_3_Can_Network_CANNODE_0_CanIf2Com
            TMR_3_Can_Network_CANNODE_0_CanIf2PduR (PduRSrcPdu): PduRSourcePduHandleId=1
            TMR_3_Can_Network_CANNODE_0_PduR2Com (PduRDestPdu): PduRDestPduHandleId=1
          BMS_20_Can_Network_CANNODE_0_Com2CanIf
            BMS_20_Can_Network_CANNODE_0_PduR2CanIf (PduRDestPdu): PduRDestPduHandleId=0
            BMS_20_Can_Network_CANNODE_0_Com2PduR (PduRSrcPdu): PduRSourcePduHandleId=0
          BMS_Vol_8_Can_Network_CANNODE_0_Com2CanIf
            BMS_Vol_8_Can_Network_CANNODE_0_PduR2CanIf (PduRDestPdu): PduRDestPduHandleId=1
            BMS_Vol_8_Can_Network_CANNODE_0_Com2PduR (PduRSrcPdu): PduRSourcePduHandleId=1
package /RB/UBK/Project/EcucModuleConfigurationValuess
  module config rba_ArxmlGen
    5 x rba_ArxmlGen_Comp:
      CanIf
        CanIf_ControllerState_Astruct_impl (rba_ArxmlGen_ImplDataType):
          rba_ArxmlGen_ImplDataTypeCategory = Array
          rba_ArxmlGen_ImplDataTypeLongName = Implementation datatype for array of struct
          rba_ArxmlGen_ImplDataTypeNumElements = 1
          CanIf_struct_impl (rba_ArxmlGen_ImplDataTypeSub): rba_ArxmlGen_ImplDataTypeSubOwnRef=CanIf_ControllerStateType_struct_impl
        CanIf_ControllerState_Astruct_app (rba_ArxmlGen_ApplDataType):
          rba_ArxmlGen_ApplDataTypeCategory = Array
          rba_ArxmlGen_ApplDataTypeLongName = Structure datatype in CanIf
          rba_ArxmlGen_ApplDataTypeNumElements = 1
          rba_ArxmlGen_ApplDataTypeImplOwnRef = CanIf_ControllerState_Astruct_impl
          CanIf_ControllerStateType (rba_ArxmlGen_ApplDataTypeSub): rba_ArxmlGen_ApplDataTypeSubOwnRef=CanIf_ControllerStateType_struct_app
        CanIf_Prv_ControllerState_ast (rba_ArxmlGen_Measurement):
          rba_ArxmlGen_MeasCategory = Array
          rba_ArxmlGen_MeasDispFormat = %5.0f
          rba_ArxmlGen_MeasLongName = Can Interface controller State
          rba_ArxmlGen_MeasAddrMethodRef = INTERNAL_VAR_CLEARED
          rba_ArxmlGen_MeasApplDataTypeOwnRef = CanIf_ControllerState_Astruct_app
        CanIf_NotifStatusType_Aenum_impl (rba_ArxmlGen_ImplDataType):
          rba_ArxmlGen_ImplDataTypeCategory = Array
          rba_ArxmlGen_ImplDataTypeLongName = implementation data type for array of enum
          rba_ArxmlGen_ImplDataTypeNumElements = 3
          CanIf_Enum_impl (rba_ArxmlGen_ImplDataTypeSub): rba_ArxmlGen_ImplDataTypeSubOwnRef=CanIf_NotifStatusType_Enum_impl
        CanIf_NotifStatusType_Aenum_app (rba_ArxmlGen_ApplDataType):
          rba_ArxmlGen_ApplDataTypeCategory = Array
          rba_ArxmlGen_ApplDataTypeLongName = application data type for array of enum
          rba_ArxmlGen_ApplDataTypeNumElements = 3
          rba_ArxmlGen_ApplDataTypeImplOwnRef = CanIf_NotifStatusType_Aenum_impl
          CanIf_NotifStatusType (rba_ArxmlGen_ApplDataTypeSub): rba_ArxmlGen_ApplDataTypeSubOwnRef=CanIf_NotifStatusType_Enum_app
        CanIf_Prv_TxNotification_aen (rba_ArxmlGen_Measurement):
          rba_ArxmlGen_MeasCategory = Array
          rba_ArxmlGen_MeasDispFormat = %5.0f
          rba_ArxmlGen_MeasLongName = Can Interface Transmit Notification
          rba_ArxmlGen_MeasAddrMethodRef = INTERNAL_VAR_CLEARED
          rba_ArxmlGen_MeasApplDataTypeOwnRef = CanIf_NotifStatusType_Aenum_app
      CanNm
        BSWSE_MainFunction (rba_ArxmlGen_ExecEntity): rba_ArxmlGen_ExecEntityPeriod=0.01
      CanSM
        CanSM_Au8_app (rba_ArxmlGen_ApplDataType): rba_ArxmlGen_ApplDataTypeNumElements=1
        CanSM_Au8_impl (rba_ArxmlGen_ImplDataType): rba_ArxmlGen_ImplDataTypeNumElements=1
        CanSM_Aboolean_app (rba_ArxmlGen_ApplDataType): rba_ArxmlGen_ApplDataTypeNumElements=1
        CanSM_Aboolean_impl (rba_ArxmlGen_ImplDataType): rba_ArxmlGen_ImplDataTypeNumElements=1
        CanSM_currBOR_State_a_Aenum_app (rba_ArxmlGen_ApplDataType): rba_ArxmlGen_ApplDataTypeNumElements=1
        CanSM_currBOR_State_a_Aenum_impl (rba_ArxmlGen_ImplDataType): rba_ArxmlGen_ImplDataTypeNumElements=1
        CanSM_currComM_Mode_a_Aenum_app (rba_ArxmlGen_ApplDataType): rba_ArxmlGen_ApplDataTypeNumElements=1
        CanSM_currComM_Mode_a_Aenum_impl (rba_ArxmlGen_ImplDataType): rba_ArxmlGen_ImplDataTypeNumElements=1
        CanSM_TimerConfig_ast_Astruct_app (rba_ArxmlGen_ApplDataType): rba_ArxmlGen_ApplDataTypeNumElements=1
        CanSM_TimerConfig_ast_Astruct_impl (rba_ArxmlGen_ImplDataType): rba_ArxmlGen_ImplDataTypeNumElements=1
        BSWSE_MainFunction (rba_ArxmlGen_ExecEntity): rba_ArxmlGen_ExecEntityPeriod=0.01
      ComM
        ComM_UserStruct_Array_App (rba_ArxmlGen_ApplDataType): rba_ArxmlGen_ApplDataTypeNumElements=1
        ComM_UserStruct_Array_Impl (rba_ArxmlGen_ImplDataType): rba_ArxmlGen_ImplDataTypeNumElements=1
        ComM_ChannelStruct_Array_App (rba_ArxmlGen_ApplDataType): rba_ArxmlGen_ApplDataTypeNumElements=1
        ComM_ChannelStruct_Array_Impl (rba_ArxmlGen_ImplDataType): rba_ArxmlGen_ImplDataTypeNumElements=1
        BSWSE_MainFunction_ComMChannel_Can_Network_Channel (rba_ArxmlGen_ExecEntity):
          rba_ArxmlGen_ExecEntityCategory = Schedulable
          rba_ArxmlGen_ExecEntityPeriod = 0.01
          rba_ArxmlGen_ExecEntityImplEntryRef = ComM_MainFunction_ComMChannel_Can_Network_Channel
      Com
        Com_SigBuf_au8_impl (rba_ArxmlGen_ImplDataType):
          rba_ArxmlGen_ImplDataTypeCategory = Array
          rba_ArxmlGen_ImplDataTypeNumElements = 2
          rba_ArxmlGen_ImplDataTypeLongName = Implementation data type for Signals of type - uint8,sint8,boolean,uint8_n
          Com_Subimpl_u8 (rba_ArxmlGen_ImplDataTypeSub): rba_ArxmlGen_ImplDataTypeSubOwnRef=Com_impl_u8
        Com_SigBuf_au8 (rba_ArxmlGen_ApplDataType):
          rba_ArxmlGen_ApplDataTypeCategory = Array
          rba_ArxmlGen_ApplDataTypeNumElements = 2
          rba_ArxmlGen_ApplDataTypeLongName = Application data type for Signals of type - uint8,sint8,boolean,uint8_n
          rba_ArxmlGen_ApplDataTypeImplOwnRef = Com_SigBuf_au8_impl
          Com_Subapp_u8 (rba_ArxmlGen_ApplDataTypeSub): rba_ArxmlGen_ApplDataTypeSubOwnRef=Com_uint8
        Com_SigBuf_au16_impl (rba_ArxmlGen_ImplDataType):
          rba_ArxmlGen_ImplDataTypeCategory = Array
          rba_ArxmlGen_ImplDataTypeNumElements = 5
          rba_ArxmlGen_ImplDataTypeLongName = Implementation data type for Signals of type - uint16,sint16
          Com_Subimpl_u16 (rba_ArxmlGen_ImplDataTypeSub): rba_ArxmlGen_ImplDataTypeSubOwnRef=Com_impl_u16
        Com_SigBuf_au16 (rba_ArxmlGen_ApplDataType):
          rba_ArxmlGen_ApplDataTypeCategory = Array
          rba_ArxmlGen_ApplDataTypeNumElements = 5
          rba_ArxmlGen_ApplDataTypeLongName = Application data type for Signals of type - uint16,sint16
          rba_ArxmlGen_ApplDataTypeImplOwnRef = Com_SigBuf_au16_impl
          Com_Subapp_u16 (rba_ArxmlGen_ApplDataTypeSub): rba_ArxmlGen_ApplDataTypeSubOwnRef=Com_uint16
        Com_SigType_u8 (rba_ArxmlGen_Measurement):
          rba_ArxmlGen_MeasCategory = Array
          rba_ArxmlGen_MeasDispFormat = %5.0f
          rba_ArxmlGen_MeasLongName = Measurement variable for Signals of type - uint8,sint8,boolean,uint8_n. To refer Individual element in the Buffer array, Fetch Buffer Index from Com_PBcfg.c for each signal.
          rba_ArxmlGen_MeasAddrMethodRef = INTERNAL_VAR_CLEARED
          rba_ArxmlGen_MeasApplDataTypeOwnRef = Com_SigBuf_au8
        Com_SigType_u16 (rba_ArxmlGen_Measurement):
          rba_ArxmlGen_MeasCategory = Array
          rba_ArxmlGen_MeasDispFormat = %5.0f
          rba_ArxmlGen_MeasLongName = Measurement variable for Signals of type - uint16,sint16. To refer Individual element in the Buffer array, Fetch Buffer Index from Com_PBcfg.c for each signal.
          rba_ArxmlGen_MeasAddrMethodRef = INTERNAL_VAR_CLEARED
          rba_ArxmlGen_MeasApplDataTypeOwnRef = Com_SigBuf_au16
        Com_implDataType_au8_Size8 (rba_ArxmlGen_ImplDataType):
          rba_ArxmlGen_ImplDataTypeCategory = Array
          rba_ArxmlGen_ImplDataTypeLongName = Implementation data type for Ipdu buffer of Size8
          rba_ArxmlGen_ImplDataTypeNumElements = 8
          Com_Subimpl8 (rba_ArxmlGen_ImplDataTypeSub): rba_ArxmlGen_ImplDataTypeSubOwnRef=Com_impl_u8
        Com_applDataType_au8_Size8 (rba_ArxmlGen_ApplDataType):
          rba_ArxmlGen_ApplDataTypeCategory = Array
          rba_ArxmlGen_ApplDataTypeLongName = Application data type for Ipdu buffer of Size8
          rba_ArxmlGen_ApplDataTypeNumElements = 8
          rba_ArxmlGen_ApplDataTypeImplOwnRef = Com_implDataType_au8_Size8
          Com_Subapp8 (rba_ArxmlGen_ApplDataTypeSub): rba_ArxmlGen_ApplDataTypeSubOwnRef=Com_uint8
        4 x rba_ArxmlGen_Measurement, all with rba_ArxmlGen_MeasCategory=Array, rba_ArxmlGen_MeasDispFormat=%5.0f, rba_ArxmlGen_MeasAddrMethodRef=INTERNAL_VAR_CLEARED, rba_ArxmlGen_MeasApplDataTypeOwnRef=Com_applDataType_au8_Size8:
          Com_IpduBuf_BMS_20_Can_Network_CANNODE_0: rba_ArxmlGen_MeasLongName=Tx Ipdu buffer of IPdu -BMS_20_Can_Network_CANNODE_0- as a Measurement parameter
          Com_IpduBuf_BMS_Vol_8_Can_Network_CANNODE_0: rba_ArxmlGen_MeasLongName=Tx Ipdu buffer of IPdu -BMS_Vol_8_Can_Network_CANNODE_0- as a Measurement parameter
          Com_LocalBuf_OBC_1_Can_Network_CANNODE_0: rba_ArxmlGen_MeasLongName=Rx Local Ipdu buffer of IPdu -OBC_1_Can_Network_CANNODE_0- as a Measurement parameter
          Com_LocalBuf_TMR_3_Can_Network_CANNODE_0: rba_ArxmlGen_MeasLongName=Rx Local Ipdu buffer of IPdu -TMR_3_Can_Network_CANNODE_0- as a Measurement parameter
        BSWSE_MainFunctionRx (rba_ArxmlGen_ExecEntity): rba_ArxmlGen_ExecEntityPeriod=0.01
        BSWSE_MainFunctionTx (rba_ArxmlGen_ExecEntity): rba_ArxmlGen_ExecEntityPeriod=0.01
