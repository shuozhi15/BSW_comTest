AUTOSAR XML (schema 4-2-2)
package /AUTOSAR_CanTp/EcucModuleDefs
  module definition CanTp [0..1]: category=VENDOR_SPECIFIC_MODULE_DEFINITION, post-build-variant-support=true, refined-module-def=CanTp, variants post-build/pre-compile  # Configuration of the CanTp (CAN Transport Protocol) module.
    container CanTpConfig  # This container contains the configuration parameters and sub containers of the AUTOSAR CanTp module.
      float CanTpMainFunctionPeriod: 0..0.255, scope=ECU, set at pre-compile  # Allow to configure the time for the MainFunction (as float in seconds). The CanTpMainFunctionPeriod should be assigned a value which is optimal regarding all of the timers configured for CanTp in TX and RX data transfer i.e. the differences from the configured timing should be as small as possible. Please note: This period shall be the same as call cycle time of the periodic task were CanTp Main function is called.
      integer CanTpMaxChannelCnt [0..1]: 0..1.84467440737095E+19, multiplicity set at pre-compile, set at pre-compile  # Maximum number of channels. This parameter is needed only in case of post-build loadable implementation using static memory allocation. Value of this shall be more than [ (2 x NUMBER_OF_FULL_DUPLEX_CHANNELS) + NUMBER_OF_HALF_DUPLEX_CHANNELS ]. This decides the size of CanTp_ChannelIdType.
      container CanTpChannel [1..*]: multiplicity set at pre-compile in variant pre-compile / post-build in variant post-build, post-build-variant-multiplicity=true  # This container contains the configuration parameters of the CanTp channel.
        enumeration CanTpChannelMode: {CANTP_MODE_FULL_DUPLEX, CANTP_MODE_HALF_DUPLEX}, set at pre-compile  # The CAN Transport Layer supports half and full duplex channel modes.
        container CanTpRxNSdu [0..*]: multiplicity set at pre-compile in variant pre-compile / post-build in variant post-build, post-build-variant-multiplicity=true  # The following parameters needs to be configured for each CAN N-SDU that the CanTp module receives via the CanTpChannel.
          integer CanTpBs [0..1]: 0..255, multiplicity set at pre-compile in variant pre-compile / post-build in variant post-build, post-build-variant-multiplicity=true, post-build-variant-value=true, set at pre-compile in variant pre-compile / post-build in variant post-build  # Sets the number of N-PDUs the CanTp receiver allows the sender to send, before waiting for an authorization to continue transmission of the following N-PDUs.For further details on this parameter value see ISO 15765-2 specification. | Note: For reasons of buffer length, the CAN Transport Layer can adapt the BS value within the limit of this maximum BS
          float CanTpNar [0..1]: 0..42.9, multiplicity set at pre-compile in variant pre-compile / post-build in variant post-build, post-build-variant-multiplicity=true, post-build-variant-value=true, set at pre-compile in variant pre-compile / post-build in variant post-build  # Value in seconds of the N_Ar timeout. N_Ar is the time for transmission of a CAN frame (any N_PDU) on the receiver side. Note: Real Maximum value as configurable is to depend on the clock frequency and the TickType variable holding the value. Theoretical Maximum limit given here is only as an indicator considering 100MHz System Timer frequency and 32bit TickType variable.
          float CanTpNbr: 0..42.9, post-build-variant-value=true, set at pre-compile in variant pre-compile / post-build in variant post-build  # Value in seconds of the performance requirement for (N_Br + N_Ar). N_Br is the elapsed time between the receiving indication of a FF or CF or the transmit confirmation of a FC, until the transmit request of the next FC. This timer is reset if the FC is sent with Flow Status - Wait. Note: Real Maximum value as configurable is to depend on the clock frequency and the TickType variable holding the value. Theoretical Maximum limit given here is only as an indicator considering 100MHz System Timer frequency and 32bit TickType variable.
          float CanTpNcr [0..1]: 0..42.9, multiplicity set at pre-compile in variant pre-compile / post-build in variant post-build, post-build-variant-multiplicity=true, post-build-variant-value=true, set at pre-compile in variant pre-compile / post-build in variant post-build  # Value in seconds of the N_Cr timeout. N_Cr is the time until reception of the next Consecutive Frame N_PDU. Note: Real Maximum value as configurable is to depend on the clock frequency and the TickType variable holding the value. Theoretical Maximum limit given here is only as an indicator considering 100MHz System Timer frequency and 32bit TickType variable.
          boolean CanTpRbRxFcDisabled [0..1]: multiplicity set at pre-compile, origin=RB:AR42.1.0.0:2016-10-24, set at pre-compile, default-value=false  # Vendor specific extension defines whether Flow Control Frame is supported in this connection. For an ISO 15765-2 Specific Implementation its value should be false. false: The connection will send Flow Control Frames during segmented reception. true - No Flow Control Frame is sent during segmented reception.
          enumeration CanTpRxAddressingFormat: {CANTP_EXTENDED, CANTP_MIXED, CANTP_MIXED29BIT, CANTP_NORMALFIXED, CANTP_STANDARD}, set at pre-compile  # Declares which communication addressing mode is supported for this RxNSdu. Definition of Enumeration values: CanTpStandard to use normal addressing format. CanTpExtended to use extended addressing format. CanTpMixed to use mixed 11 bit addressing format. CanTpNormalFixed to use normal fixed addressing format. CanTpMixed29Bit to use mixed 29 bit addressing format. | Enum values: CanTpStandard. To use normal addressing format. CanTpExtended. To use extended addressing format. CanTpMixed. To use mixed addressing format.
          integer CanTpRxNSduId: 0..65535, set at pre-compile, symbolic-name-value=true  # Unique identifier user by the upper layer to call CanTp_CancelReceive, CanTp_ChangeParameter and CanTp_ReadParameter.
          enumeration CanTpRxPaddingActivation: {CANTP_OFF, CANTP_ON}, post-build-variant-value=true, set at pre-compile in variant pre-compile / post-build in variant post-build  # Defines if the receive frame uses padding or not. This parameter is restricted to 8 byte N-PDUs. Definition of enumeration values: CanTpOn: The N-PDU received uses padding for SF, FC and the last CF. (N-PDU length is always ≥ 8 bytes in case of CAN 2.0) CanTpOff: The N-PDU received does not use padding for SF, CF and the last CF. (N-PDU length is dynamic - any valid DLC value). Note: The mandatory mapping to the next higher valid DLC value for N-PDUs with a length > 8 bytes is not affected by this parameter. | Definition of enumeration values: CanTpOn: The N-PDU received is validated for padding which include SF and the last CF. (N-PDU length is always 8 bytes). Tx FC N-PDU which is sent from this Rx N-Sdu shall also be set to DLC of 8. CanTpOff: The N-PDU received does not use padding for SF, CF and the last CF. (N-PDU length is dynamic) CanTpTxOn: The N-PDU received is not validated for padding which include SF and the last CF, but Tx FC N-PDU which is sent from this Rx N-Sdu shall be set to DLC of 8. Padding is enabled only for transmit Pdu's from ECU
          enumeration CanTpRxTaType: {CANTP_CANFD_FUNCTIONAL, CANTP_CANFD_PHYSICAL, CANTP_FUNCTIONAL, CANTP_PHYSICAL}, set at pre-compile  # Declares the communication type of this Rx N-SDU.
          integer CanTpRxWftMax [0..1]: 0..65535, multiplicity set at pre-compile in variant pre-compile / post-build in variant post-build, post-build-variant-multiplicity=true, post-build-variant-value=true, set at pre-compile in variant pre-compile / post-build in variant post-build  # This parameter indicates how many Flow Control wait N-PDUs can be consecutively transmitted by the receiver. It is local to the node and is not transmitted inside the FC protocol data unit. CanTpRxWftMax is used to avoid sender nodes being potentially hooked-up in case of a temporarily reception inability on the part of the receiver nodes, whereby the sender could be waiting continuously. | CanTpRxWftMax is used to avoid sender nodes being potentially hooked-up in case of a temporarily reception inability on the part of the receiver nodes, whereby the sender could be waiting continuously.
          float CanTpSTmin [0..1]: 0..0.127, multiplicity set at pre-compile in variant pre-compile / post-build in variant post-build, post-build-variant-multiplicity=true, post-build-variant-value=true, set at pre-compile in variant pre-compile / post-build in variant post-build  # Sets the duration of the minimum time the CanTp sender shall wait between the transmissions of two CF N-PDUs. For further details on this parameter value see ISO 15765-2 specification. Note: if StMin is configured 0 then, it should be made sure in lower layer (CanDriver) that, the respective hardware object runs in interrupt mode. | For further details on this parameter value see ISO 15765-2 specification.
          reference CanTpRxNSduRef: post-build-variant-value=true, set at pre-compile in variant pre-compile / post-build in variant post-build, destination=Pdu  # Reference to a Pdu in the COM-Stack.
          container CanTpNAe [0..1]  # This container is required for each RxNSdu and TxNSdu with AddressingFormat CANTP_MIXED or CANTP_MIXED29BIT.
            integer CanTpNAe: 0..255, set at pre-compile  # This parameter contains the transport protocol address extension value. | format, this parameter contains the transport protocol address extension value.
          container CanTpNSa [0..1]  # This container is required for each RxNSdu and TxNSdu with RxTaType CANTP_PHYSICAL and CanTpAddressingFormat CANTP_EXTENDED. When DynIdSupport is enabled, this container is also required for each TxNSdu with AddressingFormat CANTP_NORMALFIXED or CANTP_MIXED29BIT. When DynIdSupport is enabled and GenericConnectionSupport is not enabled, this container is also required for each RxNSdu with AddressingFormat CANTP_NORMALFIXED or CANTP_MIXED29BIT.
            integer CanTpNSa: 0..255, set at pre-compile  # This parameter contains the transport protocol source address value.
          container CanTpNTa [0..1]  # This container is required for each RxNSdu and TxNSdu with AddressingFormat CANTP_EXTENDED. When DynIdSupport is enabled, this container is also required for each RxNSdu with AddressingFormat CANTP_NORMALFIXED or CANTP_MIXED29BIT. When DynIdSupport is enabled and GenericConnectionSupport is not enabled, this container is also required for each TxNSdu with AddressingFormat CANTP_NORMALFIXED or CANTP_MIXED29BIT.
            integer CanTpNTa: 0..255, set at pre-compile  # This parameter contains the transport protocol target address value.
          container CanTpRxNPdu  # Used for grouping of the ID of a PDU and the Reference to a PDU..
            integer CanTpRxNPduId: 0..65535, set at pre-compile, symbolic-name-value=true, with-auto=true  # The N-PDU identifier attached to the RxNsdu is identified by CanTpRxNSduId. Each RxNsdu identifier is linked to only one SF/FF/CF N-PDU identifier. Nevertheless, in the case of extended or mixed addressing format, the same N-PDU identifier can be used for several N-SDU identifiers. The distinction is made by the N_TA or N_AE value (first data byte of SF or FF frames). | Each RxNsdu identifier is linked to only one SF/FF/CF N-PDU identifier. Nevertheless, in the case of extended or mixed addressing format, the same N-PDU identifier can be used for several N-SDU identifiers. The distinction is made by the N_TA or N_AE value (first data byte of SF or FF frames).
            reference CanTpRxNPduRef: post-build-variant-value=true, set at pre-compile in variant pre-compile / post-build in variant post-build, destination=Pdu  # Reference to a Pdu in the COM-Stack.
          container CanTpTxFcNPdu [0..1]  # Used for grouping of the ID of a PDU and the Reference to a PDU.
            integer CanTpTxFcNPduConfirmationPduId: 0..65535, set at pre-compile, symbolic-name-value=true, with-auto=true  # Handle Id to be used by the CanIf to confirm the transmission of the CanTpTxFcNPdu to the CanIf module.
            reference CanTpTxFcNPduRef: post-build-variant-value=true, set at pre-compile in variant pre-compile / post-build in variant post-build, destination=Pdu  # Reference to a Pdu in the COM-Stack
        container CanTpTxNSdu [0..*]: multiplicity set at pre-compile in variant pre-compile / post-build in variant post-build, post-build-variant-multiplicity=true  # The following parameters needs to be configured for each CAN N-SDU that the CanTp module transmits via the CanTpChannel.
          float CanTpNas: 0..42.9, post-build-variant-value=true, set at pre-compile in variant pre-compile / post-build in variant post-build  # Value in seconds of the N_As timeout. N_As is the time for transmission of a CAN frame (any N_PDU) on the part of the sender. Note: Real Maximum value as configurable is to depend on the clock frequency and the TickType variable holding the value. Theoretical Maximum limit given here is only as an indicator considering 100MHz System Timer frequency and 32bit TickType variable.
          float CanTpNbs [0..1]: 0..42.9, multiplicity set at pre-compile in variant pre-compile / post-build in variant post-build, post-build-variant-multiplicity=true, post-build-variant-value=true, set at pre-compile in variant pre-compile / post-build in variant post-build  # Value in seconds of the N_Bs timeout. N_Bs is the time of transmission until reception of the next Flow Control N_PDU. Note: This value is reset on reception of a FC frame with Wait Status. Real Maximum value as configurable is to depend on the clock frequency and the TickType variable holding the value. Theoretical Maximum limit given here is only as an indicator considering 100MHz System Timer frequency and 32bit TickType variable.
          float CanTpNcs [0..1]: 0..42.9, multiplicity set at pre-compile in variant pre-compile / post-build in variant post-build, post-build-variant-multiplicity=true, post-build-variant-value=true, set at pre-compile in variant pre-compile / post-build in variant post-build  # Value in seconds of the performance requirement of (N_Cs + N_As). N_Cs is the time which elapses between the transmit request of a CF N-PDU until the transmit request of the next CF N-PDU. Note: Real Maximum value as configurable is to depend on the clock frequency and the TickType variable holding the value. Theoretical Maximum limit given here is only as an indicator considering 100MHz System Timer frequency and 32bit TickType variable.
          boolean CanTpRbTxFcDisabled [0..1]: multiplicity set at pre-compile, origin=RB:AR42.1.0.0:2016-10-24, set at pre-compile, default-value=false  # Vendor specific extension defines whether Flow Control Frame is supported in this connection. For an ISO 15765-2 Specific Implementation. Its value should be false. false: The connection will Receive and process the Flow Control Frames during segmented transmission. true - No Flow Control Frame is expected during segmented transmission.The Consecutive frames are transmitted one after the other without waiting for a flow control frame.
          boolean CanTpTc: set at pre-compile  # Switch for enabling Transmit Cancellation.
          enumeration CanTpTxAddressingFormat: {CANTP_EXTENDED, CANTP_MIXED, CANTP_MIXED29BIT, CANTP_NORMALFIXED, CANTP_STANDARD}, set at pre-compile  # Declares which communication addressing format is supported for this TxNSdu. Definition of Enumeration values: CanTpStandard to use normal addressing format. CanTpExtended to use extended addressing format. CanTpMixed to use mixed 11 bit addressing format. CanTpNormalFixed to use normal fixed addressing format. CanTpMixed29Bit to use mixed 29 bit addressing format. | Definition of Enumeration values: CanTpStandard to use normal addressing format. CanTpExtended to use extended addressing format (the N_TA container of this TxNsdu will be used). CanTpMixed to use mixed addressing format (the N_AE container of this TxNsdu will be used).
          integer CanTpTxNSduId: 0..65535, set at pre-compile, symbolic-name-value=true, with-auto=true  # Unique identifier to a structure that contains all useful information to process the transmission of a TxNsdu.
          enumeration CanTpTxPaddingActivation: {CANTP_OFF, CANTP_ON}, post-build-variant-value=true, set at pre-compile in variant pre-compile / post-build in variant post-build  # Defines if the transmit frame use padding or not. This parameter is restricted to 8 byte N-PDUs. Definition of Enumeration values: CanTpOn The transmit N-PDU uses padding for SF, FC and the last CF. (N-PDU length is always 8 bytes in case of CAN 2.0) CanTpOff The transmit N-PDU does not use padding for SF, CF and the last CF. (N-PDU length is dynamic - any valid DLC value). Note: The mandatory mapping to the next higher valid DLC value for N-PDUs with a length > 8 bytes is not affected by this parameter. | Definition of Enumeration values: CanTpOn The transmit N-PDU uses padding for SF, and the last CF. (N-PDU length is always 8 bytes) and validating if the received FC is also padded accordingly. CanTpOff The transmit N-PDU does not use padding for SF, FC and the last CF. (N-PDU length is dynamic) CanTpTxOn The transmit N-PDU uses padding for SF, and the last CF. (N-PDU length is dynamic) but the received FC is not validated for padding.
          enumeration CanTpTxTaType: {CANTP_FUNCTIONAL, CANTP_PHYSICAL}, set at pre-compile  # Declares the communication type of this TxNsdu. Enumeration values: CanTpPhysical. Used for 1:1 communication. CanTpFunctional. Used for 1:n communication. | Enumeration values: CanTpPhysical. Used for 1:1 communication. CanTpFunctional. Used for 1:n communication.
          reference CanTpTxNSduRef: post-build-variant-value=true, set at pre-compile in variant pre-compile / post-build in variant post-build, destination=Pdu  # Reference to a Pdu in the COM-Stack.
          container CanTpNAe [0..1]  # This container is required for each RxNSdu and TxNSdu with AddressingFormat CANTP_MIXED or CANTP_MIXED29BIT.
            integer CanTpNAe: 0..255, set at pre-compile  # This parameter contains the transport protocol address extension value. | format, this parameter contains the transport protocol address extension value.
          container CanTpNSa [0..1]  # This container is required for each RxNSdu and TxNSdu with RxTaType CANTP_PHYSICAL and CanTpAddressingFormat CANTP_EXTENDED. When DynIdSupport is enabled, this container is also required for each TxNSdu with AddressingFormat CANTP_NORMALFIXED or CANTP_MIXED29BIT. When DynIdSupport is enabled and GenericConnectionSupport is not enabled, this container is also required for each RxNSdu with AddressingFormat CANTP_NORMALFIXED or CANTP_MIXED29BIT.
            integer CanTpNSa: 0..255, set at pre-compile  # This parameter contains the transport protocol source address value.
          container CanTpNTa [0..1]  # This container is required for each RxNSdu and TxNSdu with AddressingFormat CANTP_EXTENDED. When DynIdSupport is enabled, this container is also required for each RxNSdu with AddressingFormat CANTP_NORMALFIXED or CANTP_MIXED29BIT. When DynIdSupport is enabled and GenericConnectionSupport is not enabled, this container is also required for each TxNSdu with AddressingFormat CANTP_NORMALFIXED or CANTP_MIXED29BIT.
            integer CanTpNTa: 0..255, set at pre-compile  # This parameter contains the transport protocol target address value.
          container CanTpRxFcNPdu [0..1]  # Used for grouping of the ID of a PDU and the Reference to a PDU.
            integer CanTpRxFcNPduId: 0..65535, set at pre-compile, symbolic-name-value=true, with-auto=true  # N-PDU identifier attached to the FC N-PDU of this TxNsdu identified by CanTpTxNSduId. Each TxNsdu identifier is linked to one Rx FC N-PDU identifier only. However, in the case of extended addressing format, the same FC N-PDU identifier can be used for several N-SDU identifiers. The distinction is made by means of the N_TA value (first data byte of FC frames). | Each TxNsdu identifier is linked to one Rx FC N-PDU identifier only. However, in the case of extended addressing format, the same FC N-PDU identifier can be used for several N-SDU identifiers. The distinction is made by means of the N_TA value or N_AE value (first data byte of FC frames).
            reference CanTpRxFcNPduRef: post-build-variant-value=true, set at pre-compile in variant pre-compile / post-build in variant post-build, destination=Pdu  # Reference to a Pdu in the COM-Stack
          container CanTpTxNPdu  # Used for grouping of the ID of a PDU and the Reference to a PDU.
            integer CanTpTxNPduConfirmationPduId: 0..65535, set at pre-compile, symbolic-name-value=true, with-auto=true  # Handle Id to be used by the CanIf to confirm the transmission of the CanTpTxNPdu to the CanIf module.
            reference CanTpTxNPduRef: post-build-variant-value=true, set at pre-compile in variant pre-compile / post-build in variant post-build, destination=Pdu  # Reference to a Pdu in the COM-Stack
    container CanTpGeneral  # This container contains the general configuration parameters of the CanTp module.
      boolean CanTpChangeParameterApi: set at pre-compile  # This parameter, if set to true, enables the CanTp_ChangeParameterRequest Api for this Module.
      boolean CanTpDevErrorDetect: set at pre-compile  # Switches the Default Error Tracer (Det) detection and notification ON or OFF. true: enabled (ON). false: disabled (OFF).
      boolean CanTpDynIdSupport [0..1]: multiplicity set at pre-compile, set at pre-compile, default-value=false  # Enable support for dynamic ID handling via N-PDU MetaData. Metadata is not supported so currently this parameter need not be configured.
      boolean CanTpFlexibleDataRateSupport [0..1]: set at pre-compile, default-value=true  # Enable support for CAN FD frames.
      boolean CanTpGenericConnectionSupport [0..1]: multiplicity set at pre-compile, set at pre-compile, default-value=false  # Enable support for the handling of generic connections using N-SDUs with MetaData. Requires CanTpDynIdSupport. Metadata is not supported so currently this parameter need not be configured.
      integer CanTpPaddingByte: 0..255, set at pre-compile  # Used for the initialization of unused bytes with a certain value
      integer CanTpRbBurstQsize [0..1]: 0..255, origin=RB:AR42.1.0.0:2016-10-24, set at pre-compile  # Size of the burst Queue. If this value is configured, Burst Mode gets enabled. It gives maximum possible burst simultaniously.
      boolean CanTpRbDynamicFlowControlSupport [0..1]: origin=RB:AR42.1.0.0:2016-10-24, set at pre-compile, default-value=false  # Enables Dynamic BS/STmin values in subsequent FlowControl frames. Iso Document gives possibility to have dynamic values for STMin and BS values in single Reception process. Autosar has strategy to have only fixed Values. This parameter provides a means to override the Autosar behaviour. For more details refer section 9.6.5.6 of Iso document. Note: This parameter shall be set True only after considering that corresponding Client Server communication is compatible in this respect for all the RxConnections as this parameter enables this dynamic behaviour globally.
      float CanTpRbExternalCounterSecondsPerTick [0..1]: 0..Inf, multiplicity set at pre-compile, origin=RB:AR42.1.0.0:2016-10-24, set at pre-compile  # This parameter is required if High resolution Timer (i.e. Autosar Os based or Project specific) is used. This gives number of seconds in one Tick of the used Timer. If this parameter is configured then Integrator shall provide the Call Out implementation for CanTp_GetElapsedValue. Its Signature: void CanTp_GetElapsedValue(TickType *Value, TickType *ElapsedValue). If this parameter is not configured then internal Cyclic counter based on CanTp_MainFunction period is used, in which case CallOut implementation shall not be provided by integrator.
      string CanTpRbFdSupportInfoCallback [0..1]: multiplicity set at pre-compile, origin=RB:AR42.1.0.0:2016-10-24, set at pre-compile  # When user configures this parameter CanTp gives callback using this function. With this function CanTp passes ID, Data pointer and FlexibleDataRateSupport whether enabled for relevant connection.
      boolean CanTpRbLegacySharedFcEnabled [0..1]: multiplicity set at pre-compile, origin=RB:AR42.1.0.0:2016-10-24, set at pre-compile, default-value=false  # This is vendor specific parameter. TRUE: single Flow Control Pdu frame can be shared between different connection. FALSE: single Flow Control Pdu frame cannot be shared between different connection. Note: This parameter is relevant only for sharing of FC NPDU with standard Addressing format. Limitation: Only such mechanism of sharing for FC NPDU works if one Connection is relavant for OBD and other for UDS Protocol of Dcm, and hence the disambiguation for the reception is possible due to overall PduLength difference created using padding bytes. For Extended Addressing Format relevant FC NPDU sharing is supported by usual method. This is only for legacy projects. For new Projects this is not recomended.
      boolean CanTpRbLiteSupport [0..1]: origin=RB:AR42.1.0.0:2016-10-24, set at pre-compile, default-value=false  # This parameter helps Integrator to configure CanTp in such a way to have Lite footprint. For an ISO 15765-2 Specific and Autosar compliant Implementation, this parameter shall not be configured. If this parameter is TRUE then following features are not to be configured: CanTpChangeParameterApi, CanTpReadParameterApi, CanTpVersionInfoApi. Also CanTp_TriggerTransmit and CanTp_CancelTransmit will not be supported.
      integer CanTpRbMaxRxConnectionCnt [0..1]: 1..1.84467440737095E+19, origin=RB:AR42.1.0.0:2016-10-24, set at pre-compile  # Maximum possible value of number of Rx Connection. If this value is to be updated then source code has to be recompiled. This decides number of different Stmin/Bs combination can be stored in RAM for CanTp_ChangeParameter Api. CanTpRbMaxRxConnectionCnt and CanTpRbMaxTxConnectionCnt decides the size for CanTp_ConnectionIdType.
      integer CanTpRbMaxTxConnectionCnt [0..1]: 1..1.84467440737095E+19, origin=RB:AR42.1.0.0:2016-10-24, set at pre-compile  # Maximum possible value of number of Tx Connection. If this value is to be updated then source code has to be recompiled. CanTpRbMaxTxConnectionCnt and CanTpRbMaxRxConnectionCnt decides the size for CanTp_ConnectionIdType.
      integer CanTpRbMaxTxNpduCnt [0..1]: 1..65535, origin=RB:AR42.1.0.0:2016-10-24, set at pre-compile  # Maximum possible value of number of uinque CanIf referred Pdus. If this value is to be updated then source code has to be recompiled. This value decides the maximum value for CanTpTxFcNPduConfirmationPduId or CanTpTxNPduConfirmationPduId.
      boolean CanTpRbPageConfirmation: origin=RB:AR42.1.0.0:2018-06-30, set at pre-compile  # This parameter is to be set to True if Dcm needs a trigger from lower layer to refill its buffer when Paged Buffer feature is enabled. It is set to False if Dcm has the feature to refill its buffer on its own without any trigger.
      float CanTpRbSTmin [0..1]: 0..0.127, multiplicity set at pre-compile, origin=RB:AR42.1.0.0:2016-10-24, set at pre-compile  # This vender specific paramter is to support FC deactivation. This value is used for STmin. Sets the duration of the minimum time the CanTp sender shall wait between the transmissions of two CF N-PDUs. Also if this parameter is configured, it means that CanTp will not send the FC for the FF recieved.
      boolean CanTpRbStrictBsCrTimeoutCheck [0..1]: multiplicity set at pre-compile, origin=RB:AR42.1.0.0:2016-10-24, set at pre-compile, default-value=false  # FC and CF frames are handled within event calls in CanTp_RxIndication; thus it is possible to accurately check for the current time within the CanTp_RxIndication before accepting that FC/CF frame. It is also known that this event call can also be triggered from the interrupt context and many projects may not intend to call OS functions within interrupt context. Thus, it is provided as a option to users to choose if TimeOut handling needs to be done before processing a received CF/FC frame within CanTp_RxIndication. If configured TRUE, This timeout check is done in CanTp_RxIndication also, if FALSE, the timeouts are handled only from CanTp_MainFunction. Dependency: CanTpRbExternalCounterSecondsPerTick.
      boolean CanTpRbStrictDlcCheck [0..1]: multiplicity set at pre-compile, origin=RB:AR42.1.0.0:2016-10-24, set at pre-compile, default-value=false  # If this parameter is configured TRUE, the received frames are checked strictly for the exact DLC expected in the frame. Configuring this parameter as FALSE provides some leniency in the check for received DLC, where any DLC greater than the expected length of the frame (but not greater than 8) are accepted. For behaviour according to ISO 15765-2, please configure this parameter as FALSE. NOTE: The configuration of this parameter will not have any effect if the parameter CanTpRxPaddingActivation or CanTpTxPaddingActivation are configured as CANTP_ON
      boolean CanTpRbValidationDone [0..1]: origin=RB:AR42.1.0.0:2016-10-24, set at pre-compile, with-auto=true, default-value=false  # Configuration Validation Step executed in BCT? Note: This parameter is for internal use only. Do not configure it.
      boolean CanTpReadParameterApi: set at pre-compile  # This parameter, if set to true, enables the CanTp_ReadParameterApi for this module.
      boolean CanTpVersionInfoApi: set at pre-compile  # The function CanTp_GetVersionInfo is configurable (On/Off) by this configuration parameter.
      reference CanTpRbBurstTaskRef [0..1]: multiplicity set at pre-compile, origin=RB:AR42.1.0.0:2016-10-24, set at pre-compile, destination=OsTask  # Absolute Reference to OsTask in which context the CanTp_MainFunction is called for Burst Mode. To enable Burst Mode this Reference configuration is a must. This task is activated in case of additional execution of Burstmode activity. Depending on the value of STmin (received through FC) is zero for a particular connection, the transmission will happen in Burst mode, else if the STmin is a non zero valid value, then the CFs shall be sent normally. Other modules MainFunction should not be mapped to this task. Dependency: CanTpRbBurstQsize. Note: Priority of this Task should be same as the Task in which Normal cyclic Timing Event is mapped w.r.t. CanTp_MainFunction. For more details on different type of events supported by CanTp please refer CanTp_Cfg_BSWMD.arxml generated.
