AUTOSAR XML (schema 4-2-2)
# The material contained in this specification is protected by copyright and
# other types of Intellectual Property Rights. The commercial exploitation of the
# material contained in this specification requires a license to such
# Intellectual Property Rights.
# This specification may be utilized or reproduced without any modification, in
# any form or by any means, for informational purposes only. For any other
# purpose, no part of the specification may be utilized or reproduced, in any
# form or by any means, without permission in writing from the publisher.
# licensed under the same rules as applicable to the AUTOSAR Standard.
package /AUTOSAR_Xfrm/EcucModuleDefs
  ecuc definition collection AUTOSARParameterDefinition: module=Xfrm
  module definition Xfrm [0..*]: post-build-variant-support=true, variants link-time/post-build/pre-compile
    container XfrmGeneral  # Contains the general configuration parameters of the module.
      boolean XfrmDevErrorDetect: set at pre-compile  # Switches the Default Error Tracer (Det) detection and notification ON or OFF. | * true: enabled (ON). * false: disabled (OFF).
      boolean rba_XfrmEnableAlignedBufferAccess: origin=RB, set at pre-compile  # defines wether the transformer can access the buffer in an aligned manner (e.g. read 4 bytes at once). This can be sued to optimize execution time, but the uffer allocation is handeled externally by the caller. This option should be enabled only if the caller component can guarantee that the start of the buffer is aligned! | * true: enabled (ON) - the caller guarantees that start of the buffer is aligned * false: disabled (OFF) - the Xfrm cannot rely on the caller and should only acces the buffer one byte at a time.
    container XfrmImplementationMapping [1..*]  # For each transformer (TransformationTechnology) in a transformer chain (DataTransformation) which is applied to an ISignal it is necessary to specify the BswModuleEntry which implements it. This is the container to hold these mappings.
      integer XfrmBufferSizeInBytes [0..1]: 0.., set at pre-compile, origin=RB, with-auto=true  # Size of the buffer provided to the transformer
      foreign reference XfmTransformationBswModuleEntryRef [0..1]: multiplicity set at pre-compile, set at pre-compile, destination-type=BSW-MODULE-ENTRY  # This parameter is set to obsolete and will be removed in future. Please use XfrmTransformerBswModuleEntryRef instead. Tags: atp.Status=obsolete, atp.StatusRevisionBegin=4.2.2 | Old description: Reference to the BswModuleEntry which implements the referenced transformer on the sending/calling side. This element is obsolete and will be removed in a future revision.
      foreign reference XfrmInvTransformerBswModuleEntryRef [0..1]: multiplicity set at pre-compile, set at pre-compile, destination-type=BSW-MODULE-ENTRY  # Reference to the BswModuleEntry which implements the referenced inverse transformer on the receiving/called side.
      reference rba_SysElem_XfrmTransformationTechnologyRef: origin=RB, set at pre-compile, destination=rba_SysElem_TransformationTechnology  # Reference to the TransformationTechnology in the DataTransformation. This is RB specific reference and point to the SystemElement Ecuc Values rba_SysElem_TransformationTechnology.
      foreign reference XfrmTransformationTechnologyRef: set at pre-compile, destination-type=TRANSFORMATION-TECHNOLOGY  # Reference to the TransformationTechnology in the DataTransformation of the system description for which the implementation (BswModuleEntry) shall be mapped.
      foreign reference XfrmTransformerBswModuleEntryRef [0..1]: multiplicity set at pre-compile, set at pre-compile, destination-type=BSW-MODULE-ENTRY  # Reference to the BswModuleEntry which implements the referenced transformer on the sending/calling side.
      reference rba_SysElem_XfrmVariableDataPrototypeInstanceRef [0..1]: multiplicity set at pre-compile, origin=RB, set at pre-compile, destination=rba_SysElem_VariableDataPrototype  # VS Reference to a VariableDataPrototype inside te RB SysElem EcuConf. (see XfrmVariableDataPrototypeInstanceRef)
      instance reference XfrmVariableDataPrototypeInstanceRef [0..1]: multiplicity set at pre-compile, set at pre-compile, destination-context=SW-COMPONENT-PROTOTYPE PORT-PROTOTYPE, destination-type=VARIABLE-DATA-PROTOTYPE  # Instance Reference to a VariableDataPrototype in case a dedicated transformer BswModuleEntry is required per VariableDataPrototype access.
      container XfrmDemEventParameterRefs [0..1]  # Container for the references to DemEventParameter elements which shall be invoked using the API Dem_ReportErrorStatus API in case the corresponding error occurs. The EventId is taken from the referenced DemEventParameter's DemEventId value. The standardized errors are provided in the container and can be extended by vendor specific error references.
        symbolic name reference XFRM_E_MALFORMED_MESSAGE [0..1]: multiplicity set at pre-compile, set at pre-compile, destination=DemEventParameter  # Reference to configured DEM event to report if malformed messages were received by the transformer.
      container XfrmSignal [0..1]  # Reference to the signal in the system description that transports the transformed data.
        choice container XfrmSignalChoice  # Choice whether an ISignal or an ISignalGroup shall be referenced.
          container XfrmISignalGroupRefChoice [0..1]  # Reference to the ISignalGroup in the system description that transports the transformed data.
            reference rba_SysElem_XfrmISignalGroupRef: set at pre-compile, destination=rba_SysElem_ISignalGroup  # Reference to the ISignalGroup in the RB SysElem EcuConf that transports the transformed data.
            foreign reference XfrmISignalGroupRef: set at pre-compile, destination-type=I-SIGNAL-GROUP  # Reference to the ISignalGroup in the system description that transports the transformed data.
          container XfrmISignalRefChoice [0..1]  # Reference to the ISignal in the system description that transports the transformed data.
            reference rba_SysElem_XfrmISignalRef: set at pre-compile, destination=rba_SysElem_ISignal  # Reference to the ISignal in the RB SysElem parmConf that transports the transformed data.
            foreign reference XfrmISignalRef: set at pre-compile, destination-type=I-SIGNAL  # Reference to the ISignal in the system description that transports the transformed data.
package /AUTOSAR_Xfrm/LifeCycleInfoSets
  life cycle info set AUTOSARParameterDefinition: life-cycle-info{lc-object=XfmTransformationBswModuleEntryRef, lc-state=obsolete, period-begin=ar-release-version=4.2.2}
