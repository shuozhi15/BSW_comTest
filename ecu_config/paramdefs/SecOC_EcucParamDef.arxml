AUTOSAR XML (schema 4-2-2)
package /AUTOSAR_SecOC/EcucModuleDefs
  module definition SecOC [0..1]: refined-module-def=SecOC, variants pre-compile  # Configuration of the SecOC (Secure Onboard Communication) module.
    container SecOCGeneral: multiplicity set at   # SecOC General | Container for common configuration options.
      boolean SecOCDevErrorDetect: multiplicity set at , set at pre-compile, default-value=false  # Default error tracer (Det) | Swithces the default error tracer (Det) detection and notification ON or OFF.
      boolean SecOCEnableForcedPassOverride: multiplicity set at , set at pre-compile, default-value=false  # Enable forced pass override | When this configuration option is set to TRUE then the functionality inside the function SecOC_VerifyStatusOverride to forcibly override the VerifyStatus to "Pass" is enabled.
      boolean SecOCIgnoreVerificationResult: multiplicity set at , set at pre-compile, default-value=false  # Ignore verification result | Switches the handling of verification result ON or OFF. If the switch is set to true the verification is performed but the verification result is ignored. So if the verification fails the PDU is forwarded to the PduR nevertheless and an error event is set in the Logging Module. The switch is implemented for the test phase and will be ignored in series software.
      float SecOCMainFunctionPeriodRx: 0..1, multiplicity set at , set at pre-compile, default-value=0.01  # Period of SecOC_MainFunctionRx | Specifies the period of the main function SecOC_MainFunctionRx in seconds
      float SecOCMainFunctionPeriodTx: 0..1, multiplicity set at , set at pre-compile, default-value=0.01  # Period of SecOC_MainFunctionTx | Specifies the period of the main function SecOC_MainFunctionTx in seconds
      enumeration SecOCMaxAlignScalarType: {uint8, uint16, uint32}, multiplicity set at , set at pre-compile, default-value=uint32  # SecOC maximum alignment type | The scalar type which has the maximum alignment restrictions on the given platform. This type can be e.g. uint8, uint16 or uint32.
      function name SecOCVerificationStatusCallout [0..*]: multiplicity set at pre-compile, set at pre-compile  # SecOC verification status callout | Name of the verification status callout
      boolean SecOCVersionInfoApi: multiplicity set at , set at pre-compile, default-value=true  # SecOC version Info | Switches the availability of the SecOC_GetVersionInfo ON or OFF.
      boolean SecOCRbRetryVerifyImmediately: multiplicity set at , origin=RB, set at pre-compile, default-value=false  # SecOC retry verification immediately | If this parameter is set to true, SecOC retries the verification immediately in the same main function cycle if mac verification fails (see section 9.4 in AR specification). This feature is only possible for synchronous jobs.
      enumeration SecOCRbCryptDefaultInterface: {Csm_rba_CryptoBCL, Csm_rba_CryptoHSM, None, Csm_Crypto}, multiplicity set at , origin=RB, set at pre-compile, default-value=Csm_rba_CryptoBCL  # SecOC default cryptographic interface | Selects the default cryptographic interface. It is set for all Rx and Tx pdus if the mac calculation is done via the cryptographic library (value Csm_rba_CryptoBCL) or via hardware security module (value Csm_rba_CryptoHSM). If value 'None' is selected no cryptographic interface is called. Nevertheless the PDUs are forwarded to the PduR for further routing. This configuration can be overwritten for each pdu in the pdu configuration containers.
      enumeration SecOCRbCryptDefaultMode: {asynchronous, synchronous}, multiplicity set at , origin=RB, set at pre-compile, default-value=synchronous  # SecOC cryptographic mode | SecOC can call the cryptographic services synchronous or asynchronous. Both are done in the cyclic main functions but in case of asynchronous mode the result is received via callbacks. AR defines the asynchronous mode. This configuration is set for all Rx and Tx PDUs but it can be overwritten for each pdu in the pdu configuration containers.
    container SecOCSameBufferPduCollection [0..*]: multiplicity set at post-build  # SecOC Buffer configuration that may be used by a collection of Pdus.
      integer SecOCBufferLength: 0..4294967295, multiplicity set at , set at pre-compile, default-value=0  # Buffer length | This parameter defines the length of the buffer for Pdu collection in bytes.
    container SecOCRxPduProcessing [0..*]: multiplicity set at post-build  # SecOC configuration of received PDUs to be verified
      integer SecOCAuthenticationBuildAttempts [0..1]: 0..65535, multiplicity set at pre-compile, set at pre-compile, default-value=0  # SecOC number of authentication build attempts | This parameter specifies the number of authentication build attempts.
      integer SecOCAuthenticationVerifyAttempts [0..1]: 0..65535, multiplicity set at pre-compile, set at pre-compile, default-value=0  # SecOC number of verification attempts | This parameter specifies the number of authentication verify attempts that are to be carried out when the verification of the authentication information failed for a given Secured I_PDU. If zero is set then only one authentication verification attempt is done.
      integer SecOCAuthInfoTxLength: 1..65535, multiplicity set at , set at pre-compile, default-value=4  # SecOC authenticator length | This parameter defines the length in bits of the authentication code to be included in the payload of the Secured I-PDU.
      integer SecOCDataId: 0..65535, multiplicity set at , set at pre-compile  # SecOC data identifier | This parameter defines a unique numerical identifier for the Secured I-PDU.
      integer SecOCFreshnessValueId: 0..65535, multiplicity set at , set at pre-compile  # SecOC freshness value id | This parameter specifies the local freshness identifier used to generate the freshness value used to generate or verify a MAC.
      integer SecOCFreshnessValueLength: 0..64, multiplicity set at , set at pre-compile, default-value=0  # SecOC freshness value length | This parameter defines the length in bits of the Freshness Value.
      integer SecOCFreshnessValueTxLength: 0..64, multiplicity set at , set at pre-compile, default-value=0  # SecOC freshness value payload length | This parameter defines the length in bits of the Freshness Value to be included in the payload of the Secured I-PDU. This length is specific to the least significant bits of the complete Freshness Counter. If the parameter is 0 no Fresh-ness Value is included in the Secured I-PDU.
      enumeration SecOCVerificationStatusPropagationMode: {BOTH, FAILURE_ONLY, NONE}, multiplicity set at , set at pre-compile  # SecOC verification status propagation mode | This parameter is used to describe the propagation of the status of each verification attempt from SecOC module to SWCs.
      enumeration SecOCRbRxPduCryptIF [0..1]: {Csm_rba_CryptoBCL, Csm_rba_CryptoHSM, None, Csm_Crypto}, multiplicity set at pre-compile, origin=RB, set at pre-compile  # SecOC cryptographic interface | Selects the default cryptographic interface. It is set if the mac calculation is done via the cryptographic library (value Csm_rba_CryptoBCL) or via hardware security module (value Csm_rba_CryptoHSM). If value 'None' is selected no cryptographic interface is called. Nevertheless the PDUs are forwarded to the PduR for further routing. This pdu specific configuration overwrites the global setting in container SecOCGeneral.
      enumeration SecOCRbRxCryptMode [0..1]: {asynchronous, synchronous}, multiplicity set at pre-compile, origin=RB, set at pre-compile  # SecOC cryptographic mode | SecOC can call the cryptographic services synchronous or asynchronous. Both are done in the cyclic main functions but in case of asynchronous mode the result is received via callbacks. AR defines the asynchronous mode. This pdu specific configuration overwrites the global setting in container SecOCGeneral.
      reference SecOCRxAuthServiceConfigRef [0..1]: multiplicity set at pre-compile, set at pre-compile, destination=CsmJob  # Reference to Csm Job | This reference is used to define which crypto service function is called for authentication.
      reference SecOCSameBufferPduRef [0..1]: multiplicity set at pre-compile, set at pre-compile, destination=SecOCSameBufferPduCollection  # Reference to Buffer collection | This reference is used to collect Pdus that are using the same SecOC buffer.
      container SecOCRxSecuredPduLayer: multiplicity set at   # SecOC configuration of received PDU from PduR
        integer SecOCRxSecuredLayerPduId: 0..65535, multiplicity set at , set at pre-compile, symbolic-name-value=true  # SecOC identifier of secured PDU | PDU identifier assigned by SecOC module. Used by PduR for SecOC_PduRRxIndication.
        reference SecOCRxSecuredLayerPduRef [0..1]: multiplicity set at pre-compile, set at pre-compile, destination=Pdu  # Reference to secured PDU | Reference to the global Pdu.
      container SecOCRxAuthenticPduLayer: multiplicity set at   # SecOC configuration of authentic PDU
        reference SecOCRxAuthenticLayerPduRef [0..1]: multiplicity set at pre-compile, set at pre-compile, destination=Pdu  # Reference to authentic PDU | Reference to the global Pdu.
    container SecOCTxPduProcessing [0..*]: multiplicity set at post-build  # SecOC configuration of transmitted PDUs to be secured
      integer SecOCAuthenticationBuildAttempts [0..1]: 0..65535, multiplicity set at pre-compile, set at pre-compile, default-value=0  # SecOC number of authentication build attempts | This parameter specifies the number of authentication build attempts.
      integer SecOCAuthInfoTxLength: 1..65535, multiplicity set at , set at pre-compile, default-value=4  # SecOC authentication length | This parameter defines the length in bits of the authentication code to be included in the payload of the Secured I-PDU.
      integer SecOCDataId: 0..65535, multiplicity set at , set at pre-compile  # SecOC data identifier | This parameter defines a unique numerical identifier for the Secured I-PDU.
      integer SecOCFreshnessValueId: 0..65535, multiplicity set at , set at pre-compile  # SecOC freshness value id | This parameter specifies the local freshness identifier used to generate the freshness value used to generate or verify a MAC.
      integer SecOCFreshnessValueLength: 0..64, multiplicity set at , set at pre-compile, default-value=0  # SecOC freshness value length | This parameter defines the length in bits of the Freshness Value.
      integer SecOCFreshnessValueTxLength: 0..64, multiplicity set at , set at pre-compile, default-value=0  # SecOC freshness value payload length | This parameter defines the length in bits of the Freshness Value to be included in the payload of the Secured I-PDU. This length is specific to the least significant bits of the complete Freshness Counter. If the parameter is 0 no Fresh-ness Value is included in the Secured I-PDU.
      boolean SecOCRbClearBufferAfterTransmit [0..1]: multiplicity set at pre-compile, origin=RB, set at pre-compile, default-value=false  # SecOCRB Clear buffers after transmit | If this parameter is set to true, SecOC doesn't wait for TxConfirmation to clear the buffers and instead clears the buffers and resets the PDU state to idle directly after passing the secured PDU to the PduR.
      enumeration SecOCRbTxPduCryptIF [0..1]: {Csm_rba_CryptoBCL, Csm_rba_CryptoHSM, None, Csm_Crypto}, multiplicity set at pre-compile, origin=RB, set at pre-compile  # SecOC cryptographic interface | Selects the default cryptographic interface. It is set if the mac calculation is done via the cryptographic library (value Csm_rba_CryptoBCL) or via hardware security module (value Csm_rba_CryptoHSM). If value 'None' is selected no cryptographic interface is called. Nevertheless the PDUs are forwarded to the PduR for further routing. This pdu specific configuration overwrites the global setting in container SecOCGeneral.
      enumeration SecOCRbTxCryptMode [0..1]: {asynchronous, synchronous}, multiplicity set at pre-compile, origin=RB, set at pre-compile  # SecOC cryptographic mode | SecOC can call the cryptographic services synchronous or asynchronous. Both are done in the cyclic main functions but in case of asynchronous mode the result is received via callbacks. AR defines the asynchronous mode. This pdu specific configuration overwrites the global setting in container SecOCGeneral.
      reference SecOCSameBufferPduRef [0..1]: multiplicity set at pre-compile, set at pre-compile, destination=SecOCSameBufferPduCollection  # Reference to Buffer collection | This reference is used to collect Pdus that are using the same SecOC buffer.
      reference SecOCTxAuthServiceConfigRef [0..1]: multiplicity set at pre-compile, set at pre-compile, destination=CsmJob  # Reference to Csm Job | This reference is used to define which crypto service function is called for authentication.
      container SecOCTxAuthenticPduLayer: multiplicity set at   # SecOC configuration of authentic PDU
        integer SecOCTxAuthenticLayerPduId: 0..65535, multiplicity set at , set at pre-compile, symbolic-name-value=true  # SecOC identifier of authentic PDU | PDU identifier assigned by SecOC module. Used by PduR for SecOC_PduRTransmit.
        reference SecOCTxAuthenticLayerPduRef [0..1]: multiplicity set at pre-compile, set at pre-compile, destination=Pdu  # Reference to authentic PDU | Reference to the global Pdu.
      container SecOCTxSecuredPduLayer: multiplicity set at   # SecOC configuration of transmitted PDU to PduR
        integer SecOCTxSecuredLayerPduId: 0..65535, multiplicity set at , set at pre-compile, symbolic-name-value=true  # SecOC identifier of secured PDU | PDU identifier assigned by SecOC module. Used by PduR for confirmation (SecOC_PduRTxConfirmation) and for TriggerTransmit.
        reference SecOCTxSecuredLayerPduRef [0..1]: multiplicity set at pre-compile, set at pre-compile, destination=Pdu  # Reference to secured PDU | Reference to the global Pdu.
