AUTOSAR XML (schema 4-2-2)
package /AUTOSAR_Crypto/EcucModuleDefs
  module definition Crypto [0..*]: refined-module-def=Crypto, variants pre-compile  # Configuration of the Crypto (CryptoDriver) module
    container CryptoDriverObjects: multiplicity set at   # Container for CRYPTO Objects
      container CryptoDriverObject [0..*]: multiplicity set at post-build  # Configuration of a CryptoDriverObject
        integer CryptoDriverObjectId [0..1]: 0..4294967295, multiplicity set at pre-compile, set at pre-compile, symbolic-name-value=true  # Identifier of the Crypto Driver Object. The Crypto Driver Object offers different crypto primitives.
        integer CryptoQueueSize: 0..4294967295, multiplicity set at , set at pre-compile  # Size of the queue in the Crypto Driver. Defines the maximum number of jobs in the Crypto Driver Object queue. If it is set to 0, queueing is disabled in the Crypto Driver Object.
        reference CryptoPrimitiveRef: multiplicity set at , set at pre-compile, destination=CryptoPrimitive  # Refers to primitive in the CRYPTO.
    container CryptoGeneral: multiplicity set at   # Container for common configuration options
      integer CryptoRbNvmDeviceId [0..1]: 0..1, multiplicity set at pre-compile, origin=RB, set at pre-compile  # Identification of the device where the NVRAM block is located.
      boolean CryptoRbBclPreCalculateK1_K2 [0..1]: multiplicity set at pre-compile, origin=RB, set at pre-compile, default-value=false  # True: Enable the precalculation of K1 and K2 for CMAC generation. This option results in a faster generation but safety is threatened because the keys are stored within global variables and will not be cleared. False: Disable the precalculation of K1 and K2 for CMAC generation. The keys are calculated for each CMAC generation and are cleared when CMAC generation was completed (safety is enhanced = default).
      boolean CryptoRbReturnInvalidStatusOnGet [0..1]: multiplicity set at pre-compile, origin=RB, set at pre-compile, default-value=true  # True: Csm_KeyElementGet returns E_NOT_OK when the element containing key status is invalid. False: Csm_KeyElementGet return value is independent from the key valid status.
      boolean CryptoRbHsmOutputBuffering [0..1]: multiplicity set at pre-compile, origin=RB, set at pre-compile, default-value=true  # True: Cryptodriver creates extra output buffers (for the results written by the HSM module) as a safety separation in case of HSM driver library cannot access the ouput memory area provided by Cryptostack. False: HSM Output extra buffers will not be created (in case of HSM can access the output memory areas provided by the Cryptostack).
      integer CryptoRbHsmTimeout [0..1]: 1..4294967295, multiplicity set at pre-compile, origin=RB, set at pre-compile  # Maximum timeout for the HSM in ms.
      boolean CryptoRbKeyExchangeApi: multiplicity set at , origin=RB, set at pre-compile  # Pre-processor switch to enable and disable availability of the API Crypto_KeyExchangeCalcPubVal() and Crypto_KeyExchangeCalcSecret().
      boolean CryptoDevErrorDetect: multiplicity set at , set at pre-compile  # Switches the development error detection and notification on or off.
      float CryptoMainFunctionPeriod [0..1]: multiplicity set at pre-compile, set at pre-compile  # Specifies the period of main function Crypto_MainFunction in seconds.
      boolean CryptoVersionInfoApi: multiplicity set at , set at pre-compile  # Pre-processor switch to enable and disable availability of the API Crypto_GetVersionInfo().
      enumeration CryptoRbNvmBlockReadMode [0..1]: {READ_ALL, SINGLE_BLOCK}, multiplicity set at pre-compile, origin=RB, set at pre-compile, default-value=SINGLE_BLOCK  # Specifies the NvM block read request type: READ_ALL : NvM block registered for Read All operation. Read All must be called before the Crypto Init function. SINGLE_BLOCK: Crypto requests a single block read internal in its Init function.
      boolean CryptoRbWaitForNvMRead [0..1]: multiplicity set at pre-compile, origin=RB, set at pre-compile, default-value=true  # True: In Crypto Init wait for NvM Read to be completed for required NvM block. (Calls Memstack Mainfunctions intern). False: Cyclically check NvM Read status in Crypto Mainfunction if read not already finished before Crypto Init.
      integer CryptoRbBclSignatureLoopCounter [0..1]: 1..4294967295, multiplicity set at pre-compile, origin=RB, set at pre-compile  # Holds the number of iterations to be performed internally by the signature primitive (update). This parameter can be used to increase or reduce the runtime of a single signature (update) call.
      integer CryptoRbBclKeyExchangeLoopCounter [0..1]: 1..4294967295, multiplicity set at pre-compile, origin=RB, set at pre-compile, default-value=4294967295  # Holds the number of iterations to be performed internally by the key exchange primitive. This parameter can be used to increase or reduce the runtime of a single key exchange call.
      boolean CryptoRbHsmInitializeKeyElements [0..1]: multiplicity set at pre-compile, origin=RB, set at pre-compile, default-value=true  # True: Enable the initialization of HSM key elements with configured initialization data on startup and if the persistent storage was never used before by the HSM. False: Disable the initialization of HSM key elements on startup (True = default).
      integer CryptoRbMainFunctionLoopCounter [0..1]: 1..4294967295, multiplicity set at pre-compile, origin=RB, set at pre-compile, default-value=1  # Holds the number of iterations to be performed internally by the main function. This parameter can be used to increase or reduce the runtime of a single main function call.
      enumeration CryptoRbHsmMainFunctionMacMode [0..1]: {NON_BLOCKING, BLOCKING}, multiplicity set at pre-compile, origin=RB, set at pre-compile, default-value=NON_BLOCKING  # Determines whether the MainTask should wait for the HSM mac generation/verification until the corresponding process is finished (BLOCKING) or whether only the status should be queried without waiting (NON_BLOCKING). In combination with the parameter CryptoRbMainFunctionLoopCounter, the wait mode can be used to process several jobs directly one after the other and thus reduce the waiting time until all asynchronous jobs have been processed. The BLOCKING mode is also required whenever several queues are used within the Cryptostack for the mac generation/verification, since the HSM cannot process jobs in parallel.
      enumeration CryptoRbHsmMainFunctionCipherMode [0..1]: {NON_BLOCKING, BLOCKING}, multiplicity set at pre-compile, origin=RB, set at pre-compile, default-value=NON_BLOCKING  # Determines whether the MainTask should wait for the HSM cipher encryption/decryption until the corresponding process is finished (BLOCKING) or whether only the status should be queried without waiting (NON_BLOCKING). In combination with the parameter CryptoRbMainFunctionLoopCounter, the wait mode can be used to process several jobs directly one after the other and thus reduce the waiting time until all asynchronous jobs have been processed. The BLOCKING mode is also required whenever several queues are used within the Cryptostack for the cipher encryption/decryption, since the HSM cannot process jobs in parallel.
      enumeration CryptoRbHsmMainFunctionHashMode [0..1]: {NON_BLOCKING, BLOCKING}, multiplicity set at pre-compile, origin=RB, set at pre-compile, default-value=NON_BLOCKING  # Determines whether the MainTask should wait for the HSM hash generation until the corresponding process is finished (BLOCKING) or whether only the status should be queried without waiting (NON_BLOCKING). In combination with the parameter CryptoRbMainFunctionLoopCounter, the wait mode can be used to process several jobs directly one after the other and thus reduce the waiting time until all asynchronous jobs have been processed. The BLOCKING mode is also required whenever several queues are used within the Cryptostack for the hash generation, since the HSM cannot process jobs in parallel.
      enumeration CryptoRbHsmMainFunctionSignatureMode [0..1]: {NON_BLOCKING, BLOCKING}, multiplicity set at pre-compile, origin=RB, set at pre-compile, default-value=NON_BLOCKING  # Determines whether the MainTask should wait for the HSM signature generation/verification until the corresponding process is finished (BLOCKING) or whether only the status should be queried without waiting (NON_BLOCKING). In combination with the parameter CryptoRbMainFunctionLoopCounter, the wait mode can be used to process several jobs directly one after the other and thus reduce the waiting time until all asynchronous jobs have been processed. The BLOCKING mode is also required whenever several queues are used within the Cryptostack for the signature generation/verification, since the HSM cannot process jobs in parallel.
      enumeration CryptoRbHsmMainFunctionRandomMode [0..1]: {NON_BLOCKING, BLOCKING}, multiplicity set at pre-compile, origin=RB, set at pre-compile, default-value=NON_BLOCKING  # Determines whether the MainTask should wait for the HSM random generation until the corresponding process is finished (BLOCKING) or whether only the status should be queried without waiting (NON_BLOCKING). In combination with the parameter CryptoRbMainFunctionLoopCounter, the wait mode can be used to process several jobs directly one after the other and thus reduce the waiting time until all asynchronous jobs have been processed. The BLOCKING mode is also required whenever several queues are used within the Cryptostack for the random generation, since the HSM cannot process jobs in parallel.
      enumeration CryptoRbHsmMainFunctionRandomSeedMode [0..1]: {NON_BLOCKING, BLOCKING}, multiplicity set at pre-compile, origin=RB, set at pre-compile, default-value=NON_BLOCKING  # Determines whether the MainTask should wait for the HSM random seed operation until the corresponding process is finished (BLOCKING) or whether only the status should be queried without waiting (NON_BLOCKING). In combination with the parameter CryptoRbMainFunctionLoopCounter, the wait mode can be used to process several jobs directly one after the other and thus reduce the waiting time until all asynchronous jobs have been processed. The BLOCKING mode is also required whenever several queues are used within the Cryptostack for the random seed operation, since the HSM cannot process jobs in parallel.
      enumeration CryptoRbHsmMainFunctionKeyExchangeMode [0..1]: {NON_BLOCKING, BLOCKING}, multiplicity set at pre-compile, origin=RB, set at pre-compile, default-value=NON_BLOCKING  # Determines whether the MainTask should wait for the HSM key exchange operation until the corresponding process is finished (BLOCKING) or whether only the status should be queried without waiting (NON_BLOCKING). In combination with the parameter CryptoRbMainFunctionLoopCounter, the wait mode can be used to process several jobs directly one after the other and thus reduce the waiting time until all asynchronous jobs have been processed. The BLOCKING mode is also required whenever several queues are used within the Cryptostack for the key exchange opeartion, since the HSM cannot process jobs in parallel.
    container CryptoKeyElements [0..1]: multiplicity set at post-build  # Container for Crypto key elements
      container CryptoKeyElement [1..*]: multiplicity set at post-build  # Configuration of a CryptoKeyElement
        boolean CryptoKeyElementAllowPartialAccess: multiplicity set at , set at pre-compile  # Enable or disable writing and reading the key element with data smaller than the size of the element.
        integer CryptoKeyElementId: 0..4294967295, multiplicity set at , set at pre-compile, symbolic-name-value=true  # Identifier of the CRYPTO key element
        string CryptoKeyElementInitValue [0..1]: multiplicity set at pre-compile, set at pre-compile  # Value which will be used to fill the element during initialisation, when the element is not already initialized.
        boolean CryptoKeyElementPersist: multiplicity set at , set at pre-compile  # Enable or disable persisting of the key element in non-volatile storage.
        enumeration CryptoKeyElementReadAccess: {CRYPTO_RA_ALLOWED, CRYPTO_RA_DENIED, CRYPTO_RA_ENCRYPTED, CRYPTO_RA_INTERNAL_COPY}, multiplicity set at , set at pre-compile  # Define the reading access rights of the key element.
        integer CryptoKeyElementSize: 1..4294967295, multiplicity set at , set at pre-compile  # Maximum Size size of a CRYPTO key element in bytes
        enumeration CryptoKeyElementWriteAccess: {CRYPTO_WA_ALLOWED, CRYPTO_WA_DENIED, CRYPTO_WA_ENCRYPTED, CRYPTO_WA_INTERNAL_COPY}, multiplicity set at , set at pre-compile  # Define the writing access rights of the key element
        enumeration CryptoRbKeyElementType [0..1]: {RBA_CRYPTO_ELEMENT_TYPE_DEFAULT, RBA_CRYPTO_ELEMENT_TYPE_SIGGEN, RBA_CRYPTO_ELEMENT_TYPE_SIGVER}, multiplicity set at pre-compile, origin=RB, set at pre-compile  # Define the type of a key element. This parameter is optional and can be used to overrule the process to discover the type automatically.RBA_CRYPTO_ELEMENT_TYPE_DEFAULT: default type (16 byte)RBA_CRYPTO_ELEMENT_TYPE_SIGGEN: element to be used for signature generation (32 byte)RBA_CRYPTO_ELEMENT_TYPE_SIGVER: element to be used for signature verification (32 byte)
        reference CryptoKeyElementVirtualTargetRef [0..*]: multiplicity set at pre-compile, post-build-variant-value=true, set at pre-compile, destination=CryptoKeyElement  # Refers to a key element which will contain the actual data. If the Reference is configured, the key element will be a virtual key element.
    container CryptoKeyTypes [0..1]: multiplicity set at pre-compile  # Container for CRYPTO key types
      container CryptoKeyType [1..*]: multiplicity set at post-build  # Configuration of a CryptoKeyType
        reference CryptoKeyElementRef [1..*]: multiplicity set at pre-compile, set at pre-compile, destination=CryptoKeyElement  # Refers to a pointer in the CRYPTOCrypto Key Element, which holds the data of the crypto key element.
    container CryptoKeys [0..1]: multiplicity set at post-build  # Container for CRYPTO keys
      container CryptoKey [1..*]: multiplicity set at pre-compile  # Configuration of a CryptoKey
        integer CryptoKeyDeriveIterations: 1..4294967295, multiplicity set at , set at pre-compile  # Holds the number of iterations to be performed by the key derivation primitive
        integer CryptoKeyId [0..1]: 0..4294967295, multiplicity set at pre-compile, set at pre-compile, symbolic-name-value=true  # Identifier of the CRYPTO Key
        reference CryptoKeyTypeRef: multiplicity set at , set at pre-compile, destination=CryptoKeyType  # Refers to a pointer in the CRYPTOto a CryptoKeyType. The CryptoKeyType provides the information which key elements are contained in a CryptoKey.
    container CryptoPrimitives [0..*]: multiplicity set at pre-compile  # Container for CRYPTO primitives
      container CryptoPrimitive [0..*]: multiplicity set at pre-compile  # Configuration of a CryptoPrimitive
        enumeration CryptoPrimitiveAlgorithmFamiliy [1..*]: {CRYPTO_ALGOFAM_3DES, CRYPTO_ALGOFAM_AES, CRYPTO_ALGOFAM_BLAKE_1_256, CRYPTO_ALGOFAM_BLAKE_1_512, CRYPTO_ALGOFAM_BLAKE_2s_256, CRYPTO_ALGOFAM_BLAKE_2s_512, CRYPTO_ALGOFAM_BRAINPOOL, CRYPTO_ALGOFAM_CHACHA, CRYPTO_ALGOFAM_CUSTOM, CRYPTO_ALGOFAM_ECCNIST, CRYPTO_ALGOFAM_ECIES, CRYPTO_ALGOFAM_ED25519, CRYPTO_ALGOFAM_NOT_SET, CRYPTO_ALGOFAM_RIPEMD160, CRYPTO_ALGOFAM_RNG, CRYPTO_ALGOFAM_RSA, CRYPTO_ALGOFAM_SECURECOUNTER, CRYPTO_ALGOFAM_SHA1, CRYPTO_ALGOFAM_SHA2_224, CRYPTO_ALGOFAM_SHA2_256, CRYPTO_ALGOFAM_SHA2_384, CRYPTO_ALGOFAM_SHA2_512, CRYPTO_ALGOFAM_SHA2_512_224, CRYPTO_ALGOFAM_SHA2_512_256, CRYPTO_ALGOFAM_SHA3_224, CRYPTO_ALGOFAM_SHA3_256, CRYPTO_ALGOFAM_SHA3_384, CRYPTO_ALGOFAM_SHA3_512, CRYPTO_ALGOFAM_SHAKE128, CRYPTO_ALGOFAM_SHAKE256, CRYPTO_ALGOFAM_SIPHASH, CRYPTO_ALGOFAM_DH}, multiplicity set at pre-compile, set at pre-compile  # Determines the algorithm family used for the crypto service
        enumeration CryptoPrimitiveAlgorithmMode [1..*]: {CRYPTO_ALGOMODE_12ROUNDS, CRYPTO_ALGOMODE_20ROUNDS, CRYPTO_ALGOMODE_8ROUNDS, CRYPTO_ALGOMODE_CBC, CRYPTO_ALGOMODE_CBC_NIST_SP800_38A, CRYPTO_ALGOMODE_CBC_NONE, CRYPTO_ALGOMODE_CBC_PKCS7_v1_5, CRYPTO_ALGOMODE_CFB, CRYPTO_ALGOMODE_CMAC, CRYPTO_ALGOMODE_CTR, CRYPTO_ALGOMODE_CTRDRBG, CRYPTO_ALGOMODE_CUSTOM, CRYPTO_ALGOMODE_ECB, CRYPTO_ALGOMODE_GCM, CRYPTO_ALGOMODE_GMAC, CRYPTO_ALGOMODE_HMAC, CRYPTO_ALGOMODE_NOT_SET, CRYPTO_ALGOMODE_OFB, CRYPTO_ALGOMODE_RSAES_OAEP, CRYPTO_ALGOMODE_RSAES_PKCS1_v1_5, CRYPTO_ALGOMODE_RSASSA_PKCS1_v1_5, CRYPTO_ALGOMODE_RSASSA_PSS, CRYPTO_ALGOMODE_XTS}, multiplicity set at pre-compile, set at pre-compile  # Determines the algorithm mode used for the crypto service
        enumeration CryptoPrimitiveAlgorithmSecondaryFamiliy [1..*]: {CRYPTO_ALGOFAM_3DES, CRYPTO_ALGOFAM_AES, CRYPTO_ALGOFAM_BLAKE_1_256, CRYPTO_ALGOFAM_BLAKE_1_512, CRYPTO_ALGOFAM_BLAKE_2s_256, CRYPTO_ALGOFAM_BLAKE_2s_512, CRYPTO_ALGOFAM_BRAINPOOL, CRYPTO_ALGOFAM_CHACHA, CRYPTO_ALGOFAM_CUSTOM, CRYPTO_ALGOFAM_ECCNIST, CRYPTO_ALGOFAM_ECIES, CRYPTO_ALGOFAM_ED25519, CRYPTO_ALGOFAM_NOT_SET, CRYPTO_ALGOFAM_RIPEMD160, CRYPTO_ALGOFAM_RNG, CRYPTO_ALGOFAM_RSA, CRYPTO_ALGOFAM_SECURECOUNTER, CRYPTO_ALGOFAM_SHA1, CRYPTO_ALGOFAM_SHA2_224, CRYPTO_ALGOFAM_SHA2_256, CRYPTO_ALGOFAM_SHA2_384, CRYPTO_ALGOFAM_SHA2_512, CRYPTO_ALGOFAM_SHA2_512_224, CRYPTO_ALGOFAM_SHA2_512_256, CRYPTO_ALGOFAM_SHA3_224, CRYPTO_ALGOFAM_SHA3_256, CRYPTO_ALGOFAM_SHA3_384, CRYPTO_ALGOFAM_SHA3_512, CRYPTO_ALGOFAM_SHAKE128, CRYPTO_ALGOFAM_SHAKE256, CRYPTO_ALGOFAM_SIPHASH}, multiplicity set at pre-compile, set at pre-compile  # Determines the algorithm secondary family used for the crypto service
        enumeration CryptoPrimitiveService: {AEAD_DECRYPT, AEAD_ENCRYPT, DECRYPT, ENCRYPT, HASH, MAC_GENERATE, MAC_VERIFY, RANDOM, RANDOMSEED, SIGNATURE_GENERATE, SIGNATURE_VERIFY, KEYEXCHANGECALCPUBVAL, KEYEXCHANGECALCSECRET, SECURECOUNTER}, multiplicity set at , set at pre-compile  # Determines the crypto service used for defining the capabilities
