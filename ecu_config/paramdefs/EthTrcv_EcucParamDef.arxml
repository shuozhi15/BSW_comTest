AUTOSAR XML (schema 4-2-2)
package /AUTOSAR_EthTrcv/EcucModuleDefs
  module definition EthTrcv [0..*]: category=VENDOR_SPECIFIC_MODULE_DEFINITION, refined-module-def=EthTrcv, variants pre-compile  # Configuration of Ethernet Transceiver Driver module
    container EthTrcvConfigSet  # This container contains the configuration parameters and sub containers of the AUTOSAR EthTrcv module.
      container EthTrcvConfig [1..*]  # Configuration of the individual transceiver
        boolean EthTrcvAutoNegotiationEnabled: post-build-variant-value=true, set at link in variant link-time / post-build in variant post-build / pre-compile in variant pre-compile  # Specifies if Auto-Negotiation is enabled (TRUE) or disabled (FALSE) for determination of the Ethernet transceiver speed.
        enumeration EthTrcvConnNeg: {TRCV_CONN_NEG_AUTO, TRCV_CONN_NEG_MASTER, TRCV_CONN_NEG_SLAVE}, post-build-variant-value=true, set at link in variant link-time / post-build in variant post-build / pre-compile in variant pre-compile  # Specifies the connection negotiation of the Ethernet transceiver link.
        integer EthTrcvCtrlIdx: 0..255, post-build-variant-value=true, set at link in variant link-time / post-build in variant post-build / pre-compile in variant pre-compile  # Specifies the controller used for MII access to the transceiver
        enumeration EthTrcvDriverMiiApi: {ETHTRCV_DRIVER_SUPPORT_ASYNC_MIICOMMUNICATION, ETHTRCV_DRIVER_SUPPORT_NO_ASYNC_MIICOMMUNICATION, ETHTRCV_DRIVER_SUPPORT_OAWAPI_TO_PROVIDE_MII_FUNCTIONALITY}, origin=RB, post-build-variant-value=true, set at link in variant link-time / post-build in variant post-build / pre-compile in variant pre-compile, default-value=ETHTRCV_DRIVER_SUPPORT_OAWAPI_TO_PROVIDE_MII_FUNCTIONALITY  # The communication from EthTrcv to Phy-hardware is managed by Mac (controller) hardware and SW. The SW-API is defined by Autosar by Eth_ReadMii and Eth_WriteMii. To avoid blocking of micro-controller during Mii-(MDio)-communication this API is defined to be asynchron. But some controllers does not support interrupts (by Mac- hardware) when a Mii(Mdio) word is written/received. These SW-controllers-drivers may not support asynchron communication. With this (EthTrcvDriverMiiAPI) configuration parameter it is possible to define the capability of Eth-Driver: ETHTRCV_DRIVER_SUPPORT_OAWAPI_TO_PROVIDE_MII_FUNCTIONALITY is the default configuraion parameter. It is defined at RB that each Eth-controller-driver shall provides its capability to communicate async or sync by OAW-API: String Eth_Aspect_MiiBehaviour(). EthTrcv uses this OAW-API so configurator does not need to know the features of the EthDriver. If there is an error at validation in EthTrcv, Eth-driver is not RB conform and then configurator needs to know the capability of Eth-driver and should configure other parameters here (EthTrcvDriverMiiApi). ETHTRCV_DRIVER_SUPPORT_ASYNC_MIICOMMUNICATION: Driver supports async communication and calls EthTrcv_ReadMiiIndication or EthTrcv WriteMiiIndication function after each Eth_ReadMii and Eth_WriteMii. ETHTRCV_DRIVER_SUPPORT_NO_ASYNC_MIICOMMUNICATION: Driver does not support async communication and is not allowed to call EthTrcv_ReadMiiIndication nor EthTrcv WriteMiiIndication.
        enumeration EthTrcvDuplexMode: {ETHTRCV_DUPLEX_MODE_FULL, ETHTRCV_DUPLEX_MODE_HALF}, post-build-variant-value=true, set at link in variant link-time / post-build in variant post-build / pre-compile in variant pre-compile  # Specifies the duplex mode of the Ethernet transceiver link if Auto-Negotiation is disabled. This parameter is ignored if Auto-Negotiation is enabled.
        enumeration EthTrcvPortMacLayerType [0..1]: {TRCV_MAC_LAYER_TYPE_MII, TRCV_MAC_LAYER_TYPE_RMII, TRCV_MAC_LAYER_TYPE_RevMII, TRCV_MAC_LAYER_TYPE_GMII, TRCV_MAC_LAYER_TYPE_RGMII, TRCV_MAC_LAYER_TYPE_RGMII_DELAY, TRCV_MAC_LAYER_TYPE_SGMII}, scope=ECU, multiplicity set at link in variant link-time / post-build in variant post-build / pre-compile in variant pre-compile, post-build-variant-multiplicity=true, post-build-variant-value=true, set at link in variant link-time / post-build in variant post-build / pre-compile in variant pre-compile  # Defines the MAC layer type of the ethernet transceiver.
        integer EthTrcvIdx: 0..255, scope=ECU, set at pre-compile, symbolic-name-value=true  # Specifies the instance ID of the configured transceiver.
        integer EthTrcvMiiIdx: 0..255, post-build-variant-value=true, set at link in variant link-time / post-build in variant post-build / pre-compile in variant pre-compile  # Specifies the transceiver index used for MII access to the transceiver
        enumeration EthTrcvPhysLayerType [0..1]: {TRCV_PHYS_LAYER_TYPE_BASE_T, TRCV_PHYS_LAYER_TYPE_BROADR_REACH}, multiplicity set at link in variant link-time / post-build in variant post-build / pre-compile in variant pre-compile, post-build-variant-multiplicity=true, post-build-variant-value=true, set at link in variant link-time / post-build in variant post-build / pre-compile in variant pre-compile  # Specifies the physical layer type of the Ethernet transceiver link.
        enumeration EthTrcvSpeed: {TRCV_SPEED_10, TRCV_SPEED_100, TRCV_SPEED_1000}, post-build-variant-value=true, set at link in variant link-time / post-build in variant post-build / pre-compile in variant pre-compile  # Specifies the speed of the Ethernet transceiver link in [MBit/s]. If AutoNegotiation is enabled this is the maximum speed advertised for Auto-Negotiation.
        function name EthTrcvWakeUpCallout [0..1]: multiplicity set at pre-compile, set at pre-compile  # Configuration of the call-out name.
        symbolic name reference EthTrcvIcuChannelRef [0..1]: multiplicity set at pre-compile, set at pre-compile, destination=IcuChannel  # Reference to the IcuChannel to enable/disable the interrupts for wakeups.
        container EthTrcvDemEventParameterRefs [0..1]  # Container for the references to DemEventParameter elements which shall be invoked using the API Dem_ReportErrorStatus API in case the corresponding error occurs. The EventId is taken from the referenced DemEventParameter's DemEventId value. The standardized errors are provided in the container and can be extended by vendor specific error references.
          enumeration EthTrcvRbDynCreate_ETHTRCV_E_ACCESS [0..1]: {Disabled, Standard}, origin=RB, set at pre-compile, default-value=Disabled  # Dynamically create DemEvent | Selects the way how the example DemEvent is created. If not set or set to &quot;Disabled&quot;, no such DemEvent is automatically created. If the dynamic creation of this DemEvent is enabled, the reference to this DemEvent (in parameter rba_Example_DemEventRef) is also automatically created and shall therefore not be set manually.
          symbolic name reference ETHTRCV_E_ACCESS [0..1]: multiplicity set at link in variant link-time / post-build in variant post-build / pre-compile in variant pre-compile, post-build-variant-multiplicity=true, post-build-variant-value=true, set at link in variant link-time / post-build in variant post-build / pre-compile in variant pre-compile, destination=DemEventParameter  # Reference to the DemEventParameter which shall be issued when the error "Transceiver access failed" has occurred.
        container EthTrcvRbAccess [0..1]  # Container gives EthTrcv Driver information about access to a single Eth transceiver.
          container EthTrcvRbDioAccess  # Container gives Eth transceiver driver information about accessing ports and port pins. In addition relation between Eth transceiver hardware pin names and Dio port access information is given. If a Eth transceiver hardware has no Dio interface, there is no instance of this container.
            container EthTrcvRbDioChannelAccess [1..3]  # Container gives DIO channel access by single Eth transceiver channel.
              enumeration EthTrcvRbDioHardwareInterfaceType: {Reset, Enable, Wake}, origin=RB, set at pre-compile, default-value=Enable  # Type of Pin-functionality. According this value the EthTrcv-SW derives the corresponding Hardware-Pin for specific functionality.
              choice reference EthTrcvRbDioSymNameRef: origin=RB, set at pre-compile, destination=DioChannel  # Choice Reference to a DIO Channel.
        container EthTrcvRbTrcvSpecificParam [0..1]  # Transceiver specific parameters.
          container EthTrcvRbTJA1100 [0..1]  # Special Container for TJA1100 configuration. This can be configured for enabling some of the features of the TJA1100. But this has to be done in accordance with the hardware configuration.T
            enumeration EthTrcvRbOperationMode [0..1]: {ETHTRCV_AUTO_OP_MANAGED, ETHTRCV_AUTO_OP_AUTONOMOUS}, origin=RB, set at pre-compile, default-value=ETHTRCV_AUTO_OP_MANAGED  # RB (Vendor06) specific parameter: This configures the mode of operation for TJA1100. This has to be configured according to the bootstrap hardware configuration. If no bootstrap resistors are used, then it has to be configured to managed operation.
            enumeration EthTrcvRbAUTO_PWD [0..1]: {ETHTRCV_AUTO_PWD_DISABLED, ETHTRCV_AUTO_PWD_ENABLED}, origin=RB, set at pre-compile, default-value=ETHTRCV_AUTO_PWD_DISABLED  # RB (Vendor06) specific parameter: If autonomous power-down is enabled via Configuration register 1 (AUTO_PWD = 1), the TJA1100 goes to Sleep Request mode automatically if no Ethernet frames have been received at the MDI and MII for the time-out time, tto(pd)autn. Currently, it is not supported
            enumeration EthTrcvRbCONFIG_INH [0..1]: {ETHTRCV_CONFIG_INH_OFF_IN_DIS_MODE, ETHTRCV_CONFIG_INH_ON_IN_DIS_MODE}, origin=RB, set at pre-compile, default-value=ETHTRCV_CONFIG_INH_ON_IN_DIS_MODE  # RB (Vendor06) specific parameter: Reg17 Bit1, 0 = INH switched off in Disable mode; 1 = INH switched on in Disable mode
            enumeration EthTrcvRbJUMBO_ENABLE [0..1]: {ETHTRCV_4KB_SUPPORT, ETHTRCV_16KB_SUPPORT}, origin=RB, set at pre-compile, default-value=ETHTRCV_16KB_SUPPORT  # RB (Vendor06) specific parameter: It enables/disables the jumbo packet support. Reg 19 Bit2: 0 = packets up to 4 kB supported; 1 = packets up to 16 kB supported
            enumeration EthTrcvRbLED_ENABLE [0..1]: {ETHTRCV_LED_OUTPUT_DISABLED, ETHTRCV_LED_OUTPUT_ENABLED}, origin=RB, set at pre-compile, default-value=ETHTRCV_LED_OUTPUT_DISABLED  # RB (Vendor06) specific parameter: It enables/disables the LED output and Wake input. This shall be configured according to the hardware configuration. Reg 18 Bit3: 0 = LED output disabled; WAKE input enabled 1 = LED output enabled; WAKE input disabled
            enumeration EthTrcvRbLED_MODE [0..1]: {ETHTRCV_LED_MODE_LINK_UP, ETHTRCV_LED_MODE_FRAME_RECEPTION, ETHTRCV_LED_MODE_SYMBOL_ERROR, ETHTRCV_LED_MODE_CRS_SIGNAL}, origin=RB, set at pre-compile, default-value=ETHTRCV_LED_MODE_LINK_UP  # RB (Vendor06) specific parameter: This configuration is valid only if the EthTrcvRbLED_ENABLE configuration is enabled.
            enumeration EthTrcvRbLPS_ACTIVE [0..1]: {ETHTRCV_LPS_ACTIVE_DISABLED, ETHTRCV_LPS_ACTIVE_ENABLED}, origin=RB, set at pre-compile, default-value=ETHTRCV_LPS_ACTIVE_DISABLED  # RB (Vendor06) specific parameter: Reg 18 Bit0: 0 = automatic transition from Normal to Sleep Request when LPS code group received disabled 1 = automatic transition from Normal to Sleep Request when LPS code group received enabled
            enumeration EthTrcvRbMII_DRIVER [0..1]: {ETHTRCV_MII_DRIVER_STANDARD, ETHTRCV_MII_DRIVER_REDUCED}, origin=RB, set at pre-compile, default-value=ETHTRCV_MII_DRIVER_STANDARD  # RB (Vendor06) specific parameter: This configures the driver strength for the MII lines.
            enumeration EthTrcvRbTX_AMPLITUDE [0..1]: {ETHTRCV_TX_AMPLITUDE_500MV, ETHTRCV_TX_AMPLITUDE_750MV, ETHTRCV_TX_AMPLITUDE_1000MV, ETHTRCV_TX_AMPLITUDE_1250MV}, origin=RB, set at pre-compile, default-value=ETHTRCV_TX_AMPLITUDE_1000MV  # RB (Vendor06) specific parameter: This parameter configures the nominal transmit amplitude. The default value is 1000mV.
        container EthTrcvWakeupMap [0..7]  # Container for the mapping of wake up reasons to wake up sources. At least one container is needed if EthTrcvWakeUpSupport is not ETHTRCV_WAKEUP_NOT_SUPPORTED.
          enumeration EthTrcvWakeupReason: {ETHTRCV_WUR_BUS, ETHTRCV_WUR_GENERAL, ETHTRCV_WUR_INTERNAL, ETHTRCV_WUR_PIN, ETHTRCV_WUR_POWER_ON, ETHTRCV_WUR_RESET, ETHTRCV_WUR_SYSERR}, post-build-variant-value=true, set at link in variant link-time / post-build in variant post-build / pre-compile in variant pre-compile  # This parameter defines the transceiver wake up reasons.
          symbolic name reference EthTrcvWakeupSourceRef: set at pre-compile, destination=EcuMWakeupSource  # Configures the wake-up source defined in EcuM.
    container EthTrcvGeneral  # General configuration of Ethernet Transceiver Driver module
      boolean EthTrcvDevErrorDetect: set at pre-compile  # Switches the Default Error Tracer (Det) detection and notification ON or OFF. | * true: enabled (ON). * false: disabled (OFF).
      boolean EthTrcvGetBaudRateApi: set at pre-compile  # Enables / Disables EthTrcv_GetBaudRate API
      boolean EthTrcvGetDuplexModeApi: set at pre-compile  # Enables / Disables EthTrcv_GetDuplexMode API
      boolean EthTrcvGetLinkStateApi: set at pre-compile  # Enables / Disables EthTrcv_GetLinkState API
      boolean EthTrcvGetTransceiverModeApi: set at pre-compile  # Enables / Disables EthTrcv_GetTransceiverMode API
      boolean EthTrcvGetTransceiverWakeupModeApi [0..1]: multiplicity set at pre-compile, set at pre-compile  # Enables / Disables EthTrcv_GetTransceiverWakeupMode API
      enumeration EthTrcvRbHardwareType: {DP83822, BCM89811, TJA1100, NO_PHY, RTL9000AA, MARVELL_88Q2112}, origin=RB, set at pre-compile  # RB (Vendor06) specific parameter: Type of the used Hardware
      integer EthTrcvIndex: 0..255, set at pre-compile  # Specifies the InstanceId of this module instance. If only one instance is present it shall have the Id 0.
      float EthTrcvMainFunctionPeriod: 0..Inf, multiplicity set at pre-compile, set at pre-compile  # Specifies the period of main function EthTrcv_MainFunction in seconds.
      integer EthTrcvMaxTrcvsSupported: 0..255, set at pre-compile, default-value=1
      string EthTrcvRbCableDiagCallout [0..1]: origin=RB, set at link in variant link-time / post-build in variant post-build / pre-compile in variant pre-compile, max-length=31, min-length=10  # Specifies the callback that needs to be called on completion of CableDiagnostics. Only requireed for RTL9000AA Syntax: void <CallBackName> (uint8 TrcvIdx, EthTrcv_CableDiagResultType Result) TrcvIdx - Id of the Transceiver Result - ETHTRCV_CABLEDIAG_OK - Cable diagnostic ok ETHTRCV_CABLEDIAG_ERROR - Cable diagnostic failed ETHTRCV_CABLEDIAG_SHORT - Short circuit detected ETHTRCV_CABLEDIAG_OPEN - Open circuit detected
      string EthTrcvRbCallBackHeaderFile [0..1]: origin=RB, set at link in variant link-time / post-build in variant post-build / pre-compile in variant pre-compile, max-length=31, min-length=3  # Specifies the header file, where the call back API(Configured via parameter - EthTrcvRbCableDiagCallout) is declared. Needs to be configured if the Transceiver selected is RTL9000AA
      boolean EthTrcvRbGetCableDiagnosticsResultApi [0..1]: origin=RB, set at pre-compile  # Enables / Disables EthTrcv_GetCableDiagnosticsResult API. This api specifies whether the Cable connection between the Ecu and the link partner is normal, short or open. This api is available only for TJA1100 and RTL9000AA EthTrcv
      boolean EthTrcvRbGetConnNegConfigApi [0..1]: origin=RB, set at pre-compile, default-value=FALSE  # Enables / Disables EthTrcv_GetConnNegConfig API.This api retrieves the Master/Slave configuration of the Phy.This api is available only for TJA1100 EthTrcv.
      boolean EthTrcvRbGetLinkStatisticsApi [0..1]: origin=RB, set at pre-compile, default-value=FALSE  # Enables / Disables EthTrcv_GetLinkStatistics API.This api provides information about the number of symbol errors and number of link loss count of Phy.This api is available only for TJA1100 EthTrcv.
      boolean EthTrcvRbGetLinkTrainingDurationApi [0..1]: origin=RB, set at pre-compile, default-value=FALSE  # Enables / Disables EthTrcv_GetLinkTrainingDuration API.This api provides information about the link training.This is available only for TJA1100 EthTrcv.
      boolean EthTrcvRbGetPhyIdentifierApi [0..1]: origin=RB, set at pre-compile, default-value=FALSE  # Enables / Disables EthTrcv_GetPhyIdentifier API.This api specifies the OUI, model number and Revision number of the configured Phy.This api helps us to identify which Trcv is being used.This api is available for TJA1100 and RTL9000AA EthTrcv.
      boolean EthTrcvRbGetPhySignalQualityApi [0..1]: origin=RB, set at pre-compile, default-value=FALSE  # Enables / Disables EthTrcv_GetPhySignalQuality API.This api specifies the signal quality between the ECU and the link partner whether the link quality is good or bad.This api is available for TJA1100 and RTL9000AA EthTrcv.
      string EthTrcvRbLinkTrainingCallout [0..1]: origin=RB, set at link in variant link-time / post-build in variant post-build / pre-compile in variant pre-compile, max-length=31, min-length=10  # Specifies the callback that needs to be called on completion of Link training. Only requireed for TJA1100 Syntax: void <CallBackName> (uint8 TrcvIdx, uint32 LinkTrainingDuration TrcvIdx - Id of the Transceiver LinkTrainingDuration - Link training duration in milli seconds
      boolean EthTrcvRbSetPhyLoopbackModeApi [0..1]: origin=RB, set at pre-compile, default-value=FALSE  # Enables / Disables EthTrcv_SetPhyLoopbackMode API.This api configures the Phy to requested loopback(internal, external or remote) mode. This api is available for TJA1100 and RTL9000AA EthTrcv.
      boolean EthTrcvRbSetPhyTestModeApi [0..1]: origin=RB, set at pre-compile, default-value=FALSE  # Enables / Disables EthTrcv_SetPhyTestMode API.This api is used to configure the Phy to requested test mode. This api is available for TJA1100 and RTL9000AA EthTrcv.
      boolean EthTrcvSetTransceiverModeApi: set at pre-compile  # Enables / Disables EthTrcv_SetTransceiverMode API
      boolean EthTrcvStartAutoNegotiationApi: set at pre-compile  # Enables / Disables EthTrcv_StartAutoNegotiation API
      boolean EthTrcvVersionInfoApi: set at pre-compile  # Enables / Disables version info API
      boolean EthTrcvVersionInfoApiMacro: set at pre-compile  # Enables / Disables version info API macro implementation
      enumeration EthTrcvWakeUpSupport: {ETHTRCV_WAKEUP_BY_INTERRUPT, ETHTRCV_WAKEUP_BY_POLLING, ETHTRCV_WAKEUP_NOT_SUPPORTED}, set at pre-compile  # Configures wake-up to polling or interrupt or to not used/not supported. In case no wake up is supported by the hardware, the BSWMD pre-configuration shall be set to ETHTRCV_WAKEUP_NOT_SUPPORTED.
