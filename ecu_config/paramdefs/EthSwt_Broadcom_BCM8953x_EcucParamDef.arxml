AUTOSAR XML (schema 4-2-2)
# The material contained in this specification is protected by copyright and
# other types of Intellectual Property Rights. The commercial exploitation of the
# material contained in this specification requires a license to such
# Intellectual Property Rights.
# This specification may be utilized or reproduced without any modification, in
# any form or by any means, for informational purposes only. For any other
# purpose, no part of the specification may be utilized or reproduced, in any
# form or by any means, without permission in writing from the publisher.
# licensed under the same rules as applicable to the AUTOSAR Standard.
package /AUTOSAR_EthSwt/EcucModuleDefs
  module definition EthSwt [0..*]: refined-module-def=EthSwt, variants post-build/pre-compile  # Configuration of the EthSwt (Ethernet Switch Driver) module.
    container EthSwtConfig [1..*]: multiplicity set at link in variant link-time / post-build in variant post-build / pre-compile in variant pre-compile, post-build-variant-multiplicity=true  # Configuration of one Ethernet Switch.
      boolean EthSwtDropDoubleTagged [0..0]: post-build-variant-value=true, set at link in variant link-time / post-build in variant post-build / pre-compile in variant pre-compile, default-value=false  # This parameter defines if a switch shall drop double tagged (Q in Q) frames. | If this parameter is set to TRUE double tagged frames are dropped at all ports. If this parameter is set to FALSE, then double tagged frames are forwarded. If double tagging is used as a feature, this parameter must be set to FALSE. This parameter shall only be set to TRUE when Switch-HW supports the filtering of double tagged frames as filtering by SW is NOT possible!
      integer EthSwtIdx: 0..255, scope=ECU, set at pre-compile, symbolic-name-value=true, with-auto=true  # Specifies the instance ID of the configured Ethernet Switch.
      symbolic name reference EthSwtManagementEthCtrlRef [0..0]: multiplicity set at pre-compile, set at pre-compile, destination=EthCtrlConfig  # Reference to the Ethernet controller connected to the management port where the management frames will be transmitted/received.
      reference EthSwtManagementPortRef [0..0]: multiplicity set at pre-compile, set at pre-compile, destination=EthSwtPort  # Reference to the port where the management CPU is connected to.
      container EthSwtDemEventParameterRefs [0..0]: multiplicity set at pre-compile, post-build-variant-multiplicity=true  # Container for the references to DemEventParameter elements which shall be invoked using the API Dem_SetEventStatus in case the corresponding error occurs. The EventId is taken from the referenced DemEventParameter's DemEventId symbolic value. The standardized errors are provided in this container and can be extended by vendor-specific error references.
        symbolic name reference ETHSWT_E_ACCESS [0..0]: multiplicity set at link in variant link-time / post-build in variant post-build / pre-compile in variant pre-compile, post-build-variant-multiplicity=true, post-build-variant-value=true, set at link in variant link-time / post-build in variant post-build / pre-compile in variant pre-compile, destination=DemEventParameter  # Reference to the DemEventParameter which shall be issued when the error "Ethernet Switch Access Failure" has occurred.
      container EthSwtNvm [0..0]: multiplicity set at pre-compile, post-build-variant-multiplicity=true  # Configuration of one Ethernet Switch Nvm usage in case the module requires non volatile memory in the Ecu to store switch configuration.
        symbolic name reference EthSwtNvmBlockDescriptorRef [0..0]: scope=ECU, post-build-variant-value=true, set at pre-compile, destination=NvMBlockDescriptor  # Reference to the Nvm block description in the Nvm module configuration.
      container EthSwtPort [1..*]: multiplicity set at link in variant link-time / post-build in variant post-build / pre-compile in variant pre-compile, post-build-variant-multiplicity=true  # Configuration of one Ethernet Switch Port.
        boolean EthSwtPortEnableLinkDownCallback [0..0]: post-build-variant-value=true, set at link in variant link-time+post-build / post-build in variant post-build / pre-compile in variant pre-compile  # Enables the callback <User>_LinkDown for this EthSwtPort if an IEEE802.1X link loss is detected. | <User> is defined by EthSwtLinkDownUser.
        integer EthSwtPortIdx: 0..255, scope=ECU, set at pre-compile, symbolic-name-value=true  # Specifies the instance ID of the configured Ethernet Switch Port.
        enumeration EthSwtPortMacLayerSpeed [0..1]: {ETH_MAC_LAYER_SPEED_100M, ETH_MAC_LAYER_SPEED_1G}, scope=ECU, multiplicity set at link in variant link-time+post-build / pre-compile in variant pre-compile, post-build-variant-multiplicity=true, post-build-variant-value=true, set at link in variant link-time+post-build / pre-compile in variant pre-compile  # Defines the baud rate of the MAC layer.
        enumeration EthSwtPortMacLayerSubType [0..1]: {REDUCED, REVERSED, SERIAL, STANDARD}, scope=ECU, multiplicity set at link in variant link-time+post-build / pre-compile in variant pre-compile, post-build-variant-multiplicity=true, post-build-variant-value=true, set at link in variant link-time+post-build / pre-compile in variant pre-compile  # Defines the MAC layer Sub type of this EthSwtPort.
        enumeration EthSwtPortMacLayerType [0..0]: {ETHSWT_PORT_MAC_LAYER_TYPE_XGMII, ETHSWT_PORT_MAC_LAYER_TYPE_XMII, ETHSWT_PORT_MAC_LAYER_TYPE_XXGMII}, scope=ECU, multiplicity set at link in variant link-time+post-build / pre-compile in variant pre-compile, post-build-variant-multiplicity=true, post-build-variant-value=true, set at link in variant link-time+post-build / pre-compile in variant pre-compile  # Defines the MAC layer type of this EthSwtPort.
        enumeration EthSwtPortMasterSlaveMode [0..1]: {ETHSWT_PORT_MASTER_MODE, ETHSWT_PORT_SLAVE_MODE}, scope=ECU, multiplicity set at link in variant link-time+post-build / pre-compile in variant pre-compile, origin=RB:AR42.1.4.0:2016-10-14, set at link in variant link-time+post-build / pre-compile in variant pre-compile  # Defines the mode on this EthSwtPort.
        enumeration EthSwtPortPhysicalLayerType [0..1]: {ETHSWT_PORT_100BASE_T1, ETHSWT_PORT_100BASE_TX}, scope=ECU, multiplicity set at link in variant link-time+post-build / pre-compile in variant pre-compile, origin=RB:AR42.2.4.0:2017-03-13, post-build-variant-multiplicity=true, post-build-variant-value=true, set at link in variant link-time+post-build / pre-compile in variant pre-compile  # Defines the physical layer type of this EthSwtPort.
        string EthSwtPortPredefinedMacAddresses [0..*]: multiplicity set at link in variant link-time / post-build in variant post-build / pre-compile in variant pre-compile, post-build-variant-multiplicity=true, post-build-variant-value=true, set at link in variant link-time / post-build in variant post-build / pre-compile in variant pre-compile, regular-expression=[0-9a-fA-F]{2}[[:-][0-9a-fA-F]{2}]{5}  # Specifies a list of 48-bit physical addresses (MAC addresses) which can be reached via this port in network byte order. | Note that further addresses can be learned during runtime.
        enumeration EthSwtPortRole [0..1]: {ETHSWT_HOST_PORT, ETHSWT_UP_LINK_PORT}, multiplicity set at link in variant link-time / post-build in variant post-build / pre-compile in variant pre-compile, post-build-variant-multiplicity=true, post-build-variant-value=true, set at link in variant link-time / post-build in variant post-build / pre-compile in variant pre-compile  # Set a special role of the Ethernet switch port. It is either a host port or a up link port. If not configured it is a standard port.
        boolean EthSwtPortTimeStampSupport: post-build-variant-value=true, set at link in variant link-time / post-build in variant post-build / pre-compile in variant pre-compile  # Enables/Disables the Switch-port specific timestamping.
        symbolic name reference EthSwtPortTrcvRef [0..0]: scope=ECU, multiplicity set at link in variant link-time / post-build in variant post-build / pre-compile in variant pre-compile, origin=RB:AR42.1.7.0:2017-02-03, post-build-variant-multiplicity=true, post-build-variant-value=true, set at link in variant link-time / post-build in variant post-build / pre-compile in variant pre-compile, destination=EthTrcvConfig  # Reference to the Ethernet transceiver driver this EthSwtPort is connected with.
        container EthSwtPortEgress [0..0]  # Configuration of one Ethernet Switch Port Egress behavior.
          reference EthSwtPortEgressLastSchedulerRef [0..0]: post-build-variant-value=true, set at link in variant link-time / post-build in variant post-build / pre-compile in variant pre-compile, destination=EthSwtPortScheduler  # Reference to the port scheduler which is the last in the egress port structure.
          container EthSwtPortFifo [0..1]: multiplicity set at link in variant link-time / post-build in variant post-build / pre-compile in variant pre-compile, post-build-variant-multiplicity=true  # Represents a Fifo in the egress port.
            integer EthSwtPortFifoMinimumLength [0..0]: 0..18446744073709551615, scope=ECU, multiplicity set at link in variant link-time / post-build in variant post-build / pre-compile in variant pre-compile, post-build-variant-multiplicity=true, post-build-variant-value=true, set at link in variant link-time / post-build in variant post-build / pre-compile in variant pre-compile  # FIFO minimum length in Byte. This assignment is used to configure a guaranteed size of a configured FIFO.
            integer EthSwtPortFifoTrafficClassAssignment [0..0]: 0..7, scope=ECU, post-build-variant-value=true, set at link in variant link-time / post-build in variant post-build / pre-compile in variant pre-compile  # Defines which traffic classes are assigned to this Fifo.
          container EthSwtPortScheduler [0..1]: multiplicity set at link in variant link-time / post-build in variant post-build / pre-compile in variant pre-compile, post-build-variant-multiplicity=true  # Represents a Scheduler in the egress port.
            enumeration EthSwtPortSchedulerAlgorithm [0..0]: {ETHSWT_SCHEDULER_DEFICIT_ROUND_ROBIN, ETHSWT_SCHEDULER_STRICT_PRIORITY, ETHSWT_SCHEDULER_WEIGHTED_ROUND_ROBIN}, post-build-variant-value=true, set at link in variant link-time / post-build in variant post-build / pre-compile in variant pre-compile  # Defines the scheduler algorithm.
            container EthSwtPortSchedulerPredecessor [0..1]: multiplicity set at link in variant link-time / post-build in variant post-build / pre-compile in variant pre-compile, post-build-variant-multiplicity=true  # Defines an ordered list of predecessors for this scheduler.
              integer EthSwtPortSchedulerPredecessorOrder [0..0]: 0..18446744073709551615, scope=ECU, post-build-variant-value=true, set at link in variant link-time / post-build in variant post-build / pre-compile in variant pre-compile  # Defines the order of the scheduler predecessors.
              choice reference EthSwtPortEgressPredecessorRef [0..0]: post-build-variant-value=true, set at link in variant link-time / post-build in variant post-build / pre-compile in variant pre-compile, destination=[EthSwtPortFifo, EthSwtPortScheduler, EthSwtPortShaper]  # Choice reference to the scheduler predecessor.
          container EthSwtPortShaper [0..1]: multiplicity set at link in variant link-time / post-build in variant post-build / pre-compile in variant pre-compile, post-build-variant-multiplicity=true  # Represents a Shaper in the egress port.
            integer EthSwtPortShaperIdleSlope [0..0]: 0..18446744073709551615, post-build-variant-value=true, set at link in variant link-time / post-build in variant post-build / pre-compile in variant pre-compile  # Defines the increase of credit in bits per second for the AVB shaper.
            reference EthSwtPortEgressPredecessorFifoRef [0..0]: post-build-variant-value=true, set at link in variant link-time / post-build in variant post-build / pre-compile in variant pre-compile, destination=EthSwtPortFifo  # Reference to the fifo which is the predecessor for this shaper.
        container EthSwtPortIngress  # Configuration of one Ethernet Switch Port ingress behavior.
          integer EthSwtPortIngressDefaultPriority [0..1]: 0..7, multiplicity set at link in variant link-time / post-build in variant post-build / pre-compile in variant pre-compile, post-build-variant-multiplicity=true, post-build-variant-value=true, set at link in variant link-time / post-build in variant post-build / pre-compile in variant pre-compile, default-value=0  # Default priority for ingress.
          integer EthSwtPortIngressDefaultVlan [0..1]: 0..4094, multiplicity set at link in variant link-time / post-build in variant post-build / pre-compile in variant pre-compile, post-build-variant-multiplicity=true, post-build-variant-value=true, set at link in variant link-time / post-build in variant post-build / pre-compile in variant pre-compile, default-value=1  # Default VLAN for ingress.
          boolean EthSwtPortIngressDropUntagged: post-build-variant-value=true, set at link in variant link-time / post-build in variant post-build / pre-compile in variant pre-compile, default-value=false  # Defines the ingress behavior for untagged frames.
          integer EthSwtPortIngressVlanModification [0..0]: 0..4095, scope=ECU, multiplicity set at link in variant link-time / post-build in variant post-build / pre-compile in variant pre-compile, post-build-variant-multiplicity=true, post-build-variant-value=true, set at link in variant link-time / post-build in variant post-build / pre-compile in variant pre-compile  # If this parameter is defined all messages which arrive at this ingress port will be tagged with this VLAN Id. This tagging happen also if the arriving message already has a VLAN Id, it will be overwritten by the defined one. | If this parameter is not defined no changes to the VLAN Id shall happen at this ingress port.
          integer EthSwtPortTrafficClassAssignment [0..0]: 0..7, scope=ECU, multiplicity set at link in variant link-time / post-build in variant post-build / pre-compile in variant pre-compile, post-build-variant-multiplicity=true, post-build-variant-value=true, set at link in variant link-time / post-build in variant post-build / pre-compile in variant pre-compile  # If this parameter is defined all arriving messages at this ingress port shall be assigned this traffic class. | If this parameter is not defined no general port based traffic class assignment is done.
          container EthSwtPortPolicer [0..0]: multiplicity set at link in variant link-time / post-build in variant post-build / pre-compile in variant pre-compile, post-build-variant-multiplicity=true  # Definition of Rate Policing parameters.
            integer EthSwtPortRatePolicedByteCount [0..0]: 1..18446744073709551615, post-build-variant-value=true, set at link in variant link-time / post-build in variant post-build / pre-compile in variant pre-compile  # Amount of Byte Counts (excluding Header information) which can be received in a configured EthSwtPortRatePolicedTimeInterval.
            integer EthSwtPortRatePolicedPriority [0..0]: 0..7, multiplicity set at link in variant link-time / post-build in variant post-build / pre-compile in variant pre-compile, post-build-variant-multiplicity=true, post-build-variant-value=true, set at link in variant link-time / post-build in variant post-build / pre-compile in variant pre-compile  # Defines the priority which this rate policy shall be limited on. If no priority is given this rate policy is not considering priority.
            float EthSwtPortRatePolicedTimeInterval [0..0]: 0..Inf, post-build-variant-value=true, set at link in variant link-time / post-build in variant post-build / pre-compile in variant pre-compile  # Time interval in seconds where a configured EthSwtPortRatePolicedByteCount can be received without a rate limitation.
            enumeration EthSwtPortRateViolationAction [0..0]: {BLOCK_SOURCE, DROP_FRAME}, post-build-variant-value=true, set at link in variant link-time / post-build in variant post-build / pre-compile in variant pre-compile  # Action to be taken when the rate policy criteria defined for this EthSwtPortPolicer are met.
            reference EthSwtPortRateVlanMembershipRef [0..0]: multiplicity set at link in variant link-time / post-build in variant post-build / pre-compile in variant pre-compile, post-build-variant-multiplicity=true, post-build-variant-value=true, set at link in variant link-time / post-build in variant post-build / pre-compile in variant pre-compile, destination=EthSwtPortVlanMembership  # References the Vlans this rate policy shall apply to. | If no EthSwtPortRateVlanMembershipRef is configured the rate policing applies only on the configured EthSwtPortRatePolicedPriority.
          container EthSwtPriorityRegeneration [0..0]: multiplicity set at link in variant link-time / post-build in variant post-build / pre-compile in variant pre-compile, post-build-variant-multiplicity=true  # Defines a priority regeneration where the EthSwtPriorityRegenerationIngressPriority is replaced by EthSwtPriorityRegenerationRegeneratedPriority. | The EthSwtPriorityRegeneration is optional in case no priority regeneration shall be performed. In case a EthSwtPriorityRegeneration is defined it shall have 8 mappings, one for each priority.
            integer EthSwtPriorityRegenerationIngressPriority [0..0]: 0..7, scope=ECU, post-build-variant-value=true, set at link in variant link-time / post-build in variant post-build / pre-compile in variant pre-compile  # Message priority of the incoming message.
            integer EthSwtPriorityRegenerationRegeneratedPriority [0..0]: 0..7, scope=ECU, post-build-variant-value=true, set at link in variant link-time / post-build in variant post-build / pre-compile in variant pre-compile  # Message priority the incoming message will be tagged with.
          container EthSwtPriorityTrafficClassAssignment [0..0]: multiplicity set at link in variant link-time / post-build in variant post-build / pre-compile in variant pre-compile, post-build-variant-multiplicity=true  # Defines a priority based traffic class assignment. All messages with a specific priority (EthSwtPriorityTrafficClassAssignmentPriority) arriving at this ingress port or, if enabled regenerated priorities (EthSwtPriorityRegeneration), shall be assigned to a traffic class (EthSwtPriorityTrafficClassAssignmentTrafficClass).
            integer EthSwtPriorityTrafficClassAssignmentPriority [0..0]: 0..7, scope=ECU, post-build-variant-value=true, set at link in variant link-time / post-build in variant post-build / pre-compile in variant pre-compile  # Message priority.
            integer EthSwtPriorityTrafficClassAssignmentTrafficClass [0..0]: 0..7, scope=ECU, post-build-variant-value=true, set at link in variant link-time / post-build in variant post-build / pre-compile in variant pre-compile  # Traffic Class value.
        container EthSwtPortVlanMembership [0..4095]: multiplicity set at link in variant link-time / post-build in variant post-build / pre-compile in variant pre-compile, post-build-variant-multiplicity=true  # Description Determines the membership of this port to the virtual network, i.e. frames with this VID can be received and transmitted via this port.
          integer EthSwtPortVlanDefaultPriority: 0..7, scope=ECU, post-build-variant-value=true, set at link in variant link-time / post-build in variant post-build / pre-compile in variant pre-compile  # Determines the standard output-priority outgoing messages will be tagged with.
          enumeration EthSwtPortVlanForwardingType: {ETHSWT_NOT_SENT, ETHSWT_SENT_TAGGED, ETHSWT_SENT_UNTAGGED}, scope=ECU, post-build-variant-value=true, set at link in variant link-time / post-build in variant post-build / pre-compile in variant pre-compile  # Defines how the message with a specific VLAN Id shall be handled.
          integer EthSwtPortVlanMembershipId: 0..4094, scope=ECU, post-build-variant-value=true, set at link in variant link-time / post-build in variant post-build / pre-compile in variant pre-compile  # Determines the VID of the virtual network this port belongs to.
      container EthSwtSpi [0..1]: multiplicity set at pre-compile, post-build-variant-multiplicity=true  # Configuration of one Ethernet Switch SPI access (if SPI is used).
        integer EthSwtSpiChipSelectIndex [0..1]: 0..3, origin=RB:AR42.1.4.0:2016-10-14, set at pre-compile  # The BCM8953x Chip has two strap pins that define the 2MSBs of the chip ID(PHY address for MDIO interface). SPI Command [7:6] defines which chip select will respond to the SPI operation. Up to four BCM8953x chip can be driven by SPI master and only the chip with the matching ID will respond
        integer EthSwtSpiReadWaitState [0..1]: 0..3, origin=RB:AR42.1.4.0:2016-10-14, set at pre-compile  # This field is applicable only for read operation. When performing direct access reads, the data is not immediately available to be shifted out to ensure that the interval slave or register has enough time to provide the requested data, it is required to insert wait states between the address phase and data phase. - 00 = Reserved - 01 = 16 SCK dummy clock cycles required after address and before data is shifted out.Use this setting when SCK frequency is ≤ TO 25 MHz - 10 = 32 SCK dummy clock cycles required after address and before data is shifted out.Use this setting when SCK frequency is ≤ TO 50 MHz - 11 = 48 SCK dummy clock cycles required after address and before data is shifted out.Use this setting when SCK frequency is > TO 50 MHz
        container EthSwtSpiSequence [1..*]: multiplicity set at pre-compile, post-build-variant-multiplicity=true  # Container gives EthSwt driver information about one SPI sequence. | One SPI sequence used by EthSwt driver is in exclusive use for it. No other driver is allowed to access this sequence. EthSwt driver may use one sequence to access n EthSwt hardware chips of the same type or n sequences are used to access one single EthSwt hardware chip. If a EthSwt hardware has no SPI interface, there is no instance of this container.
          boolean EthSwtSpiAccessSynchronous [0..1]: scope=ECU, multiplicity set at pre-compile, post-build-variant-multiplicity=true, post-build-variant-value=true, set at pre-compile, with-auto=true  # This parameter is used to define whether the access to the Spi sequence is synchronous or asynchronous. | true: SPI access is synchronous. false: SPI access is asynchronous.
          symbolic name reference EthSwtSpiSequenceName [0..*]: scope=ECU, multiplicity set at pre-compile, post-build-variant-multiplicity=true, post-build-variant-value=true, set at pre-compile, destination=SpiSequence, with-auto=true  # Reference to a Spi sequence configuration container.
    container EthSwtGeneral  # General configuration of Ethernet Switch Driver module.
      boolean EthSwtDevErrorDetect: set at pre-compile, default-value=false  # Switches the development error detection and notification on or off. | * true: detection and notification is enabled. * false: detection and notification is disabled.
      boolean EthSwtEnableVlanApi [0..0]: set at pre-compile  # Enables / Disables EthSwt_EnableVLAN API.
      boolean EthSwtGetArlTableApi: set at pre-compile  # Enables / Disables EthSwt_GetArlTable API.
      function name EthSwtGetArlTableCallBack [0..1]: multiplicity set at pre-compile, origin=RB:AR42.2.4.0:2017-06-29, set at pre-compile  # This Parameter Defines the name of the Call Back for EthSwtGetArlTableApi.
      boolean EthSwtGetBufferLevelApi [0..0]: set at pre-compile  # Enables / Disables API to fetch the switch buffer utilization.
      boolean EthSwtGetCfgHexDumpApi [0..0]: set at pre-compile  # Enables / Disables EthSwt_GetCfgHexDump API
      boolean EthSwtGetCfgHexDumpLengthApi [0..0]: set at pre-compile  # Enables / Disables EthSwt_GetCfgHexDumpLength API
      boolean EthSwtGetDropCountApi: set at pre-compile  # Enables / Disables EthSwt_GetCounterValues API
      function name EthSwtGetCounterValuesCallBack [0..1]: multiplicity set at pre-compile, origin=RB:AR42.2.4.0:2018-05-15, set at pre-compile  # This Parameter Defines the name of the Call Back for EthSwtGetDropCountApi .
      boolean EthSwtGetMacLearningModeApi [0..0]: set at pre-compile  # Enables / Disables EthSwt_GetMacLearningMode API.
      boolean EthSwtGetPortCableDiagnosticsResultApi: set at pre-compile  # Enables / Disables EthSwt_GetPortCableDiagnosticsResult API
      function name EthSwtGetPortCableDiagnosticsResultCallBack [0..1]: multiplicity set at pre-compile, origin=RB:AR42.2.4.0:2017-06-29, set at pre-compile  # This Parameter Defines the name of the Call Back for EthSwtGetPortCableDiagnosticsResultApi.
      boolean EthSwtGetLinkStateApi [0..1]: set at pre-compile  # Enables / Disables EthSwtGetLinkState API
      function name EthSwtGetLinkStateCallBack [0..1]: multiplicity set at pre-compile, origin=RB:AR42.5.1.0:2018-07-31, set at pre-compile  # This Parameter Defines the name of the Call Back for EthSwtGetLinkState api .
      boolean EthSwtGetPortIdentifierApi [0..0]: set at pre-compile  # Enables / Disables EthSwt_GetPortIdentifier API
      boolean EthSwtGetPortMacAddrApi [0..0]: set at pre-compile  # Enables / Disables EthSwt_GetPortMacAddr API.
      boolean EthSwtGetPortMirrorStateApi: set at pre-compile  # Enables / Disables EthSwt_GetPortMirrorState API
      function name EthSwtGetPortMirrorStateCallBack [0..1]: multiplicity set at pre-compile, origin=RB:AR42.5.1.0:2018-07-31, set at pre-compile  # This Parameter Defines the name of the Call Back for EthSwtGetPortMirrorStateApi.
      boolean EthSwtGetPortSignalQualityApi [0..0]: set at pre-compile  # Enables / Disables EthSwt_GetPortSignalQuality API
      boolean EthSwtGetRxStatsApi: set at pre-compile  # Enables / Disables EthSwt_GetEtherStats API.
      function name EthSwtGetRxStatsCallBack [0..1]: multiplicity set at pre-compile, origin=RB:AR42.5.1.0:2018-07-31, set at pre-compile  # This Parameter Defines the name of the Call Back for GetRxStatsApi.
      boolean EthSwtGetSwitchIdentifierApi [0..0]: set at pre-compile  # Enables / Disables EthSwt_GetSwitchIdentifier API
      boolean EthSwtGetSwitchPortModeApi: set at pre-compile  # Enables / Disables EthSwt_GetSwitchPortMode API.
      function name EthSwtGetSwitchPortModeCallBack [0..1]: multiplicity set at pre-compile, origin=RB:AR42.5.1.0:2018-07-31, set at pre-compile  # This Parameter Defines the name of the Call Back for EthSwtGetSwitchPortModeApi.
      boolean EthSwtGetSwitchRegApi: set at pre-compile  # Enables / Disables EthSwt_GetSwitchReg API.
      function name EthSwtGetSwitchRegCallBack [0..1]: multiplicity set at pre-compile, origin=RB:AR42.5.1.0:2018-07-31, set at pre-compile  # This Parameter Defines the name of the Call Back for EthSwtGetSwitchRegApi.
      boolean EthSwtGetTxErrorCounterValuesApi: set at pre-compile, default-value=false  # Enables/Disables Eth_GetTxErrorCounterValues API.
      function name EthSwtGetTxErrorCounterValuesCallBack [0..1]: multiplicity set at pre-compile, origin=RB:AR42.5.1.0:2018-07-31, set at pre-compile  # This Parameter Defines the name of the Call Back for EthSwtGetTxErrorCounterValuesApi.
      boolean EthSwtGetTxStatsApi: set at pre-compile, default-value=false  # Enables/Disables Eth_GetTxStats API.
      function name EthSwtGetTxStatsCallBack [0..1]: multiplicity set at pre-compile, origin=RB:AR42.5.1.0:2018-07-31, set at pre-compile  # This Parameter Defines the name of the Call Back for EthSwtGetTxStatsApi
      boolean EthSwtGlobalTimeSupportApi: set at pre-compile  # Enables/Disables the Global Time APIs used amongst others by Global Time Synchronization over Ethernet.
      integer EthSwtIndex: 0..255, set at pre-compile, with-auto=true  # Specifies the InstanceId of this module instance. If only one instance is present it shall have the Id 0.
      function name EthSwtLinkDownUser [0..0]: multiplicity set at pre-compile, set at pre-compile  # Defines the <User> function name for the <User>_LinkDown callback.
      function name EthSwtLinkUpUser [0..0]: multiplicity set at pre-compile, set at pre-compile  # Defines the <User> function name for the <User>_LinkUp callback.
      boolean EthSwtLowPowerModeSupport [0..1]: multiplicity set at pre-compile, set at pre-compile, default-value=false  # Disable / Enable support of low power mode.
      float EthSwtMainFunctionPeriod: 0..Inf, set at pre-compile  # The cycle time of the periodic main function of EthSwt. Defined in seconds .
      boolean EthSwtManagementSupportApi [0..0]: set at pre-compile  # Enables/Disables the Switch management APIs to support a Switch-port specific communication attribute access.
      float EthSwtMgmtInfoIndicationTimeout [0..0]: 0..Inf, origin=RB:AR42.3.0.0:2017-03-08, set at pre-compile  # This parameter specifies the timeout while the Switch driver is waiting for management information out of the Switch for reception. | The value 0 deactivates the timeout supervision. Unit: seconds
      integer EthSwtNumberOfArlTableEntry [0..1]: 0..65535, origin=RB:AR42.2.0.0:2017-02-04, set at pre-compile, symbolic-name-value=true  # Defines the number of possible ARL entry
      boolean EthSwtPersistentConfigurationResult [0..0]: set at pre-compile  # Enables / Disables the callback API <User>_PersistentConfigurationResult.
      function name EthSwtPersistentConfigurationResultUser [0..0]: multiplicity set at pre-compile, set at pre-compile  # Defines the <User> function name for the <User>_PersistentConfigurationResult callback.
      string EthSwtPublicCddHeaderFile [0..1]: multiplicity set at pre-compile, set at pre-compile, max-length=32, min-length=1  # Defines header files for callback functions which shall be included in case of CDDs.
      boolean EthSwtReadPortMirrorConfigurationApi: set at pre-compile  # Enables / Disables EthSwt_ReadPortMirrorConfiguration API
      function name EthSwtReadPortMirrorConfigurationCallBack [0..1]: multiplicity set at pre-compile, origin=RB:AR42.5.1.0:2018-07-31, set at pre-compile  # This Parameter Defines the name of the Call Back for EthSwtReadPortMirrorConfigurationApi.
      boolean EthSwtReadTrcvRegisterApi [0..0]: set at pre-compile  # Enables / Disables EthSwt_ReadTrcvRegister API.
      boolean EthSwtResetConfigurationApi [0..0]: set at pre-compile  # Enables / Disables EthSwt_ResetConfiguration API.
      boolean EthSwtSetForwardingModeApi [0..0]: set at pre-compile, default-value=false  # Enables /disables EthSwt_SetForwardingMode API.
      boolean EthSwtSetMacLearningModeApi [0..0]: set at pre-compile  # Enables / Disables EthSwt_SetMacLearningMode API.
      boolean EthSwtSetPortLoopbackModeApi [0..0]: set at pre-compile  # Enables / Disables EthSwt_SetPortLoopbackModeApi API
      boolean EthSwtSetPortMirrorStateApi: set at pre-compile  # Enables / Disables EthSwt_SetPortMirrorState API
      function name EthSwtSetPortMirrorStateCallBack [0..1]: multiplicity set at pre-compile, origin=RB:AR42.5.1.0:2018-07-31, set at pre-compile  # This Parameter Defines the name of the Call Back for EthSwt_SetPortMirrorState Api.
      boolean EthSwtSetPortTestModeApi: set at pre-compile  # Enables / Disables EthSwt_SetPortTestMode API
      function name EthSwtSetPortTestModeCallBack [0..1]: multiplicity set at pre-compile, origin=RB:AR42.5.1.0:2018-07-31, set at pre-compile  # This Parameter Defines the name of the Call Back for EthSwtSetPortTestModeApi.
      boolean EthSwtSetPortTxModeApi [0..0]: set at pre-compile  # Enables / Disables EthSwt_SetPortTxModeApi API
      boolean EthSwtSetSwitchPortModeApi: set at pre-compile  # Enables / Disables EthSwt_SetSwitchPortMode API.
      boolean EthSwtSetSwitchRegApi: set at pre-compile  # Enables / Disables EthSwt_SetSwitchReg API.
      function name EthSwtSetSwitchRegCallBack [0..1]: multiplicity set at pre-compile, origin=RB:AR42.5.1.0:2018-07-31, set at pre-compile  # This Parameter Defines the name of the Call Back for EthSwtSetSwitchRegApi.
      boolean EthSwtStoreConfigurationApi [0..0]: set at pre-compile  # Enables / Disables EthSwt_StoreConfiguration API.
      boolean EthSwtVerifyConfigApi [0..0]: set at pre-compile, default-value=false  # Enables /disables EthSwt_VerifyConfig API.
      boolean EthSwtVersionInfoApi: set at pre-compile, default-value=false  # Enables / Disables version info API.
      boolean EthSwtWritePortMirrorConfigurationApi: set at pre-compile  # Enables / Disables EthSwt_WritePortMirrorConfiguration API
      function name EthSwtWritePortMirrorCfgCallBack [0..1]: multiplicity set at pre-compile, origin=RB:AR42.5.1.0:2018-07-31, set at pre-compile  # This Parameter Defines the name of the Call Back for EthSwt_WritePortMirrorConfiguration Api.
      boolean EthSwtWriteTrcvRegisterApi [0..0]: set at pre-compile  # Enables / Disables EthSwt_WriteTrcvRegister API.
