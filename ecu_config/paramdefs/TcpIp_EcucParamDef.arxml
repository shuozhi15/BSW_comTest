AUTOSAR XML (schema 4-2-2)
package /AUTOSAR_TcpIp/EcucModuleDefs
  module definition TcpIp [0..1]: category=VENDOR_SPECIFIC_MODULE_DEFINITION, refined-module-def=TcpIp, variants pre-compile  # Configuration of the TcpIp (TCP/IP stack) module.
    container TcpIpConfig  # This container contains the configuration parameters and sub containers of the AUTOSAR TcpIp module.
      container TcpIpCtrl [1..*]  # Specifies the EthIf controller used for IP communication and TcpIp errors that shall be reported to DEM.
        integer TcpIpIpFramePrioDefault [0..1]: 0..7, multiplicity set at link in variant link-time / post-build in variant post-build / pre-compile in variant pre-compile, post-build-variant-multiplicity=true, post-build-variant-value=true, set at link in variant link-time / post-build in variant post-build / pre-compile in variant pre-compile, default-value=0  # Specifies the default value for the priority for all outgoing frames. | Note: the value can be changed for each socket individually via TcpIp_ChangeParameter() service. If this optional parameter is not available, 0 is used as default priority.
        boolean TcpIpIpTtlConfigurationEnabled [0..1]: origin=RB:42.0.3.0:2016-03-25, set at pre-compile, default-value=false  # RB (Vendor06) Enables (TRUE) or disables (FALSE) usage of configured TTL value per EthIfCtrl (VLAN). If it is disabled, default value 1 shall be used.
        reference TcpIpDhcpServerConfigRef [0..0]: post-build-variant-value=true, set at link in variant link-time / post-build in variant post-build / pre-compile in variant pre-compile, destination=TcpIpDhcpServerConfig  # TcpIpDhcpServerConfigRef (Currently Unused) | Reference to a TcpIpDhcpServerConfig which shall be used for this controller setting (VLAN). Parameter is unused in implementation.
        symbolic name reference TcpIpEthIfCtrlRef: post-build-variant-value=true, set at link in variant link-time / post-build in variant post-build / pre-compile in variant pre-compile, destination=EthIfController  # Reference to EthIf controller where the IP address shall be assigned. | Each TcpIpCtrl shall refer to one EthIfCtrl uniquely.
        container TcpIpCtrlDemEventParameterRefs [0..1]  # This container is a subcontainer of TcpIpCtrl and specifies the references to DemEventParameter elements which shall be invoked using the API Dem_ReportErrorStatus API in case the corresponding TcpIp error occurs for communication on the EthIf Controller. The EventId is taken from the referenced DemEventParameter's DemEventId value. The standardized errors are provided in the container and can be extended by vendor specific error references.
          enumeration TcpIp_DynCreate_TcpIpEvent [0..1]: {Standard, Disabled}, origin=RB:AR42.3.4.0:2017-13-10, set at pre-compile, default-value=Disabled  # RB (Vendor06) Selects the way how the TcpIp DemEvents are created. If set to "Disabled" no DemEvent is automatically created. If configured to "Standard", the reference to a DemEvent is also automatically created and shall therefore not to be set manually.
          symbolic name reference TCPIP_E_CONNREFUSED [0..1]: multiplicity set at link in variant link-time / post-build in variant post-build / pre-compile in variant pre-compile, post-build-variant-multiplicity=true, post-build-variant-value=true, set at link in variant link-time / post-build in variant post-build / pre-compile in variant pre-compile, destination=DemEventParameter  # Reference to the DemEventParameter which shall be issued when the error "Connection refused" has occurred. | When Dem is configured and ICMP message is sent due to a received frame for which the destination port is not reachable, then Dem error TCPIP_E_CONNREFUSED will be thrown
          symbolic name reference TCPIP_E_HOSTUNREACH [0..0]: multiplicity set at link in variant link-time / post-build in variant post-build / pre-compile in variant pre-compile, post-build-variant-multiplicity=true, post-build-variant-value=true, set at link in variant link-time / post-build in variant post-build / pre-compile in variant pre-compile, destination=DemEventParameter  # TCPIP_E_HOSTUNREACH (Currently Unused) | Reference to the DemEventParameter which shall be issued when the error "No route to host" has occurred.
          symbolic name reference TCPIP_E_PACKETTOBIG [0..0]: multiplicity set at link in variant link-time / post-build in variant post-build / pre-compile in variant pre-compile, post-build-variant-multiplicity=true, post-build-variant-value=true, set at link in variant link-time / post-build in variant post-build / pre-compile in variant pre-compile, destination=DemEventParameter  # TCPIP_E_PACKETTOBIG (Currently Unused) | Reference to the DemEventParameter which shall be issued when the error "Path does not support frame size" has occurred. Parameter unused.
          symbolic name reference TCPIP_E_TIMEDOUT [0..0]: multiplicity set at link in variant link-time / post-build in variant post-build / pre-compile in variant pre-compile, post-build-variant-multiplicity=true, post-build-variant-value=true, set at link in variant link-time / post-build in variant post-build / pre-compile in variant pre-compile, destination=DemEventParameter  # TCPIP_E_TIMEDOUT (Currently Unused) | Reference to the DemEventParameter which shall be issued when the error "Operation timed out" has occurred.
        choice container TcpIpIpVXCtrl  # Specifies whether this controller is an Internet Protocol version 4 (IPv4) or Internet Protocol version 6 (IPv6) instance. Note: one TcpIpCtrl can not support both IPv4 and IPv6 at the same time.
          container TcpIpIpV4Ctrl [0..1]  # Specifies an Internet Protocol version 4 (IPv4) instance. Container must be configured to specify domain of TcpIpCtrl.
            boolean TcpIpArpTblAgeingDisabled [0..1]: origin=RB:42.0.3.0:2016-03-25, set at pre-compile, default-value=false  # RB (Vendor06) specific parameter: Disables (TRUE) or enables (FALSE) ageing of ARP Table Entries per TcpIpCtrl. | When enabled, the ARP table entries will be discarded after ARP table entry timeout occurs.
            boolean TcpIpIcmpEchoBroadcastEnabled [0..1]: origin=RB:42.0.3.0:2016-03-25, set at pre-compile, default-value=false  # RB (Vendor06) specific parameter: Enables (TRUE) or disables (FALSE) reply to ICMP Broadcast echo requests per TcpIpCtrl.
            reference TcpIpArpConfigRef [0..0]: multiplicity set at pre-compile, set at pre-compile, destination=TcpIpArpConfig  # TcpIpArpConfigRef (Currently unused) | Reference to ARP configuration for this IPv4 instance. | (Multiple IPv4 instances may use the same configuration container but will operate independently)
            reference TcpIpAutoIpConfigRef [0..0]: multiplicity set at pre-compile, set at pre-compile, destination=TcpIpAutoIpConfig  # TcpIpAutoIpConfigRef (Currently unused) | Reference to AutoIp configuration for this IPv4 instance. | (Multiple IPv4 instances may use the same configuration container but will operate independently)
            reference TcpIpDhcpConfigRef [0..0]: multiplicity set at pre-compile, set at pre-compile, destination=TcpIpDhcpConfig  # TcpIpDhcpConfigRef (Currently unused) | Reference to DHCP configuration for this IPv4 instance. | (Multiple IPv4 instances may use the same configuration container but will operate independently)
            reference TcpIpFragmentationConfigRef [0..1]: multiplicity set at pre-compile, set at pre-compile, destination=TcpIpIpFragmentationConfig  # Reference to Fragmentation configuration for this IPv4 instance. | (Multiple IPv4 instances may use the same configuration container but will operate independently)
          container TcpIpIpV6Ctrl [0..1]  # Specifies an Internet Protocol version 6 (IPv6) instance. Container must be configured to specify domain of TcpIpCtrl.
            reference TcpIpIpV6DhcpConfigRef [0..0]: multiplicity set at pre-compile, set at pre-compile, destination=TcpIpDhcpV6Config  # TcpIpIpV6DhcpConfigRef (Currently Unused) | Reference to DHCPv6 configuration. | (Multiple IPv6 instances may use the same configuration container but will operate independently)
            reference TcpIpIpV6FragmentationConfigRef [0..0]: multiplicity set at pre-compile, set at pre-compile, destination=TcpIpIpV6FragmentationConfig  # TcpIpIpV6FragmentationConfigRef (Currently Unused) | Reference to IPv6 Fragmentation Configuration. | (Multiple IPv6 instances may use the same configuration container but will operate independently)
            reference TcpIpIpV6NdpConfigRef [0..0]: set at pre-compile, destination=TcpIpNdpConfig  # TcpIpIpV6NdpConfigRef (Currently Unused) | Reference to Neighbor Discovery Protocol Configuration. | (Multiple IPv6 instances may use the same configuration container but will operate independently)
            container TcpIpIpV6MtuConfig [0..0]  # TcpIpIpV6MtuConfig (Currently Unused) | This container specifies the Maximum Transmission Unit parameters for this IPv6 instance.
              integer TcpIpIpV6DefaultMtuSize: 1280..65535, default-value=1500  # Maximum Transmission Unit (MTU) of the link. | [RFC2460 5. Packet Size Issues] "IPv6 requires that every link in the internet have an MTU of 1280 octets or greater. On any link that cannot convey a 1280-octet packet in one piece, link-specific fragmentation and reassembly must be provided at a layer below IPv6. Links that have a configurable MTU (for example, PPP links [RFC-1661]) must be configured to have an MTU of at least 1280 octets; it is recommended that they be configured with an MTU of 1500 octets or greater, to accommodate possible encapsulations (i.e., tunneling) without incurring IPv6-layer fragmentation. From each link to which a node is directly attached, the node must be able to accept packets as large as that link's MTU."
              boolean TcpIpIpV6PathMtuEnabled: set at pre-compile, default-value=false  # If enabled the IPv6 processes incoming ICMPv6 "Packet Too Big" messages and stores a MTU value for each destination address. | See RFC1981 "Path MTU Discovery for IP version 6" for details about PathMTU.
              float TcpIpIpV6PathMtuTimeout: 1..86400, set at pre-compile, default-value=600  # If this value is >0 the IpV6 will reset the MTU value stored for each destination after n seconds. | see [RFC1981 5.3. Purging stale PMTU information] Default: 600 seconds (10 minutes)
      container TcpIpDhcpServerConfig [0..0]: multiplicity set at link in variant link-time / post-build in variant post-build / pre-compile in variant pre-compile, post-build-variant-multiplicity=true  # TcpIpDhcpServerConfig (Currently Unused) | Specifies the configuration parameters of the DHCP Server sub-module. Configuration is not used in implementation.
        string TcpIpDhcpDefaultRouter [0..1]: multiplicity set at link in variant link-time / post-build in variant post-build / pre-compile in variant pre-compile, post-build-variant-multiplicity=true, post-build-variant-value=true, set at link in variant link-time / post-build in variant post-build / pre-compile in variant pre-compile  # IP address of default router (gateway).
        integer TcpIpDhcpNetmask [0..1]: 0..128, multiplicity set at link in variant link-time / post-build in variant post-build / pre-compile in variant pre-compile, post-build-variant-multiplicity=true, post-build-variant-value=true, set at link in variant link-time / post-build in variant post-build / pre-compile in variant pre-compile  # Network mask of IPv4 address or address prefix of IPv6 address in CIDR Notation, i.e. decimal value between 0 and 32 (IPv4) or 0 and 128 (IPv6) that describes the number of significant bits defining the network number or prefix of an IP address.
        symbolic name reference TcpIpDhcpEthIfSwitchRef [0..1]: scope=ECU, multiplicity set at link in variant link-time / post-build in variant post-build / pre-compile in variant pre-compile, post-build-variant-multiplicity=true, post-build-variant-value=true, set at link in variant link-time / post-build in variant post-build / pre-compile in variant pre-compile, destination=EthIfSwitch  # Reference to EthIfSwitch representation. | Optional in case the Dhcp server is operating without an Ethernet switch.
        container TcpIpDhcpAddressAssignment [0..*]: multiplicity set at link in variant link-time / post-build in variant post-build / pre-compile in variant pre-compile, post-build-variant-multiplicity=true  # Defines a Ethernet Switch port based IP address assignment.
          string TcpIpDhcpAddressLowerBound: post-build-variant-value=true, set at link in variant link-time / post-build in variant post-build / pre-compile in variant pre-compile  # The lower bound IP address which shall be assigned. | If lower bound and upper bound are identical exactly this IP address shall be assigned.
          string TcpIpDhcpAddressUpperBound: post-build-variant-value=true, set at link in variant link-time / post-build in variant post-build / pre-compile in variant pre-compile  # The upper bound IP address which shall be assigned. | If lower bound and upper bound are identical exactly this IP address shall be assigned.
          symbolic name reference TcpIpDhcpSwitchPortRef [0..1]: scope=ECU, multiplicity set at link in variant link-time / post-build in variant post-build / pre-compile in variant pre-compile, post-build-variant-multiplicity=true, post-build-variant-value=true, set at link in variant link-time / post-build in variant post-build / pre-compile in variant pre-compile, destination=EthSwtPort  # Reference to Ethernet Switch port. | Optional in case the Dhcp server is operating without an Ethernet switch.
      container TcpIpIpConfig [0..1]  # Specifies the configuration parameters of the IP (Internet Protocol) sub-module
        container TcpIpIpV4Config [0..1]  # Specifies the configuration parameters of the IPv4 (Internet Protocol version 4) sub-module.
          container TcpIpArpConfig [0..*]  # Specifies the configuration parameters of the ARP (Address Resolution Protocol) sub-module.
            integer TcpIpArpMaxRequests [0..1]: 1..65535, origin=RB:42.4.3.0:2018-03-31, set at link in variant link-time+post-build / pre-compile in variant pre-compile  # RB (Vendor06) specific parameter: Maximum number of ARP requests that can be sent for a particular destination IP address. Suggested Default Value (1) | Note: Maximum number of ARP requests that are sent to resolve a particular destination IP. If ARP reply is not received, the ARP table entry would timeout. Its possible to restart Address resolution for an entry that has Timed Out. User may configure only one parameter out of TcpIpArpRequestTxTimeout and TcpIpArpMaxRequests as these features are mutually exclusive
            integer TcpIpArpNumGratuitousARPonStartup: 0..255, post-build-variant-value=true, set at link in variant link-time / post-build in variant post-build / pre-compile in variant pre-compile, default-value=1  # TcpIpArpNumGratuitousARPonStartup (Feature not supported) | Specifies the number of gratuitous ARP replies which shall be sent on assignment of a new IP address.
            boolean TcpIpArpPacketQueueEnabled [0..0]: set at pre-compile, default-value=false  # TcpIpArpPacketQueueEnabled (Currently Unused) | Enables (TRUE) or disables (FALSE) support of the ARP Packet Queue according to IETF RFC 1122, section 2.3.2.2. Parameter unused.
            float TcpIpArpRequestTxTimeout [0..1]: 0.0001..4294967.295, origin=RB:42.4.3.0:2018-03-31, post-build-variant-value=true, set at link in variant link-time / post-build in variant post-build / pre-compile in variant pre-compile  # TcpIpArpRequestTxTimeout (TcpIpArpTrialMax) | RB (Vendor06) specific parameter: Timeout in seconds after which an ECU stops sending ARP request. | Note: After configured timeout is elapsed ECU stops sending ARP request for the particular destination IP, if no reply is received, address resolution sequence will not be repeated for this remote IP afterwards. I.e. further transmit requests to this destination will be rejected. The ARP entry for this IP would be permanently occupied and never freed. User may configure only one parameter out of TcpIpArpRequestTxTimeout and TcpIpArpMaxRequests as these features are mutually exclusive
            float TcpIpArpTableEntryTimeout: 0..Inf, post-build-variant-value=true, set at link in variant link-time / post-build in variant post-build / pre-compile in variant pre-compile  # Timeout in seconds after which an unused ARP entry is removed.
            integer TcpIpArpTableSizeMax: 1..65535, set at link in variant link-time+post-build / pre-compile in variant pre-compile  # Maximum number of entries in the ARP table.
            float TcpIpArpTblPendingEntryTimeout [0..1]: 0.001..4294967.295, origin=RB:42.4.3.0:2018-03-31, post-build-variant-value=true, set at link in variant link-time / post-build in variant post-build / pre-compile in variant pre-compile, default-value=5  # TcpIpArpTblPendingEntryTimeout (ArpCycleTime) | RB (Vendor06) specific parameter: The Timeout in seconds after which ARP resends an ARP Request if ARP Reply was not received. The maximum number of ARP requests to be send before quitting the address resolution is governed by TcpIpArpMaxRequests or TcpIpArpRequestTxTimeout parameters.
            boolean TcpIpIpConflictDetectionArpFrames [0..1]: origin=RB:42.2.0.0:2017-01-30, set at pre-compile, default-value=true  # RB (Vendor06) Enables (TRUE) or disables (FALSE) IP conflict detection based on ARP frames. This parameter shall be enabled if Dhcp or AutoIp is configured, and may be disabled if only static IP addresses are used for in-vehicle communication.
            boolean TcpIpIpConflictDetectionIPv4Frames [0..1]: origin=RB:42.2.0.0:2017-01-30, set at pre-compile, default-value=false  # RB (Vendor06) Enables (TRUE) or disables (FALSE) IP conflict detection based on IPv4 frames. This parameter needs to be enabled only if IP conflict detection needs to be done on reception every IPv4 frame. This might be required to identify IP conflicts after some node has assigned same IP as the current node, but for some reason probing frame has not reached the current node (eg. link was down for the current node).
          container TcpIpAutoIpConfig [0..*]  # Specifies the configuration parameters of the Auto-IP (automatic private IP addressing) sub-module.
            float TcpIpAutoIpInitTimeout: 0..Inf, post-build-variant-value=true, set at link in variant link-time / post-build in variant post-build / pre-compile in variant pre-compile  # The time in seconds Auto-IP waits at startup, before beginning with ARP probing. This delay is used to give DHCP time to acquire a lease in case a DHCP server is present.
          container TcpIpDhcpConfig [0..0]  # TcpIpDhcpConfig (Currently Unused) | Specifies the configuration parameters of the DHCPv4. Configuration Parameter is not supported by Implementation. | This container may be referenced by multiple IPv4 instances if they shall use the same configuration. This container may have multiple instances if different configurations are required for different IPv4 instances.
          container TcpIpIcmpConfig [0..1]  # Specifies the configuration parameters of the ICMP (Internet Control Message Protocol) sub-module.
            integer TcpIpIcmpTtl: 0..255, post-build-variant-value=true, set at link in variant link-time / post-build in variant post-build / pre-compile in variant pre-compile  # Default Time-to-live value of outgoing ICMP packets. | This Time-To-Live value decides how long packet stays alive on network when destination is not reachable
            container TcpIpIcmpMsgHandler [0..1]  # This container is a subcontainer of TcpIpIcmpConfig and specifies the configuration parameters for the ICMP message handler.
              string TcpIpIcmpMsgHandlerHeaderFileName: set at link in variant link-time+post-build / pre-compile in variant pre-compile, max-length=32, min-length=1  # This parameter specifies the name of the header file containing the definition of the ICMP message handler function.
              function name TcpIpIcmpMsgHandlerName: set at link in variant link-time+post-build / pre-compile in variant pre-compile  # This parameter defines the name of the ICMP message handler function <User_IcmpMsgHandler>.
          container TcpIpIpFragmentationConfig [0..*]  # Specifies the configuration parameters of IPv4 packet fragmentation/reassembly. | This container may be referenced by multiple IPv4 instances if they shall use the same configuration. This container may have multiple instances if different configurations are required for different IPv4 instances.
            boolean TcpIpIpFragmentationRxEnabled [0..0]: set at pre-compile, default-value=false  # TcpIpIpFragmentationRxEnabled (Currently unused) | Enables (TRUE) or disables (FALSE) support for reassembling of incoming datagrams that are fragmented according to IETF RFC 815 (IP Datagram Reassembly Algorithms). Currently unused in Implementation
            integer TcpIpIpNumFragments [0..0]: 0..255, multiplicity set at link in variant link-time / post-build in variant post-build / pre-compile in variant pre-compile, post-build-variant-multiplicity=true, post-build-variant-value=true, set at link in variant link-time / post-build in variant post-build / pre-compile in variant pre-compile, default-value=0  # TcpIpIpNumFragments (Currently unused) | Specifies the maximum number of IP fragments per datagram. Currently unused in Implementation. | Note: this parameter is only relevant if TcpIpIpFragmentationRxEnabled is TRUE.
            integer TcpIpIpNumReassDgrams [0..0]: 0..65535, multiplicity set at link in variant link-time / post-build in variant post-build / pre-compile in variant pre-compile, post-build-variant-multiplicity=true, post-build-variant-value=true, set at link in variant link-time / post-build in variant post-build / pre-compile in variant pre-compile, default-value=3  # TcpIpIpNumReassDgrams (Currently unused) | Specifies the maximum number of fragmented IP datagrams that can be reassembled in parallel. Currently unused in Implementation. | Note: this parameter is only relevant if TcpIpIpFragmentationRxEnabled is TRUE.
            float TcpIpIpReassTimeout [0..1]: 0.001..120, multiplicity set at link in variant link-time / post-build in variant post-build / pre-compile in variant pre-compile, post-build-variant-multiplicity=true, post-build-variant-value=true, set at link in variant link-time / post-build in variant post-build / pre-compile in variant pre-compile  # Specifies the timeout in [s] after which an incomplete datagram gets discarded. RFC 1122 recommends the value to be in between 60 seconds and 120 seconds. | Note: This parameter is only relevant if TcpIpIpReassemblyBufferCount is configured to a value greater than zero.
            integer TcpIpIpReassemblyBufferCount: 0..255, origin=RB:42.2.0.0:2017-01-30, set at pre-compile, default-value=1  # RB (Vendor06) specific parameter: Number of buffers that can be used for fragment reassembly. A value of 0 disables fragment reassembly. | For all the fragments of a particular quadruple (source IP, destination IP, frame identifier and protocol) only one buffer will be allocated during reassembly. And hence value of the parameter specifies the maximum number of parallel reassembly operations possible for different quadruples.
            integer TcpIpIpReassemblyBufferSize [0..1]: 576..65535, multiplicity set at pre-compile, origin=RB:42.2.0.0:2017-01-30, set at pre-compile  # RB (Vendor06) specific parameter: The parameter specifies size of the buffer in bytes required to reassemble all the fragments of an original frame. Expected value here corresponds to only IPv4 payload size before frame undergoing fragmentation. | Note: This parameter is only relevant if TcpIpIpReassemblyBufferCount is configured to a value greater than zero.
            integer TcpIpIpTxFragmentBufferSize [0..1]: origin=RB:42.1.2.0:2016-08-12, set at pre-compile  # RB (Vendor06) specific parameter: Specifies the fragmentation buffer size in terms of bytes for the controller. If the fragmentation needs to be disabled for the controller the parameter shall not be configured.
        container TcpIpIpV6Config [0..1]  # Specifies the configuration parameters of the IPv6 (Internet Protocol version 6) sub-module. This is not supported in present implementation and hence not to be configured.
          container TcpIpDhcpV6Config [0..0]  # TcpIpDhcpV6Config (Currently Unused) | Specifies the configuration parameters of the DHCPv6. | This container may be referenced by multiple IPv6 instances if they shall use the same configuration. This container may have multiple instances if different configurations are required for different IPv6 instances.
            float TcpIpDhcpV6CnfDelayMax: 0..100, set at pre-compile, default-value=1  # Maximum delay (s) before sending the first Confirm message. If this value is bigger than the previous minimum delay value a random delay will be chosen from the interval.
            float TcpIpDhcpV6CnfDelayMin: 0..100, set at pre-compile, default-value=0  # Minimum delay (s) before the first Confirm message will be sent.
            float TcpIpDhcpV6InfDelayMax: 0..100, set at pre-compile, default-value=1  # Maximum delay (s) before sending the first Information Request message. If this value is bigger than the previous minimum delay value a random delay will be chosen from the interval.
            float TcpIpDhcpV6InfDelayMin: 0..100, set at pre-compile, default-value=0  # Minimum delay (s) before the first Information Request message will be sent.
            float TcpIpDhcpV6SolDelayMax: 0..100, set at pre-compile, default-value=1  # Maximum delay (s) before sending the first Solicit message. If this value is bigger than the previous minimum delay value a random delay will be chosen from the interval.
            float TcpIpDhcpV6SolDelayMin: 0..100, set at pre-compile, default-value=0  # Minimum delay (s) before the first Solicit message will be sent.
          container TcpIpIcmpV6Config  # Specifies the configuration parameters of the ICMPv6 (Internet Control Message Protocol for IPv6) sub-module.
            integer TcpIpIcmpV6EchoDataBufferSize: 0..1452, set at pre-compile, default-value=64  # Configure the maximum amount of arbitrary data that will be sent back to the sender of an echo request. If the arbitrary data of an incoming echo request is bigger than configured here, the response payload will be truncated.
            boolean TcpIpIcmpV6EchoReplyEnabled: set at pre-compile, default-value=false  # If enabled, the stack will respond to incoming ICMPv6 Echo Requests (Pings).
            integer TcpIpIcmpV6HopLimit: 0..255, post-build-variant-value=true, set at link in variant link-time / post-build in variant post-build / pre-compile in variant pre-compile  # Default Hop-Limit value of outgoing ICMPv6 packets.
            boolean TcpIpIcmpV6MsgDestinationUnreachableEnabled: set at pre-compile  # Dis/Enables transmission of Destination Unreachable Messages.
            boolean TcpIpIcmpV6MsgParameterProblemEnabled: set at pre-compile, default-value=true  # If enabled an ICMPv6 parameter problem message will be sent if a received packet has been dropped due to unknown options or headers that are found in the packet. | [RFC2460 4. IPv6 Extension Headers]
            container TcpIpIcmpV6MsgHandler [0..1]  # This container is a subcontainer of TcpIpIcmpConfig and specifies the configuration parameters for the ICMPv6 message handler.
              string TcpIpIcmpV6MsgHandlerHeaderFileName: set at link in variant link-time+post-build / pre-compile in variant pre-compile, max-length=32, min-length=1  # This parameter specifies the name of the header file containing the definition of the ICMPv6 message handler function.
              function name TcpIpIcmpV6MsgHandlerName: set at link in variant link-time+post-build / pre-compile in variant pre-compile  # This parameter defines the name of the ICMP message handler function <User_IcmpMsgHandler>.
          container TcpIpIpV6FragmentationConfig [0..0]  # TcpIpIpV6FragmentationConfig (Currently Unused) | Specifies the configuration parameters of IPv6 packet fragmentation/reassembly. | This container may be referenced by multiple IPv6 instances if they shall use the same configuration. This container may have multiple instances if different configurations are required for different IPv6 instances.
            integer TcpIpIpV6ReassemblyBufferCount: 0..255, set at pre-compile, default-value=2  # Number of buffers that can be used for fragment reassembly. In case of a reassembly error or if not all fragments are received in time this buffer will be blocked until the specified "Fragment Reassembly Timeout" has been exceeded. | A value of 0 disables fragment reassembly. [RFC2460 5. Packet Size Issues] "In order to send a packet larger than a path's MTU, a node may use the IPv6 Fragment header to fragment the packet at the source and have it reassembled at the destination(s). However, the use of such fragmentation is discouraged in any application that is able to adjust its packets to fit the measured path MTU (i.e., down to 1280 octets)."
            integer TcpIpIpV6ReassemblyBufferSize [0..1]: 1500..65535, multiplicity set at pre-compile, set at pre-compile, default-value=1500  # [RFC2460 5. Packet Size Issues] | "A node must be able to accept a fragmented packet that, after reassembly, is as large as 1500 octets. A node is permitted to accept fragmented packets that reassemble to more than 1500 octets."the measured path MTU (i.e., down to 1280 octets)."
            integer TcpIpIpV6ReassemblySegmentCount [0..1]: 255..1, multiplicity set at pre-compile, set at pre-compile, default-value=5  # Specifies the maximum number of consecutive data segments that can be managed in each reassembly buffer. If all fragments are received in order, only one segment will be needed. | To deal with fragments received out of order this value should be configured bigger than 1.
            float TcpIpIpV6ReassemblyTimeout [0..1]: 0.001..100, multiplicity set at pre-compile, set at pre-compile, default-value=60  # [RFC2460 4.5 Fragment Header] | Default: 60 seconds
            integer TcpIpIpV6TxFragmentBufferCount: 1..1000, set at pre-compile, default-value=2  # These buffers will be used if the IpV6 receives packets from the upper layer that do not fit into the MTU and thus must be fragmented. | A value of 0 disables tx fragmentation. If the upper layer transmits packets that do not fit into the link or path MTU, the IpV6 will split-up the packet into fragments. see "Enable Fragment Reassembly"
            integer TcpIpIpV6TxFragmentBufferSize [0..1]: 1500..65535, multiplicity set at pre-compile, set at pre-compile, default-value=1500  # Size of each fragment tx buffer in bytes
          container TcpIpNdpConfig [1..*]  # Specifies the configuration parameters of the Neighbor Discovery Protocol for IPv6 | This container may be referenced by multiple IPv6 instances if they shall use the same configuration. This container may have multiple instances if different configurations are required for different IPv6 instances.
            container TcpIpNdpArNudConfig [0..1]  # Specifies the configuration parameters for NDP Address Resolution and Neighbor Unreachability Detection.
              float TcpIpNdpDefaultReachableTime: 0..120, set at pre-compile, default-value=30  # Configuration of the ReachableTime (s) specified in [RFC4861 6.3.2. Host Variables]. | "The time a neighbor is considered reachable after receiving a reachability confirmation." If "TcpIpNdpDynamicReachableTimeEnabled" is checked, this value may be reconfigured based on received Router Advertisements. Default: REACHABLE_TIME = 30 seconds
              integer TcpIpNdpDefaultRefreshTimeStaticRtr: 0..60, origin=RB:AR42.4.0.0:2017-12-12, set at pre-compile, default-value=1  # The refresh time of the Default Router for all the Static TcpIp Local IPv6 Address configurations containers. The value of this parameter is interpreted in number of seconds.
              float TcpIpNdpDefaultRetransTimer: 0..60, set at pre-compile, default-value=1  # Configures the default value (s) for the RetransTimer variable specified in [RFC4861 6.3.2. Host Variables]. | "The time between retransmissions of Neighbor Solicitation messages to a neighbor when resolving the address or when probing the reachability of a neighbor." If "TcpIpNdpDynamicRetransTimeEnabled" is checked, this value may be reconfigured based on received Router Advertisements. Default: RETRANS_TIMER = 1 second
              float TcpIpNdpDelayFirstProbeTime [0..0]: 0..60, set at pre-compile, default-value=5  # TcpIpNdpDelayFirstProbeTime (Currently Unused) | Delay before sending the first NUD probe in (s). | [RFC4861 7.3.3. Node Behavior] Default: DELAY_FIRST_PROBE_TIME = 5 seconds
              integer TcpIpNdpMaxNeighborCacheSize: 1..254, set at pre-compile, default-value=5  # Maximum number of entries in the neighbor cache. | [RFC4861 5.1. Conceptual Data Structures]
              integer TcpIpNdpMaxRandomFactor [0..0]: 0..100, set at pre-compile, default-value=15  # TcpIpNdpMaxRandomFactor (Currently Unused) | Maximum random factor used for randomization | [RFC4861 10. Protocol Constants] Default: 15 (MAX_RANDOM_FACTOR = 1.5)
              integer TcpIpNdpMinRandomFactor [0..0]: 0..100, set at pre-compile, default-value=5  # TcpIpNdpMinRandomFactor (Currently Unused) | Minimum random factor used for randomization | [RFC4861 10. Protocol Constants] Default: 5 (MIN_RANDOM_FACTOR = 0.5)
              boolean TcpIpNdpNeighborUnreachabilityDetectionEnabled: set at pre-compile, default-value=true  # Neighbor Unreachability Detection is used to remove unused entries from the neighbor cache. This feature is a basic feature of NDP and should be turned on.
              integer TcpIpNdpNumMulticastSolicitations: 0..255, set at pre-compile, default-value=3  # Maximum number of multicast solicitations that will be sent when performing address resolution. | [RFC4861 7.2.2. Sending Neighbor Solicitations] Default: MAX_MULTICAST_SOLICIT = 3
              integer TcpIpNdpNumUnicastSolicitations: 0..255, set at pre-compile, default-value=3  # Maximum number of unicast solicitations that will be sent when performing Neighbor Unreachability Detection. | [RFC4861 7.3.3. Node Behavior] Default: MAX_UNICAST_SOLICIT = 3
              boolean TcpIpNdpPacketQueueEnabled: set at pre-compile, default-value=true  # Enables (TRUE) or disables (FALSE) support of a NDP Packet Queue according to IETF RFC 4861, section 7.2.2.
              boolean TcpIpNdpRandomReachableTimeEnabled: set at pre-compile, default-value=true  # If enabled the value of ReachableTime will be multiplied with a random value between MIN_RANDOM_FACTOR and MAX_RANDOM_FACTOR in order to prevent multiple nodes from transmitting at exactly the same time | [RFC4861 6.3.2. Host Variables / ReachableTime]
            container TcpIpNdpPrefixRouterDiscoveryConfig [0..1]  # Specifies the configuration parameters for NDP Prefix and Router Discovery.
              integer TcpIpNdpDefaultRouterListSize: 2..254, set at pre-compile, default-value=2  # Maximum number of default router entries. | [RFC4861 5.1. Conceptual Data Structures]
              integer TcpIpNdpDestinationCacheSize: 1..254, set at pre-compile, default-value=5  # Maximum number of entries in the destination cache. | [RFC4861 5.1. Conceptual Data Structures]
              boolean TcpIpNdpDynamicHopLimitEnabled: set at pre-compile, default-value=true  # If enabled the default hop limit may be reconfigured based on received Router Advertisements. | [RFC4861 6.3.4. Processing Received Router Advertisements]
              boolean TcpIpNdpDynamicMtuEnabled: set at pre-compile, default-value=false  # Allow dynamic reconfiguration of link MTU via Router Advertisements. | [RFC4861 4.6.4. MTU]
              boolean TcpIpNdpDynamicReachableTimeEnabled: set at pre-compile, default-value=true  # If enabled the default Reachable Time value may be reconfigured based on received Router Advertisements. | [RFC4861 6.3.4. Processing Received Router Advertisements] Default: Enabled
              boolean TcpIpNdpDynamicRetransTimeEnabled: set at pre-compile, default-value=true  # If enabled the default Retransmit Timer value may be reconfigured based on received Router Advertisements. | [RFC4861 6.3.4. Processing Received Router Advertisements] Default: Enabled
              float TcpIpNdpMaxRtrSolicitationDelay [0..0]: 0.001..60, set at pre-compile, default-value=1  # TcpIpNdpMaxRtrSolicitationDelay (Currently Unused) | Maximum delay before the first Router Solicitation will be sent after interface initialization in (s). | [RFC4861 6.3.7. Sending Router Solicitations] Default: MAX_RTR_SOLICITATION_DELAY = 1 second
              integer TcpIpNdpMaxRtrSolicitations [0..0]: 0..255, set at pre-compile, default-value=3  # TcpIpNdpMaxRtrSolicitations (Currently Unused) | Maximum number of Router Solicitations that will be sent before the first Router Advertisement has been received. | 0 = No Router Solicitations will be sent. This has no impact on handling Router Advertisements. [RFC4861 6.3.7. Sending Router Solicitations] Default: MAX_RTR_SOLICITATIONS = 3 transmissions
              integer TcpIpNdpPrefixListSize: 1..254, set at pre-compile, default-value=5  # Maximum number of entries in the on-link prefix list. | [RFC4861 5.1. Conceptual Data Structures]
              boolean TcpIpNdpRndRtrSolicitationDelayEnabled: set at pre-compile, default-value=true  # If enabled the first router solicitation will be delayed randomly from [0...MAX_RTR_SOLICITATION_DELAY]. Otherwise the first router solicitation will be sent after exactly MAX_RTR_SOLICITATION_DELAY milliseconds. | [RFC4861 6.3.7. Sending Router Solicitations] Default: Enabled
              float TcpIpNdpRtrSolicitationInterval [0..0]: 0.001..60, set at pre-compile, default-value=4  # TcpIpNdpRtrSolicitationInterval (Currently Unused) | Interval between consecutive Router Solicitations in (s). | [RFC4861 6.3.7. Sending Router Solicitations] Default: RTR_SOLICITATION_INTERVAL = 4 seconds
            container TcpIpNdpSlaacConfig [0..0]  # TcpIpNdpSlaacConfig (Currently Unused) | Specifies the configuration parameters for StateLess Address AutoConfiguration.
              integer TcpIpNdpSlaacDadNumberOfTransmissions: 0..254, set at pre-compile, default-value=1  # Number of Neighbor Solicitations that have to be unanswered in order to set an autoconfigurated address to PREFERRED (usable) state. | [RFC4861 5.1. Node Configuration Variables] Default: DupAddrDetectTransmits = 1 Setting this value to 0 turns off DAD.
              float TcpIpNdpSlaacDadRetransmissionDelay: 0..10, set at pre-compile, default-value=1  # Sets the maximum value for the address configuration delay (s). | According to [RFC4861 5.4.2. Sending Neighbor Solicitation Messages] this value should be the same as MAX_RTR_SOLICITATION_DELAY. Default: MAX_RTR_SOLICITATION_DELAY = 1 second
              boolean TcpIpNdpSlaacDelayEnabled: set at pre-compile, default-value=false  # If enabled transmission of the first DAD Neighbor Solicitation will be delayed by a random value from [0...MAX_DAD_DELAY]. | "This serves to alleviate congestion when many nodes start up on the link at the same time, such as after a power failure, and may help to avoid race conditions when more than one node is trying to solicit for the same address at the same time." "The delay will avoid similar congestion when multiple nodes are going to configure addresses by receiving the same single multicast router advertisement." [RFC4861 5.4.2. Sending Neighbor Solicitation Messages] Default: True
              boolean TcpIpNdpSlaacOptimisticDadEnabled: set at pre-compile, default-value=false  # Enable Optimistic Duplicate Address Detection (DAD) according to RFC4429.
      container TcpIpLocalAddr [1..*]  # Specifies the local IP (Internet Protocol) addresses used for IP communication.
        integer TcpIpAddrId: 0..254, scope=ECU, set at pre-compile, symbolic-name-value=true, with-auto=true  # TcpIpAddrId (Automatically generated) | IP address table identifier assigned by TCP/IP stack.
        enumeration TcpIpAddressType: {TCPIP_MULTICAST, TCPIP_UNICAST}, post-build-variant-value=true, set at link in variant link-time / post-build in variant post-build / pre-compile in variant pre-compile  # Address type. | Address type indentifies whether IP address is unicast or multicast address. Valid range for multicast IP is 224.0.0.0 to 239.255.255.255. No Unicast IP should be configured in that range. With Multicast, TcpIpAssignmentMethod shall be TCPIP_STATIC
        enumeration TcpIpDomainType: {TCPIP_AF_INET, TCPIP_AF_INET6}, post-build-variant-value=true, set at link in variant link-time / post-build in variant post-build / pre-compile in variant pre-compile  # Address family. | When address family is TCPIP_AF_INET, TcpIpIpV4Ctrl container for the referenced TcpIpCtrl shall be configured and for TCPIP_AF_INET_6, TcpIpIpV6Ctrl container for the referenced TcpIpCtrl shall be configured
        reference TcpIpCtrlRef: post-build-variant-value=true, set at link in variant link-time / post-build in variant post-build / pre-compile in variant pre-compile, destination=TcpIpCtrl  # Reference to a TcpIpCtrl specifying the EthIf Controller where the IP address shall be assigned and DEM errors that shall be reported in case of an error on this controller.
        container TcpIpAddrAssignment [1..*]  # This container is a subcontainer of TcpIpLocalAddr and specifies the assignment policy for the IP address.
          enumeration TcpIpAssignmentLifetime [0..0]: {TCPIP_FORGET, TCPIP_STORE}, post-build-variant-value=true, set at link in variant link-time / post-build in variant post-build / pre-compile in variant pre-compile, default-value=TCPIP_FORGET  # TcpIpAssignmentLifetime (Currently Unused) | Defines the lifetime of a dynamically fetched IP address. Parameter unused. | If TcpIpAssignmentMethod = TCPIP_STATIC then TcpIpAssignmentLifetime shall be omitted.
          enumeration TcpIpAssignmentMethod: {TCPIP_DHCP, TCPIP_LINKLOCAL, TCPIP_LINKLOCAL_DOIP, TCPIP_STATIC}, post-build-variant-value=true, set at link in variant link-time / post-build in variant post-build / pre-compile in variant pre-compile  # Method of address assignment | TCPIP_DHCP is dynamic ip address assignment based on Dhcp protocol, TCPIP_LINKLOCAL and TCPIP_LINKLOCAL_DOIP are based on AutoIp which dynamically assigns IP address in range of (169.254.1.0 to 169.254.254.255) and TCPIP_STATIC is for static ip address assignment where address is decided at configuration time if trigger is TCPIP_AUTOMATIC and if trigger is TCPIP_MANUAL then TcpIp_RequestIpAddrAssignment api does the assignment.
          integer TcpIpAssignmentPriority: 1..3, post-build-variant-value=true, set at link in variant link-time / post-build in variant post-build / pre-compile in variant pre-compile  # Priority of assignment (1 is highest). If a new address from an assignment method with a higher priority is available, it overwrites the IP address previously assigned by an assignment method with a lower priority.
          enumeration TcpIpAssignmentTrigger: {TCPIP_AUTOMATIC, TCPIP_MANUAL}, post-build-variant-value=true, set at link in variant link-time / post-build in variant post-build / pre-compile in variant pre-compile  # Trigger of address assignment. | In TCPIP_AUTOMATIC trigger method assignment shall be initiated automatically by TCP/IP stack. TCPIP_MANUAL assignment shall be initiated manually via TcpIp_RequestIpAddrAssignment() api.
        container TcpIpStaticIpAddressConfig [0..1]  # This container is a subcontainer of TcpIpLocalAddr and specifies a static IP address including directly related parameters.
          string TcpIpDefaultRouter [0..1]: multiplicity set at link in variant link-time / post-build in variant post-build / pre-compile in variant pre-compile, post-build-variant-multiplicity=true, post-build-variant-value=true, set at link in variant link-time / post-build in variant post-build / pre-compile in variant pre-compile  # IP address of default router (gateway) | DefaultRouter shall not be configured for multicast address.
          integer TcpIpNetmask [0..1]: 0..128, multiplicity set at link in variant link-time / post-build in variant post-build / pre-compile in variant pre-compile, post-build-variant-multiplicity=true, post-build-variant-value=true, set at link in variant link-time / post-build in variant post-build / pre-compile in variant pre-compile  # Network mask of IPv4 address or address prefix of IPv6 address in CIDR Notation, i.e. decimal value between 0 and 32 (IPv4) or 0 and 128 (IPv6) that describes the number of significant bits defining the network number or prefix of an IP address. | Netmask is mandatory if TcpIpAssignmentMethod is configured as TCPIP_STATIC, TcpIpAssignmentTrigger is configured as TCPIP_AUTOMATIC, and TcpIpAddressType is configured as TCPIP_UNICAST. Netmask shall not be configured for multicast address.
          string TcpIpStaticIpAddress: post-build-variant-value=true, set at link in variant link-time / post-build in variant post-build / pre-compile in variant pre-compile  # Static IP Address. | Static IP address is mandatory if TcpIpAssignmentMethod is configured as TCPIP_STATIC,TcpIpAssignmentTrigger is configured as TCPIP_AUTOMATIC and TcpIpAddressType is configured as TCPIP_UNICAST. To specify any IP address for a certain EthIfCtrl, "ANY" has to be set as wildcard. See TcpIp_Bind() for more details.
      container TcpIpNvmBlock [0..0]: multiplicity set at link in variant link-time+post-build / pre-compile in variant pre-compile  # TcpIpNvmBlock (Currently Unused) | Configuration of optional usage of Nvm in case the TcpIp module requires non volatile memory in the Ecu to store information (e.g. IP Address received via DHCP and shall be stored). Configuration parameter not supported in implementation.
        symbolic name reference TcpIpNvmBlockDescriptorRef: scope=ECU, set at link in variant link-time+post-build / pre-compile in variant pre-compile, destination=NvMBlockDescriptor  # Reference to the Nvm block description in the Nvm module configuration.
      container TcpIpPhysAddrConfig [0..0]  # TcpIpPhysAddrConfig (Currently Unused) | Specifies the physical address configuration. Configuration not supported in implementation.
        container TcpIpPhysAddrChgHandler [0..1]  # This container is a subcontainer of TcpIpPhysAddrConfig and | specifies the configuration parameters for physical address change handler.
          string TcpIpPhysAddrChgHandlerHeaderFileName: set at link in variant link-time+post-build / pre-compile in variant pre-compile, max-length=32, min-length=1  # This parameter specifies the name of the header file containing the definition of the physical address change handler function.
          function name TcpIpPhysAddrChgHandlerName: scope=ECU, set at pre-compile  # This parameter defines the name of the physical address change function <Up>_PhysAddrTableChg.
      container TcpIpSocketOwnerConfig  # Specifies the upper layer modules of TcpIp using the socket API.
        container TcpIpSocketOwner [1..*]  # This container is a subcontainer of TcpIpSocketOwnerConfig and specifies an upper layer of TcpIp that uses the socket API.
          function name TcpIpSocketOwnerCopyTxDataName [0..1]: set at link in variant link-time+post-build / pre-compile in variant pre-compile  # This parameter defines the name of the <Up_CopyTxData> function of the TcpIpSocketOwner module. The function name shall only be configurable if TcpIpSocketOwnerUpperLayerType is set to CDD.
          string TcpIpSocketOwnerHeaderFileName [0..1]: set at link in variant link-time+post-build / pre-compile in variant pre-compile  # This parameter specifies the name of the header file containing the definition of the TcpIpSocketOwner module functions. The header file name shall only be configurable if TcpIpSocketOwnerUpperLayerType is set to CDD.
          function name TcpIpSocketOwnerLocalIpAddrAssignmentChgName [0..1]: set at link in variant link-time+post-build / pre-compile in variant pre-compile  # This parameter defines the name of the <Up_LocalIpAddrAssignmentChg> function of the TcpIpSocketOwner module. The function name shall only be configurable if TcpIpSocketOwnerUpperLayerType is set to CDD.
          function name TcpIpSocketOwnerRxIndicationName [0..1]: set at link in variant link-time+post-build / pre-compile in variant pre-compile  # This parameter defines the name of the <Up_RxIndication> function of the TcpIpSocketOwner module. The function name shall only be configurable if TcpIpSocketOwnerUpperLayerType is set to CDD.
          function name TcpIpSocketOwnerTcpAcceptedName [0..1]: set at link in variant link-time+post-build / pre-compile in variant pre-compile  # This parameter defines the name of the <Up_TcpAccepted> function of the TcpIpSocketOwner module. The function name shall only be configurable if TcpIpSocketOwnerUpperLayerType is set to CDD.
          function name TcpIpSocketOwnerTcpConnectedName [0..1]: set at link in variant link-time+post-build / pre-compile in variant pre-compile  # This parameter defines the name of the <Up_TcpConnected> function of the TcpIpSocketOwner module. The function name shall only be configurable if TcpIpSocketOwnerUpperLayerType is set to CDD.
          function name TcpIpSocketOwnerTcpIpEventName [0..1]: set at link in variant link-time+post-build / pre-compile in variant pre-compile  # This parameter defines the name of the <Up_TcpIpEvent> function of the TcpIpSocketOwner module. The function name shall only be configurable if TcpIpSocketOwnerUpperLayerType is set to CDD.
          function name TcpIpSocketOwnerTxConfirmationName [0..1]: set at link in variant link-time+post-build / pre-compile in variant pre-compile  # This parameter defines the name of the <Up_TxConfirmation> function of the TcpIpSocketOwner module. The function name shall only be configurable if TcpIpSocketOwnerUpperLayerType is set to CDD.
          enumeration TcpIpSocketOwnerUpperLayerType: {CDD, SOAD}, post-build-variant-value=true, set at link in variant link-time / post-build in variant post-build / pre-compile in variant pre-compile  # This parameter specifies the type of the upper layer module. | SoAd can not be configured as upper layer for more than 1 time. All the configuration parameters specifying the name of the callback function should not be configured for SoAd
      container TcpIpTcpConfig [0..1]  # Specifies the configuration parameters of the TCP (Transmission Control Protocol) sub-module.
        boolean TcpIpTcpCongestionAvoidanceEnabled: set at pre-compile  # Enables (TRUE) or disables (FALSE) support of TCP congestion avoidance algorithm according to IETF RFC 5681.
        boolean TcpIpTcpDlyAckEnabled [0..1]: origin=RB:42.0.3.0:2016-03-25, set at pre-compile, default-value=false  # RB (Vendor06) specific parameter: Enables (TRUE) or disables (FALSE) support of Delayed Ack feature. | Note: If the parameter is enabled the acknowledgments sent to the remote shall be delayed by 200ms or ACK responses shall be sent after two MSS.
        boolean TcpIpTcpDynReTxTimerEnabled [0..1]: origin=RB:42.0.3.0:2016-03-25, set at pre-compile, default-value=false  # RB (Vendor06) specific parameter: Enables (TRUE) or disables (FALSE) use of TCP Dynamic ReTx Timer. | Note: If the parameter is enabled the Retransmission Timeout shall be calculated dynamically according to the time the remote acknowledge data segments(RTT). Dependency: TcpIpTcpReTxEnabled.
        float TcpIpTcpDynReTxTimerUprBound [0..1]: 1..INF, origin=RB:42.0.3.0:2016-03-25, post-build-variant-value=true, set at link in variant link-time / post-build in variant post-build / pre-compile in variant pre-compile, default-value=INF  # RB (Vendor06) specific parameter: Upper bound of Timeout in [s] when Retransmission TimeOut is calculated dynamically . | Note: This parameter specifies the maximum limit that shall be used during computing of dynamic retransmission timeout (from RTT or exponential backoff). Default: INF is used when parameter is disabled Dependency: TcpIpTcpDynReTxTimerEnabled
        boolean TcpIpTcpFastRecoveryEnabled: set at pre-compile  # Enables (TRUE) or disables (FALSE) support of TCP Fast Recovery according to IETF RFC 5681.
        boolean TcpIpTcpFastRetransmitEnabled: set at pre-compile  # Enables (TRUE) or disables (FALSE) support of TCP Fast Retransmission according to IETF RFC 5681.
        float TcpIpTcpFinWait2Timeout: 0..INF, post-build-variant-value=true, set at link in variant link-time / post-build in variant post-build / pre-compile in variant pre-compile  # Timeout in [s] to receive a FIN from the remote node (after this node has initiated connection termination), i.e. maximum time waiting in FINWAIT-2 for a connection termination request from the remote TCP.
        boolean TcpIpTcpHalfDuplxCloseEnabled [0..1]: origin=RB:42.0.3.0:2016-03-25, set at pre-compile, default-value=false  # RB (Vendor06) specific parameter: Enables (TRUE) or disables (FALSE) Implementation of Half Duplex Close as per RFC 1122 | Note: If the parameter is enabled the Half Duplex Close feature is activated which shall send a reset segment if Close call was requested and new data is received.
        enumeration TcpIpTcpIsnGenerationMethod [0..1]: {PSEUDO_RANDOM, CLOCK_DRIVEN, CLOCK_HASH_BASED}, origin=RB:AR42.0.6.0:2016-06-03, set at pre-compile, default-value=PSEUDO_RANDOM  # RB (Vendor06) specific parameter: Specify how the Initial Sequence Number should be generated. | Note: PSEUDO_RANDOM : The Initial Sequence Number is generated pseudo randomly (resource efficient, this method is not secure and does not respect RFC793 and RFC1122 assumption) CLOCK_DRIVEN : The Initial Sequence Number is chosen based on clock driven selection (resource efficient, this method is not secure but respect RFC793 and RFC1122 assumption) CLOCK_HASH_BASED : The Initial Sequence Number is chosen using clock and MD4 hash as per RFC6528 (higher resource consumption, this method is more secure) Default: PSEUDO_RANDOM is used when parameter is disabled
        boolean TcpIpTcpKeepAliveEnabled: set at pre-compile, default-value=false  # Enables (TRUE) or disables (FALSE) TCP Keep Alive Probes according to IETF RFC 1122 chapter 4.2.3.6
        float TcpIpTcpKeepAliveInterval: 0..INF, post-build-variant-value=true, set at link in variant link-time / post-build in variant post-build / pre-compile in variant pre-compile  # Specifies the interval in [s] between subsequent keepalive probes. | Dependency: TcpIpTcpKeepAliveEnabled
        integer TcpIpTcpKeepAliveProbesMax: 0..65535, post-build-variant-value=true, set at link in variant link-time / post-build in variant post-build / pre-compile in variant pre-compile  # Maximum number of times that a TCP Keep Alive is retransmitted before the connection is closed. | Dependency: TcpIpTcpKeepAliveEnabled
        float TcpIpTcpKeepAliveTime: 0..INF, post-build-variant-value=true, set at link in variant link-time / post-build in variant post-build / pre-compile in variant pre-compile, default-value=7200  # Specifies the time in [s] between the last data packet sent (simple ACKs are not considered data) and the first keepalive probe. | Note: Setting this configuration parameter to a value smaller or equal to the value of TcpIpMainFunctionPeriod results in the transmission of keep alive probes within every MainFunction cycle. Dependency: TcpIpTcpKeepAliveEnabled
        boolean TcpIpTcpMSSEnabled [0..1]: origin=RB:42.0.3.0:2016-03-25, set at pre-compile, default-value=false  # RB (Vendor06) specific parameter: Enables (TRUE) or disables (FALSE) support of TCP Maximum Segment Size option. | Note: If the parameter is enabled the Maximum Segment Size permitted on reception shall be advertised to the remote within SYN or SYN-ACK segments (MSS option).
        integer TcpIpTcpMaxRtx [0..1]: 0..255, post-build-variant-value=true, set at link in variant link-time / post-build in variant post-build / pre-compile in variant pre-compile  # Maximum number of times that a TCP segment is retransmitted before the TCP connection is closed. This parameter is only valid if TcpIpTcpRetransmissionTimeout is configured. | Note: This parameter also applies for FIN retransmissions. Default: 255 is used when parameter is disabled Dependency: TcpIpTcpReTxEnabled
        integer TcpIpTcpMaxTxBuffPerSock [0..1]: 0..65535, origin=RB:42.0.3.0:2016-03-25, set at pre-compile, default-value=4096  # RB (Vendor06) specific parameter: Maximum size of TCP Tx window buffer allocated per TCP socket. | Note: This parameter specifies the size of the Tcp Tx Buffer per socket that shall be used to store the data before transmission.
        float TcpIpTcpMsl: 0..INF, post-build-variant-value=true, set at link in variant link-time / post-build in variant post-build / pre-compile in variant pre-compile  # Maximum segment lifetime in [s]. | Note: TIME-WAIT = 2 x TcpIpTcpMsl - to ensure that the remote node received the acknowledgment to its connection termination request.
        boolean TcpIpTcpNagleEnabled: set at pre-compile  # Enables (TRUE) or disables (FALSE) support of Nagle's algorithm according to IETF RFC 896. If enabled the Nagle's algorithm is activated per default for all TCP sockets, but can be deactivated via TcpIp_ChangeParameter() API.
        boolean TcpIpTcpReTxEnabled [0..1]: origin=RB:42.2.0.0:2017-01-19, set at pre-compile, default-value=false  # RB (Vendor06) specific parameter: Enables (TRUE) or disables (FALSE) support of Retransmission feature. | Note: If the parameter is enabled the retransmissions of Tcp segments (SYN, DATA, FIN-ACK(1st packet of close sequence)) shall be possible.
        integer TcpIpTcpReceiveWindowMax: 0..65535, post-build-variant-value=true, set at link in variant link-time / post-build in variant post-build / pre-compile in variant pre-compile  # Default value of maximum receive window in bytes.
        float TcpIpTcpRetransmissionTimeout [0..1]: 0.001..INF, post-build-variant-value=true, set at link in variant link-time / post-build in variant post-build / pre-compile in variant pre-compile  # Timeout in [s] before an unacknowledged TCP segment is sent again. | Note: If the timeout is disabled or set to INF, no TCP segments shall be retransmitted. Default: INF is used when parameter is disabled Dependency: TcpIpTcpReTxEnabled
        boolean TcpIpTcpSlowStartEnabled: set at pre-compile  # Enables (TRUE) or disables (FALSE) support of TCP slow start algorithm according to IETF RFC 5681.
        integer TcpIpTcpSynMaxRtx: 0..255, post-build-variant-value=true, set at link in variant link-time / post-build in variant post-build / pre-compile in variant pre-compile  # Maximum number of times that a TCP SYN is retransmitted. | Note: SYN will be retried after TcpIpTcpRetransmissionTimeout. The connection will be dropped if no matching connection request has been received after the last TCP SYN has been sent and TcpIpTcpRetransmissionTimeout has been expired. Dependency: TcpIpTcpReTxEnabled
        float TcpIpTcpSynReceivedTimeout: 0..INF, post-build-variant-value=true, set at link in variant link-time / post-build in variant post-build / pre-compile in variant pre-compile  # Timeout in [s] to complete a remotely initiated TCP connection establishment, i.e. maximum time waiting in SYN-RECEIVED for a confirming connection request acknowledgment after having both received and sent a connection request.
        integer TcpIpTcpTtl: 0..255, post-build-variant-value=true, set at link in variant link-time / post-build in variant post-build / pre-compile in variant pre-compile  # Default Time-to-live value of outgoing TCP packets. | This Time-To-Live value decides how long TCP packet stays alive on network when destination is unreachable.
        float TcpIpTcpUserTimeout [0..1]: 0..INF, origin=RB:42.0.3.0:2016-03-25, post-build-variant-value=true, set at link in variant link-time / post-build in variant post-build / pre-compile in variant pre-compile, default-value=Inf  # RB (Vendor06) specific parameter: Maximum amount of time in [s] that transmitted data may remain unacknowledged before TCP forcefully closes the connection. | Note: This parameter specifies the User Timeout which shall be used to forcefully close a Tcp connection when remote does not respond to sent data within selected time. Dependency: TcpIpTcpUserTimeoutEnabled
        boolean TcpIpTcpUserTimeoutEnabled [0..1]: origin=RB:42.2.0.0:2017-01-19, set at pre-compile, default-value=false  # RB (Vendor06) specific parameter: Enables (TRUE) or disables (FALSE) support of User Timeout feature. | Note: If the parameter is enabled the TcpIpTcpUserTimeout shall be advertised to the remote within SYN or SYN-ACK segments (UTO option). If the remote does not respond to sent data within the TcpIpTcpUserTimeout the connection shall be forcefully closed.
        boolean TcpIpTcpZWPEnabled [0..1]: origin=RB:42.0.3.0:2016-03-25, set at pre-compile, default-value=false  # RB (Vendor06) specific parameter: Enables (TRUE) or disables (FALSE) TCP Zero Window Probes according to IETF RFC 1122 chapter 4.2.2.17 | Note: If the parameter is enabled Zero Window Probes shall be transmitted to probe the remote window when remote advertise a window of 0. Dependency: TcpIpTcpReTxEnabled
        integer TcpIpTcpZWPMaxRetries [0..1]: 0..255, origin=RB:42.0.3.0:2016-03-25, post-build-variant-value=true, set at link in variant link-time / post-build in variant post-build / pre-compile in variant pre-compile, default-value=255  # RB (Vendor06) specific parameter: Maximum number of times that a Zero Window Probe segment transmitted. | Note: This parameter specifies the maximum number of times that a Zero Window Probe segment is retransmitted without any response from the remote before the TCP connection is closed. Dependency: TcpIpTcpZWPEnabled
      container TcpIpUdpConfig [0..1]  # Specifies the configuration parameters of the UDP (User Datagram Protocol) sub-module
        integer TcpIpUdpTtl: 0..255, post-build-variant-value=true, set at link in variant link-time / post-build in variant post-build / pre-compile in variant pre-compile  # Default Time-to-live value of outgoing UDP packets. | This Time-To-Live value decides how long UDP packet stays alive on network when destination is unreachable.
    container TcpIpGeneral  # This container is a subcontainer of TcpIp and specifies the general configuration parameters of the TCP/IP stack.
      integer TcpIpBufferMemory [0..0]: 0..4294967295, set at link in variant link-time+post-build / pre-compile in variant pre-compile  # TcpIpBufferMemory (Currently Unused) | Memory size in bytes reserved for TCP/IP buffers.
      boolean TcpIpDevErrorDetect: set at pre-compile  # Switches the Default Error Tracer (Det) detection and notification ON or OFF. | * true: enabled (ON). * false: disabled (OFF).
      boolean TcpIpDhcpServerEnabled [0..0]: set at pre-compile  # TcpIpDhcpServerEnabled (Currently Unused) | Enables (TRUE) or disables (FALSE) the DHCP (Dynamic Host Configuration Protocol) Server.
      boolean TcpIpGetAndResetMeasurementDataApi: set at pre-compile  # Enables / Disables the Get and Reset Measurement Data API
      float TcpIpMainFunctionPeriod: 0..Inf, set at link in variant link-time+post-build / pre-compile in variant pre-compile  # Period of TcpIp_MainFunction in [s].
      boolean TcpIpResetIpAssignmentApi [0..0]: set at pre-compile  # TcpIpResetIpAssignmentApi (Currently Unused) | Enables/disables the API TcpIp_ResetIpAssignment of a DHCP-client. Currently unused in Implementation
      enumeration TcpIpScalabilityClass: {SC1, SC2, SC3}, set at pre-compile  # In order to customize the TcpIp Stack to the specific needs of the user it can be scaled according to the scalability classes. There are 3 possible scalability classes: SC1 (IPv4 - In-Vehicle and Diagnostic Communication), SC2 (IPv6 - In-Vehicle and Diagnostic Communication) and SC3 (IPv4 and IPv6 (Dual Stack) - In-Vehicle and Diagnostic). | If SC1: TcpIpIpV4General shall be configured, all TcpIpCtrl shall have TcpIpIpV4Ctrl configured and all TcpIpLocalAddr shall have domain type TCPIP_AF_INET If SC2: TcpIpIpV6General shall be configured, all TcpIpCtrl shall have TcpIpIpV6Ctrl configured and all TcpIpLocalAddr shall have domain type TCPIP_AF_INET_6 If SC3: TcpIpIpV4General and TcpIpIpV6General shall be configured
      boolean TcpIpTcpEnabled [0..0]: set at pre-compile  # TcpIpTcpEnabled (Currently Unused) | Enables (TRUE) or disabled (FALSE) support of TCP (Transmission Control Protocol). This parameter is unused in current implementation because Tcp is implicitly enabled if the maximum number of Tcp sockets configured is greater than 0.
      integer TcpIpTcpSocketMax: 0..65535, set at link in variant link-time+post-build / pre-compile in variant pre-compile  # Maximum number of TCP sockets. Important: If this parameter is set to 0, then all TCP protocol specific configuration will be disabled.
      boolean TcpIpUdpEnabled [0..0]: set at pre-compile  # TcpIpUdpEnabled (Currently Unused) | Enables (TRUE) or disabled (FALSE) support of UDP (User Datagram Protocol). This parameter is unused in current implementation because Udp is implicitly enabled if the maximum number of Udp sockets configured is greater than 0.
      integer TcpIpUdpSocketMax: 0..65535, set at link in variant link-time+post-build / pre-compile in variant pre-compile  # Maximum number of UDP sockets. Important: If this parameter is set to 0, then all UDP protocol specific configuration will be disabled. | If Udp sockets are configured to 0, then DHCP assignment shall not be configured (DHCP uses Udp) and there shall be no TcpIpLocalAddr configured with TcpIpAssignmentMethod set as TCPIP_DHCP.
      boolean TcpIpVersionInfoApi: set at pre-compile  # If true the TcpIp_GetVersionInfo API is available.
      container TcpIpIpV4General [0..1]  # This container is a subcontainer of TcpIp and specifies the general configuration parameters of the TCP/IP stack for IPv4. This container is mandatory only when TcpIpScalabilityClass is configured as SC1 or SC3. TcpIpIpV4General must not be configured for Scalability Class 2.
        boolean TcpIpArpEnabled [0..0]: set at pre-compile  # TcpIpArpEnabled (Currently Unused) | Enables (TRUE) or disables (FALSE) support of ARP (Address Resolution Protocol). This parameter is unused in current implementation because Arp is enabled only if there is any IPv4 unicast communication configured. For multicast and broadcast communication only, Arp is disabled.
        boolean TcpIpAutoIpEnabled [0..0]: set at pre-compile  # TcpIpAutoIpEnabled (Currently Unused) | Enables (TRUE) or disables (FALSE) the Auto-IP (automatic private IP addressing) sub-module. This is unused in current implementation because the AutoIp module is only enabled if there is at least one local IP address assignment method configured as AutoIp (link-local or link-local DoIp).
        boolean TcpIpDhcpClientEnabled [0..0]: set at pre-compile  # TcpIpDhcpClientEnabled (Currently Unused) | Enables (TRUE) or disables (FALSE) the DHCP (Dynamic Host Configuration Protocol) Client. This is unused in current implementation because the DHCP client is only enabled if there is at least one local IP address assignment by Dhcp configured.
        boolean TcpIpIcmpEnabled: set at pre-compile  # Enables (TRUE) or disabled (FALSE) support of ICMP (Internet Control Message Protocol).
        boolean TcpIpIpV4Enabled [0..0]: set at pre-compile  # TcpIpIpV4Enabled (Currently Unused) | Enables (TRUE) or disables (FALSE) support of IPv4 (Internet Protocol version 4). Configuration parameter not supported in present implementation, as IPv4 is enabled/disabled automatically based on configured scalability class.
        integer TcpIpLocalAddrIpv4EntriesMax [0..0]: 0..255, set at link in variant link-time+post-build / pre-compile in variant pre-compile  # TcpIpLocalAddrIpv4EntriesMax(Currently Unused) | Maximum number of LocalAddr table entries for IPv4. This parameter is not required as maximum number of LocalAddr table can be determined by applying size operator on the container TcpIpLocalAddr.
        boolean TcpIpPathMtuDiscoveryEnabled [0..0]: set at pre-compile  # TcpIpPathMtuDiscoveryEnabled (Currently Unused) | Enables (TRUE) or disables (FALSE) the discovery of the maximum transmission unit on a path according to IETF RfC 1191.
        container TcpIpDHCPGeneral [0..1]  # RB (Vendor06) specific container: DHCP general configuration parameters
          container TcpIpDHCPClientGeneral  # RB (Vendor06) specific container: General configuration parameters used for the DHCP Client process.
            float TcpIpDHCPTimeToWaitBeforeReTx: 1.0..4.0, origin=RB:42.0.3.0:2018-03-31, set at link in variant link-time+post-build / pre-compile in variant pre-compile, default-value=4  # RB (Vendor06) specific parameter: Parameter for DHCP Client. Time to wait before the retransmission if no response received from a Server. (Time in Seconds).
      container TcpIpIpV6General [0..1]  # This container is a subcontainer of TcpIp and specifies the general configuration parameters of the TCP/IP stack for IPv6. | This container is mandatory only when TcpIpScalabilityClass is configured as SC2 or SC3. TcpIpIpV6General must not be configured for Scalability Class 1.
        boolean TcpIpDhcpV6ClientEnabled [0..0]: set at pre-compile  # TcpIpDhcpV6ClientEnabled (Currently Unused) | Enables (TRUE) or disables (FALSE) the DHCPv6 (Dynamic Host Configuration Protocol for IPv6) Client.
        boolean TcpIpIpV6Enabled [0..0]: set at pre-compile  # TcpIpIpV6Enabled (Currently Unused) | Enables (TRUE) or disables (FALSE) support of IPv6 (Internet Protocol version 6).
        boolean TcpIpIpV6PathMtuDiscoveryEnabled [0..0]: set at pre-compile  # TcpIpIpV6PathMtuDiscoveryEnabled (Currently Unused) | Enables (TRUE) or disables (FALSE) Path MTU Discovery support for IPv6 according to IETF RFC 1981.
        integer TcpIpLocalAddrIpv6EntriesMax [0..0]: 0..255, set at link in variant link-time+post-build / pre-compile in variant pre-compile  # TcpIpLocalAddrIpv6EntriesMax (Currently Unused) | Maximum number of LocalAddr table entries for IPv6.
        boolean TcpIpNdpAddressResolutionUnrechabilityDetectionEnabled: set at pre-compile  # Enables (TRUE) or disables (FALSE) support of Address Resolution and Neighbor Unreachability Detection via NDP.
        boolean TcpIpNdpPrefixAndRouterDiscoveryEnabled: set at pre-compile  # Enables (TRUE) or disables (FALSE) support of Prefix and Router Discovery via NDP.
