AUTOSAR XML (schema 4-2-2)
package /AUTOSAR_Fr/EcucModuleDefs
  module definition Fr [0..*]: category=VENDOR_SPECIFIC_MODULE_DEFINITION, post-build-variant-support=true, refined-module-def=Fr, variants post-build/pre-compile  # Configuration of the Fr (FlexRay driver) module.
    container FrGeneral  # General configuration (parameters) of the FlexRay Driver module.
      integer FrCtrlTestCount: 0..255, set at pre-compile, default-value=1  # Maxmimum number of iterations the FlexRay controller hardware test is performed during controller initialization.
      boolean FrDevErrorDetect: set at pre-compile  # Switches the Default Error Tracer (Det) detection and notification ON or OFF. | * true: enabled (ON). * false: disabled (OFF).
      boolean FrDisableLPduSupport: set at pre-compile  # Enables or disabled API function Fr_DisableLPdu.
      integer FrIndex: 0..255, set at pre-compile  # Specifies the InstanceId of this module instance. If only one instance is present it shall have the Id 0.
      integer FrNumCtrlSupported: 1..256, set at pre-compile  # Determines the maximum number of communication controllers that the driver supports.
      boolean FrPrepareLPduSupport: set at pre-compile  # Enables or disables API function Fr_PrepareLPdu.
      boolean FrReconfigLPduSupport: set at pre-compile  # Enables or disabled API function Fr_ReconfigLPdu.
      boolean FrRxStringentCheck: set at pre-compile, default-value=false  # If stringent check is enabled (true), received frames are accepted only if no slot status error occurred.
      boolean FrRxStringentLengthCheck: set at pre-compile, default-value=false  # If stringent check is enabled (true), received frames are accepted only if the received payload length matches the configured payload length.
      boolean FrVersionInfoApi: set at pre-compile  # Enables/disables the existence of the Fr_GetVersionInfo API.
    container FrMultipleConfiguration  # This container contains the configuration parameters and sub containers of the AUTOSAR Fr module.
      container FrController [1..*]  # Configuration of the individual controller.
        integer FrCtrlIdx: 0..255, set at pre-compile, symbolic-name-value=true  # Determines index of CC within Fr.
        boolean FrPAllowHaltDueToClock: post-build-variant-value=true, set at post-build in variant post-build / pre-compile in variant pre-compile  # Boolean flag that controls the transition to the POC:halt state due to a clock synchronization errors. If set to true, the CC is allowed to transition to POC:halt. If set to false, the CC will not transition to the POC:halt state but will enter or remain in the POC:normal passive state (self healing would still be possible)
        integer FrPAllowPassiveToActive: 0..31, post-build-variant-value=true, set at post-build in variant post-build / pre-compile in variant pre-compile  # Number of consecutive even/odd cycle pairs that must have valid clock correction terms before the CC will be allowed to transition from the POC:normal passive state to POC:normal active state. If set to zero, the CC is not allowed to transition from POC:normal passive to POC:normal active
        enumeration FrPChannels: {FR_CHANNEL_A, FR_CHANNEL_AB, FR_CHANNEL_B}, post-build-variant-value=true, set at post-build in variant post-build / pre-compile in variant pre-compile  # Channels to which the node is connected. | Implementation Type: Fr_ChannelType
        integer FrPClusterDriftDamping: 0..20, post-build-variant-value=true, set at post-build in variant post-build / pre-compile in variant pre-compile  # Local cluster drift damping factor used for rate correction [Microticks]. | Remark: Upper limit 10 for FlexRay Protocol 3.0 compliance.
        integer FrPDecodingCorrection: 12..143, post-build-variant-value=true, set at post-build in variant post-build / pre-compile in variant pre-compile  # Value used by the receiver to calculate the difference between primary time reference point and secondary time reference point [Microticks]. | Remark: Lower limit 14 for FlexRay Protocol 2.1 Rev. A compliance. Upper limit 136 for FlexRay Protocol 3.0 compliance.
        integer FrPDelayCompensationA: 0..211, post-build-variant-value=true, set at post-build in variant post-build / pre-compile in variant pre-compile  # Value used to compensate for reception delays on the indicated channel. This covers assumed propagation delay up to cPropagationDelayMax for microticks in the range of 0.0125us to 0.05us [Microticks]. | Remark: Lower limit 4 for FlexRay Protocol 3.0 compliance. Remark: Upper limit 200 for FlexRay Protocol 2.1 Rev A compliance.
        integer FrPDelayCompensationB: 0..211, post-build-variant-value=true, set at post-build in variant post-build / pre-compile in variant pre-compile  # Value used to compensate for reception delays on the indicated channel. This covers assumed propagation delay up to cPropagationDelayMax for microticks in the range of 0.0125us to 0.05us [Microticks]. | Remark: Lower limit 4 for FlexRay Protocol 3.0 compliance. Remark: Upper limit 200 for FlexRay Protocol 2.1 Rev A compliance.
        boolean FrPExternalSync: post-build-variant-value=true, set at post-build in variant post-build / pre-compile in variant pre-compile  # Flag indicating whether the node is externally synchronized (operating as time gateway sink in an TT-E cluster) or locally synchronized. | If FrPExternalSync is set to 'true' then FrPTwoKeySlotMode must also be set to 'true'. Remarks: Set to 'false' for FlexRay Protocol 2.1 Rev. A compliance.
        boolean FrPFallBackInternal: post-build-variant-value=true, set at post-build in variant post-build / pre-compile in variant pre-compile  # Flag indicating whether a time gateway sink node will switch to local clock operation when synchronization with the time gateway source node is lost (FrPFallBackInternal = true) or will instead go to POC:ready (FrPFallBackInternal =false). | Remarks: Set to 'false' for FlexRay Protocol 2.1 Rev. A compliance.
        integer FrPKeySlotId: 0..1023, post-build-variant-value=true, set at post-build in variant post-build / pre-compile in variant pre-compile  # ID of the key slot, i.e., the slot used to transmit the startup frame, sync frame, or designated key slot frame. If this parameter is set to zero the node does not have a key slot. | For Fr3.0: if the value is not provided in System Description it shall be configured to 0. For Fr2.1: if the value is not provided in System Description it is driver implementation specific which value to configure.
        boolean FrPKeySlotOnlyEnabled: post-build-variant-value=true, set at post-build in variant post-build / pre-compile in variant pre-compile  # Flag indicating whether or not the node shall enter key slot only mode following startup. | Remarks: This parameter maps to FlexRay Protocol 2.1 Rev. A parameter pSingleSlotEnabled.
        boolean FrPKeySlotUsedForStartup: post-build-variant-value=true, set at post-build in variant post-build / pre-compile in variant pre-compile  # Flag indicating whether the key slot is used to transmit a startup frame. | If FrPKeySlotUsedForStartup is set to true then FrPKeySlotUsedForSync must also be set to true. If FrPTwoKeySlotMode is set to true then both FrPKeySlotUsedForSync and FrPKeySlotUsedForStartup must also be set to true.
        boolean FrPKeySlotUsedForSync: post-build-variant-value=true, set at post-build in variant post-build / pre-compile in variant pre-compile  # Flag indicating whether the key slot is used to transmit a sync frame. | If FrPKeySlotUsedForStartup is set to true then FrPKeySlotUsedForSync must also be set to true. If FrPTwoKeySlotMode is set to true then both FrPKeySlotUsedForSync and FrPKeySlotUsedForStartup must also be set to true.
        integer FrPLatestTx: 0..7988, post-build-variant-value=true, set at post-build in variant post-build / pre-compile in variant pre-compile  # Number of the last minislot in which a frame transmission can start in the dynamic segment. | Remark: Upper limit 7980 for FlexRay Protocol 2.1 Rev A compliance.
        integer FrPMacroInitialOffsetA: 2..68, post-build-variant-value=true, set at post-build in variant post-build / pre-compile in variant pre-compile  # Integer number of macroticks between the static slot boundary and the following macrotick boundary of the secondary time reference point based on the nominal macrotick duration [Macroticks].
        integer FrPMacroInitialOffsetB: 2..68, post-build-variant-value=true, set at post-build in variant post-build / pre-compile in variant pre-compile  # Integer number of macroticks between the static slot boundary and the following macrotick boundary of the secondary time reference point based on the nominal macrotick duration [Macroticks].
        integer FrPMicroInitialOffsetA: 0..239, post-build-variant-value=true, set at post-build in variant post-build / pre-compile in variant pre-compile  # Number of microticks between the secondary time reference point | and the macrotick boundary immediately following the secondary time reference point. The parameter depends on FrPDelayCompensationA and therefore it has to be set independently for each channel [Microticks].
        integer FrPMicroInitialOffsetB: 0..239, post-build-variant-value=true, set at post-build in variant post-build / pre-compile in variant pre-compile  # Number of microticks between the secondary time reference point | and the macrotick boundary immediately following the secondary time reference point. The parameter depends on FrPDelayCompensationB and therefore it has to be set independently for each channel [Microticks].
        integer FrPMicroPerCycle: 640..1280000, post-build-variant-value=true, set at post-build in variant post-build / pre-compile in variant pre-compile  # Nominal number of microticks in the communication cycle of the local node. If nodes have different microtick durations this number will differ from node to node [Microticks]. | Remark: Lower limit 960 for FlexRay Protocol 3.0 compliance. Upper limit 640000 for FlexRay Protocol 2.1 Rev A compliance.
        boolean FrPNmVectorEarlyUpdate: post-build-variant-value=true, set at post-build in variant post-build / pre-compile in variant pre-compile  # Flag indicating when the update of the Network Management Vector | in the CHI shall take place. If FrPNmVectorEarlyUpdate is set to false, the update shall take place after the NIT. If FrPNmVectorEarlyUpdate is set to true, the update shall take place after the end of the static segment. Remarks: Set to 'false' for FlexRay Protocol 2.1 Rev. A compliance.
        integer FrPOffsetCorrectionOut: 13..16082, post-build-variant-value=true, set at post-build in variant post-build / pre-compile in variant pre-compile  # Magnitude of the maximum permissible offset correction value [Microticks]. Remark: Upper limit 15567 for FlexRay Protocol 2.1 Rev A compliance. Remark: Lower limit 15 for FlexRay Protocol 3.0 compliance.
        integer FrPOffsetCorrectionStart: 7..15999, post-build-variant-value=true, set at post-build in variant post-build / pre-compile in variant pre-compile  # Start of the offset correction phase within the NIT, expressed as the number of macroticks from the start of cycle [Macroticks]. | Remark: This parameter maps to FlexRay Protocol 2.1 Rev. A parameter gOffsetCorrectionStart. Remark: Lower limit 9 for FlexRay Protocol 2.1 Rev A compliance.
        integer FrPPayloadLengthDynMax: 0..127, post-build-variant-value=true, set at post-build in variant post-build / pre-compile in variant pre-compile  # Maximum payload length for dynamic frames [16 bit words].
        integer FrPRateCorrectionOut: 2..3846, post-build-variant-value=true, set at post-build in variant post-build / pre-compile in variant pre-compile  # Magnitude of the maximum permissible rate correction value and the maximum drift offset between two nodes operating with unsynchronized clocks for one communication cycle [Microticks]. | Remarks: This parameter maps to FlexRay Protocol 2.1 Rev. A parameter pdMaxDrift. Lower limit 3 for FlexRay Protocol 3.0 compliance. Upper limit 1923 for FlexRay Protocol 2.1 Rev A compliance.
        enumeration FrPSamplesPerMicrotick: {N1SAMPLES, N2SAMPLES, N4SAMPLES}, post-build-variant-value=true, set at post-build in variant post-build / pre-compile in variant pre-compile  # Number of samples per microtick. Remark: Allowed range N1SAMPLES, N2SAMPLES for FlexRay Protocol 3.0 compliance.
        integer FrPSecondKeySlotId: 0..1023, post-build-variant-value=true, set at post-build in variant post-build / pre-compile in variant pre-compile  # ID of the second key slot, in which a second startup frame shall be sent when operating as a coldstart node in a TT-L or TT-D cluster. If this parameter is set to zero the node does not have a second key slot. | Remark: Set to 0 for FlexRay Protocol 2.1 Rev A compliance.
        boolean FrPTwoKeySlotMode: post-build-variant-value=true, set at post-build in variant post-build / pre-compile in variant pre-compile  # Flag indicating whether node operates as a coldstart node in a TT-E or TT-L cluster. | If pTwoKeySlotMode is set to true then both pKeySlotUsedForSync and pKeySlotUsedForStartup must also be set to true. If pExternalSync is set to true then pTwoKeySlotMode must also be set to true. Remark: Set to false for FlexRay Protocol 2.1 Rev A compliance.
        enumeration FrPWakeupChannel: {FR_CHANNEL_A, FR_CHANNEL_B}, post-build-variant-value=true, set at post-build in variant post-build / pre-compile in variant pre-compile  # Channel used by the node to send a wakeup pattern. | FrPWakeupChannel must be selected from among the channels configured by FrPChannels.
        integer FrPWakeupPattern: 0..63, post-build-variant-value=true, set at post-build in variant post-build / pre-compile in variant pre-compile  # Number of repetitions of the wakeup symbol that are combined to form a wakeup pattern when the node enters the POC:wakeup send state. | Remark: Lower limit 2 for FlexRay Protocol 2.1 Rev A compliance.
        integer FrPdAcceptedStartupRange: 0..2743, post-build-variant-value=true, set at post-build in variant post-build / pre-compile in variant pre-compile  # Expanded range of measured clock deviation allowed for startup frames during integration [Microticks]. | Remark: Upper limit 1875 for FlexRay Protocol 2.1 Rev A compliance. Remark: Lower limit 29 for FlexRay Protocol 3.0 compliance.
        integer FrPdListenTimeout: 1284..2567692, post-build-variant-value=true, set at post-build in variant post-build / pre-compile in variant pre-compile  # Value for the startup listen timeout and wakeup listen timeout. Although this is a node local parameter, the real time equivalent of this value should be the same for all nodes in the cluster [Microticks]. | Remark: Lower limit 1926 for FlexRay Protocol 3.0 compliance. Upper limit 1283846 for FlexRay Protocol 2.1 Rev. A compliance.
        enumeration FrPdMicrotick: {T100NS, T12_5NS, T200NS, T25NS, T50NS}, post-build-variant-value=true, set at post-build in variant post-build / pre-compile in variant pre-compile  # Duration of a microtick. | Remark: Allowed range T12_5NS, T25NS, T50NS for FlexRay Protocol 3.0 compliance.
        string HardwareName [0..1]: set at pre-compile, origin=ETAS-RTA-MCAL_v1.0  # The name of the (real or virtual) item to map to this controller. The names of the available items depend on the MCAL implementation.
        string HardwareNameWin [0..1]: set at pre-compile, origin=ETAS-RTA-MCAL_v1.0  # The name of the (real or virtual) item to map to this controller when building for VRTA-win. This can override the HardwareName value.
        string HardwareNameUx [0..1]: set at pre-compile, origin=ETAS-RTA-MCAL_v1.0  # The name of the (real or virtual) item to map to this controller when building for VRTA-ux. This can override the HardwareName value.
        container FrAbsoluteTimer [1..*]  # Specifies the absolute timer configuration parameters of the Fr.
          integer FrAbsTimerIdx: 0..254, set at pre-compile, symbolic-name-value=true  # Contains the index of an absolute timer contained in Fr on a certain FlexRay CC.
        container FrControllerDemEventParameterRefs [0..1]  # Container for the references to DemEventParameter elements which shall be invoked using the API Dem_ReportErrorStatus API in case the corresponding error occurs. The EventId is taken from the referenced DemEventParameter's DemEventId value. The standardized errors are provided in the container and can be extended by vendor specific error references.
          symbolic name reference FR_E_CTRL_TESTRESULT [0..1]: multiplicity set at post-build in variant post-build / pre-compile in variant pre-compile, post-build-variant-multiplicity=true, post-build-variant-value=true, set at post-build in variant post-build / pre-compile in variant pre-compile, destination=DemEventParameter  # Reference to DEM event Id that is reported for FlexRay | controller hardware test failure. If this parameter is not configured, no event reporting happens.
        container FrFifo [0..*]  # One First In First Out (FIFO) queued receive structure, defining the admittance criteria to the FIFO, and mandating the ability to admit messages into the FIFO based on Message Id filtering criteria.
          boolean FrAdmitWithoutMessageId: post-build-variant-value=true, set at post-build in variant post-build / pre-compile in variant pre-compile  # Determines whether or not frames received in the dynamic segment that don't contain a message ID will be admitted into the FIFO.
          integer FrBaseCycle: 0..63, post-build-variant-value=true, set at post-build in variant post-build / pre-compile in variant pre-compile  # FIFO cycle counter acceptance criteria.
          enumeration FrChannels: {FR_CHANNEL_A, FR_CHANNEL_AB, FR_CHANNEL_B}, post-build-variant-value=true, set at post-build in variant post-build / pre-compile in variant pre-compile  # FIFO channel admittance criteria.
          integer FrCycleRepetition: 1..64, post-build-variant-value=true, set at post-build in variant post-build / pre-compile in variant pre-compile  # FIFO cycle counter acceptance criteria. Valid values are 1,2,4,5,8,10,16,20,32,40,50,64. | Remark: Values 1,2,4,8,16,32,64 are valid only for FlexRay Protocol 2.1 Rev A compliance.
          integer FrFifoDepth: 1..2048, post-build-variant-value=true, set at post-build in variant post-build / pre-compile in variant pre-compile  # FrFifoDepth configures the maximum number of rx-frames which can be contained in the FIFO.
          integer FrMsgIdMask: 0..65535, post-build-variant-value=true, set at post-build in variant post-build / pre-compile in variant pre-compile  # FIFO message identifier acceptance criteria (Mask filter).
          integer FrMsgIdMatch: 0..65535, post-build-variant-value=true, set at post-build in variant post-build / pre-compile in variant pre-compile  # FIFO message identifier acceptance criteria (Match filter).
          container FrRange [1..*]  # FIFO Frame Id range acceptance criteria.
            integer FrRangeMax: 0..2047, post-build-variant-value=true, set at post-build in variant post-build / pre-compile in variant pre-compile  # Last FrameId of this range that will be accepted by the FIFO.
            integer FrRangeMin: 0..2047, post-build-variant-value=true, set at post-build in variant post-build / pre-compile in variant pre-compile  # First FrameId of this range that will be accepted by the FIFO.
package /AUTOSAR_Fr/LifeCycleInfoSets
  life cycle info set AUTOSARParameterDefinition
    life-cycle-infos:
      lc-object=BswMBswMModeRequest, lc-state=obsolete, period-begin=ar-release-version=4.2.2
      lc-object=BswMBswMModeDeclarationGroupRef, lc-state=obsolete, period-begin=ar-release-version=4.2.2
      lc-object=BswMBswMModeSwitchNotification, lc-state=obsolete, period-begin=ar-release-version=4.2.2
      lc-object=BswMBswMModeDeclarationGroupRef, lc-state=obsolete, period-begin=ar-release-version=4.2.2
      lc-object=BswMRequestRemoteMode, lc-state=obsolete, period-begin=ar-release-version=4.2.2
      lc-object=BswMModeDeclarationGroupPrototypeRef, lc-state=obsolete, period-begin=ar-release-version=4.2.2
      lc-object=BswMRequestedRemoteMode, lc-state=obsolete, period-begin=ar-release-version=4.2.2
      lc-object=BswMEcuCPartitionRef, lc-state=obsolete, period-begin=ar-release-version=4.2.2
      lc-object=BswMTriggerSlaveRTEStop, lc-state=obsolete
      lc-object=BswMCoreRef, lc-state=obsolete
      lc-object=BswMTriggerStartUpPhase2, lc-state=obsolete
      lc-object=BswMCoreRef, lc-state=obsolete
      lc-object=DcmDspDidInfotypeRef, lc-state=obsolete, period-begin=ar-release-version=4.2.2, remark=p=l-1=This reference is set to obsolete and will be removed in release 4.3. Use DcmDspEnableObdMirror instead.
      lc-object=DcmDspDidPidRef, lc-state=obsolete, period-begin=ar-release-version=4.2.2, remark=p=l-1=This reference is set to obsolete and will be removed in release 4.3. Use DcmDspEnableObdMirror instead.
      lc-object=DcmDspCommonAuthorizationRef, lc-state=obsolete, period-begin=ar-release-version=4.2.2, remark=p=l-1=This reference is set to obsolete and will be removed in release 4.3.
      lc-object=DcmDspRoutineTidRef, lc-state=obsolete, period-begin=ar-release-version=4.2.2, remark=p=l-1=This reference is set to obsolete and will be removed in release 4.3. Use DcmDspEnableObdMirror instead.
      lc-object=DemAgingCycleCounterProcessing, lc-state=obsolete, period-begin=ar-release-version=4.2.2, remark=p=l-1=This reference is set to obsolete and will be removed in release 4.3.
      lc-object=DemOBDDestinationOfEventsRef, lc-state=obsolete, period-begin=ar-release-version=4.2.2, remark=p=l-1=This reference is set to obsolete and will be removed in release 4.3.
      lc-object=EthIfMainFunctionRxTimeout, lc-state=obsolete, period-begin=ar-release-version=4.2.2
      lc-object=EthTSynGlobalTimeDomainId, lc-state=obsolete, period-begin=ar-release-version=4.2.2
      lc-object=FiMDataFixed, lc-state=obsolete
      lc-object=FiMTaskTime, lc-state=obsolete
      lc-object=FlsDemEventParameterRefs, lc-state=obsolete, period-begin=ar-release-version=4.2.2, remark=p=l-1=This container is set to obsolete and will be removed in release 4.3.
      lc-object=FLS_E_COMPARE_FAILED, lc-state=obsolete, period-begin=ar-release-version=4.2.2, remark=p=l-1=This reference is set to obsolete and will be removed in release 4.3.
      lc-object=FLS_E_ERASE_FAILED, lc-state=obsolete, period-begin=ar-release-version=4.2.2, remark=p=l-1=This reference is set to obsolete and will be removed in release 4.3.
      lc-object=FLS_E_READ_FAILED, lc-state=obsolete, period-begin=ar-release-version=4.2.2, remark=p=l-1=This reference is set to obsolete and will be removed in release 4.3.
      lc-object=FLS_E_UNEXPECTED_FLASH_ID, lc-state=obsolete, period-begin=ar-release-version=4.2.2, remark=p=l-1=This reference is set to obsolete and will be removed in release 4.3.
      lc-object=FLS_E_WRITE_FAILED, lc-state=obsolete, period-begin=ar-release-version=4.2.2, remark=p=l-1=This reference is set to obsolete and will be removed in release 4.3.
      lc-object=FlsTstNumberOfTestedCells, lc-state=obsolete, period-begin=ar-release-version=4.2.2
      lc-object=FlsTstNumberOfTestedCells, lc-state=obsolete, period-begin=ar-release-version=4.2.2
      lc-object=FrNmNumberOfClusters, lc-state=obsolete, period-begin=ar-release-version=4.2.2
      lc-object=LinNmComUserDataSupport, lc-state=obsolete
      lc-object=UDPNM_E_NETWORK_TIMEOUT, lc-state=obsolete, period-begin=ar-release-version=4.2.2
      lc-object=UDPNM_E_TCPIP_TRANSMIT_ERROR, lc-state=obsolete, period-begin=ar-release-version=4.2.2
      lc-object=WDGM_E_IMPROPER_CALLER, lc-state=obsolete, period-begin=ar-release-version=4.2.2, remark=p=l-1=This reference is set to obsolete and will be removed in R 4.3
      lc-object=WDGM_E_MONITORING, lc-state=obsolete, period-begin=ar-release-version=4.2.2, remark=p=l-1=use WDGM_E_SUPERVISION instead
      lc-object=WdgMDefensiveBehavior, lc-state=obsolete, period-begin=ar-release-version=4.2.2, remark=p=l-1=This parameter is set to obsolete and will be removed in R 4.3
      lc-object=WdgMCallerIds, lc-state=obsolete, period-begin=ar-release-version=4.2.2, remark=p=l-1=This container is set to obsolete and will be removed in R4.3
      lc-object=WdgMCallerId, lc-state=obsolete, period-begin=ar-release-version=4.2.2, remark=p=l-1=This parameter is set to obsolete and will be removed in R4.3
      lc-object=XfmTransformationBswModuleEntryRef, lc-state=obsolete, period-begin=ar-release-version=4.2.2
