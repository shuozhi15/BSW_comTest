AUTOSAR XML (schema 4-2-2)
package /AUTOSAR_Can/EcucModuleDefs
  module definition Can [0..*]: category=VENDOR_SPECIFIC_MODULE_DEFINITION, post-build-variant-support=true, refined-module-def=Can, variants post-build/pre-compile  # This container holds the configuration of a single CAN Driver.
    container CanConfigSet  # This container contains the configuration parameters and sub containers of the AUTOSAR Can module.
      container CanController [1..*]  # This container contains the configuration parameters of the CAN controller(s).
        enumeration CanBusoffProcessing: {INTERRUPT, POLLING}, set at pre-compile  # Enables / disables API Can_MainFunction_BusOff() for handling busoff events in polling mode.
        boolean CanControllerActivation: set at pre-compile  # Defines if a CAN controller is used in the configuration.
        integer CanControllerBaseAddress: 0..4294967295, set at pre-compile  # Specifies the CAN controller base address.
        integer CanControllerId: 0..255, scope=ECU, set at pre-compile, symbolic-name-value=true  # This parameter provides the controller ID which is unique in a given CAN Driver. The value for this parameter starts with 0 and continue without any gaps.
        enumeration CanRxProcessing: {INTERRUPT, POLLING}, set at pre-compile  # Enables / disables API Can_MainFunction_Read() for handling PDU reception events in polling mode.
        enumeration CanTxProcessing: {INTERRUPT, POLLING}, set at pre-compile  # Enables / disables API Can_MainFunction_Write() for handling PDU transmission events in polling mode.
        boolean CanWakeupFunctionalityAPI: set at pre-compile, default-value=false  # Adds / removes the service Can_CheckWakeup() from the code. | True: Can_CheckWakeup can be used. False: Can_CheckWakeup cannot be used.
        enumeration CanWakeupProcessing: {INTERRUPT, POLLING}, set at pre-compile  # Enables / disables API Can_MainFunction_Wakeup() for handling wakeup events in polling mode.
        boolean CanWakeupSupport: set at pre-compile  # CAN driver support for wakeup over CAN Bus.
        string HardwareName [0..1]: set at pre-compile, origin=ETAS-RTA-MCAL_v1.0  # The name of the (real or virtual) item to map to this controller. The names of the available items depend on the MCAL implementation.
        string HardwareNameWin [0..1]: set at pre-compile, origin=ETAS-RTA-MCAL_v1.0  # The name of the (real or virtual) item to map to this controller when building for VRTA-win. This can override the HardwareName value.
        string HardwareNameUx [0..1]: set at pre-compile, origin=ETAS-RTA-MCAL_v1.0  # The name of the (real or virtual) item to map to this controller when building for VRTA-ux. This can override the HardwareName value.
        reference CanControllerDefaultBaudrate: post-build-variant-value=true, set at post-build in variant post-build / pre-compile in variant pre-compile, destination=CanControllerBaudrateConfig  # Reference to baudrate configuration container configured for the Can Controller.
        reference CanCpuClockRef [0..1]: set at pre-compile, destination=McuClockReferencePoint  # Reference to the CPU clock configuration, which is set in the MCU driver configuration
        symbolic name reference CanWakeupSourceRef [0..1]: multiplicity set at pre-compile, set at pre-compile, destination=EcuMWakeupSource  # This parameter contains a reference to the Wakeup Source for this controller as defined in the ECU State Manager. | Implementation Type: reference to EcuM_WakeupSourceType
        container CanControllerBaudrateConfig [1..*]  # This container contains bit timing related configuration parameters of the CAN controller(s).
          integer CanControllerBaudRate: 0..2000, post-build-variant-value=true, set at post-build in variant post-build / pre-compile in variant pre-compile  # Specifies the baudrate of the controller in kbps.
          integer CanControllerBaudRateConfigID: 0..65535, scope=ECU, post-build-variant-value=true, set at post-build in variant post-build / pre-compile in variant pre-compile, default-value=0  # Uniquely identifies a specific baud rate configuration. This ID is used by SetBaudrate API.
          integer CanControllerPropSeg: 0..255, post-build-variant-value=true, set at post-build in variant post-build / pre-compile in variant pre-compile  # Specifies propagation delay in time quantas.
          integer CanControllerSeg1: 0..255, post-build-variant-value=true, set at post-build in variant post-build / pre-compile in variant pre-compile  # Specifies phase segment 1 in time quantas.
          integer CanControllerSeg2: 0..255, post-build-variant-value=true, set at post-build in variant post-build / pre-compile in variant pre-compile  # Specifies phase segment 2 in time quantas.
          integer CanControllerSyncJumpWidth: 0..255, post-build-variant-value=true, set at post-build in variant post-build / pre-compile in variant pre-compile  # Specifies the synchronization jump width for the controller in time quantas.
          container CanControllerFdBaudrateConfig [0..1]  # This optional container contains bit timing related configuration parameters of the CAN controller(s) for payload and CRC of a CAN FD frame. If this container exists the controller supports CAN FD frames.
            integer CanControllerFdBaudRate: 0..16000, post-build-variant-value=true, set at post-build in variant post-build / pre-compile in variant pre-compile  # Specifies the data segment baud rate of the controller in kbps.
            integer CanControllerPropSeg: 0..255, post-build-variant-value=true, set at post-build in variant post-build / pre-compile in variant pre-compile  # Specifies propagation delay in time quantas.
            integer CanControllerSeg1: 0..255, post-build-variant-value=true, set at post-build in variant post-build / pre-compile in variant pre-compile  # Specifies phase segment 1 in time quantas.
            integer CanControllerSeg2: 0..255, post-build-variant-value=true, set at post-build in variant post-build / pre-compile in variant pre-compile  # Specifies phase segment 2 in time quantas.
            integer CanControllerSyncJumpWidth: 0..255, post-build-variant-value=true, set at post-build in variant post-build / pre-compile in variant pre-compile  # Specifies the synchronization jump width for the controller in time quantas.
            integer CanControllerTrcvDelayCompensationOffset [0..1]: 0..400, multiplicity set at post-build in variant post-build / pre-compile in variant pre-compile, post-build-variant-multiplicity=true, post-build-variant-value=true, set at post-build in variant post-build / pre-compile in variant pre-compile  # Specifies the Transceiver Delay Compensation Offset in ns. If not specified Transceiver Delay Compensation is disabled.
            boolean CanControllerTxBitRateSwitch: post-build-variant-value=true, set at post-build in variant post-build / pre-compile in variant pre-compile, default-value=true  # Specifies if the bit rate switching shall be used for transmissions. | If FALSE: CAN FD frames shall be sent without bit rate switching.
        container CanTTController [0..1]  # CanTTController is specified in the SWS TTCAN and contains the configuration parameters of the TTCAN controller(s) (which are needed in addition to the configuration parameters of the CAN controller(s)). | This container is only included and valid if TTCAN is supported by the controller, enabled (see CanSupportTTCANRef, ECUC_Can_00430), and used.
          integer CanTTControllerApplWatchdogLimit: 0..255, scope=ECU, post-build-variant-value=true, set at post-build in variant post-build / pre-compile in variant pre-compile  # Defines the maximum time period (unit is 256 times NTU) after which the application has to serve the watchdog.
          integer CanTTControllerCycleCountMax: 0..63, scope=ECU, post-build-variant-value=true, set at post-build in variant post-build / pre-compile in variant pre-compile  # Defines the value for cycle_count_max. | Allowed values: 0x00: 1 basic cycle 0x01: 2 basic cycles 0x03: 4 basic cycles 0x07: 8 basic cycles 0x0F: 16 basic cycles 0x1F: 32 basic cycles 0x3F: 64 basic cycles
          integer CanTTControllerExpectedTxTrigger: 0..255, post-build-variant-value=true, set at post-build in variant post-build / pre-compile in variant pre-compile  # Number of expected_tx_trigger.
          boolean CanTTControllerExternalClockSynchronisation: scope=ECU, post-build-variant-value=true, set at post-build in variant post-build / pre-compile in variant pre-compile  # Enables/disables the external clock synchronization. | TRUE: External clock synchronization enabled. FALSE: External clock synchronization disabled. This parameter shall only be configurable if parameter CanTTControllerLevel2 equals TRUE.
          boolean CanTTControllerGlobalTimeFiltering: post-build-variant-value=true, set at post-build in variant post-build / pre-compile in variant pre-compile  # Enables/disables the global time filtering. | TRUE: Global time filtering enabled. FALSE: Global time filtering disabled. This parameter shall only be configurable if parameter CanTTControllerLevel2 equals TRUE.
          integer CanTTControllerInitialRefOffset: 0..127, scope=ECU, post-build-variant-value=true, set at post-build in variant post-build / pre-compile in variant pre-compile  # Defines the initial value for ref trigger offset.
          integer CanTTControllerInterruptEnable: 0..1023, post-build-variant-value=true, set at post-build in variant post-build / pre-compile in variant pre-compile  # Enables/disables the respective interrupts. | Bit Position set to 1: Enable respective interrupt. Bit Position set to 0: Disable respective interrupt. Bit Position / Interrupt Source: 10: Application Watchdog. 9: Watch Trigger reached. 8: Initialization Watch Trigger reached. 7: Change of Error Level. 6: Tx Overflow. 5: Tx Underflow. 4: Global Time Error. 3: Gap. 2: Start of Cycle. 1: Time Discontinuity. 0: Master State Change. Bit position "1: Time Discontinuity" and "4: Global Time Error" shall only be configurable if parameter CanTTControllerLevel2 equals TRUE.
          boolean CanTTControllerLevel2: post-build-variant-value=true, set at post-build in variant post-build / pre-compile in variant pre-compile  # Defines whether Level 2 or Level 1 is used. | TRUE: Level 2. FALSE: Level 1. If this parameter is set to FALSE then all parameters with dependency to CanTTControllerLevel2 need not be configured.
          float CanTTControllerNTUConfig: 0..100, scope=ECU, post-build-variant-value=true, set at post-build in variant post-build / pre-compile in variant pre-compile  # Defines the config value for NTU (network time unit). | Value given in microseconds. The value configured shall be greater than 0. Together with the local oscillator period, the TUR (time unit ratio) can be derived from the NTU. This parameter shall only be configurable if parameter CanTTControllerLevel2 equals TRUE.
          enumeration CanTTControllerOperationMode: {CAN_TT_EVENT_SYNC_TIME_TRIGGERED, CAN_TT_EVENT_TRIGGERED, CAN_TT_TIME_TRIGGERED}, scope=ECU, post-build-variant-value=true, set at post-build in variant post-build / pre-compile in variant pre-compile  # Defines the operation mode.
          float CanTTControllerSyncDeviation: 0..100, post-build-variant-value=true, set at post-build in variant post-build / pre-compile in variant pre-compile  # Defines the maximum synchronization deviation: | Given as a percentage value of the NTU (network time unit). The value configured shall be greater than 0. This parameter shall only be configurable if parameter CanTTControllerLevel2 equals TRUE.
          boolean CanTTControllerTURRestore: post-build-variant-value=true, set at post-build in variant post-build / pre-compile in variant pre-compile  # Enables/disables the TUR restore. | Note that the value configured for TUR can be derived from the value configured for NTU and the local oscillator preriod. TRUE: TUR restore enabled. FALSE: TUR restore disabled. This parameter shall only be configurable if parameter CanTTControllerLevel2 equals TRUE.
          boolean CanTTControllerTimeMaster: scope=ECU, post-build-variant-value=true, set at post-build in variant post-build / pre-compile in variant pre-compile  # Defines whether the controller acts as a potential time master. | TRUE: Potential time master. FALSE: Time slave.
          integer CanTTControllerTimeMasterPriority: 0..7, scope=ECU, post-build-variant-value=true, set at post-build in variant post-build / pre-compile in variant pre-compile  # Defines the time master priority.
          integer CanTTControllerTxEnableWindowLength: 1..16, scope=ECU, post-build-variant-value=true, set at post-build in variant post-build / pre-compile in variant pre-compile  # Length of the tx enable window given in CAN bit times. | Definition parameter "CanTTControllerTxEnableWindowlength" is used such that: Length of enable window = CanTTControllerTxEnableWindowLength + 1
          integer CanTTControllerWatchTriggerGapTimeMark: 0..65535, post-build-variant-value=true, set at post-build in variant post-build / pre-compile in variant pre-compile  # watch trigger time mark after a gap
          integer CanTTControllerWatchTriggerTimeMark: 0..65535, post-build-variant-value=true, set at post-build in variant post-build / pre-compile in variant pre-compile  # watch trigger time mark
          enumeration CanTTIRQProcessing: {INTERRUPT, POLLING}, scope=ECU, post-build-variant-value=true, set at post-build in variant post-build / pre-compile in variant pre-compile  # Enables / disables API Can_MainFunction_BusOff() for handling busoff events in polling mode.
      container CanHardwareObject [1..*]  # This container contains the configuration (parameters) of CAN Hardware Objects.
        integer CanFdPaddingValue [0..1]: 0..255, scope=ECU, multiplicity set at post-build in variant post-build / pre-compile in variant pre-compile, post-build-variant-multiplicity=true, post-build-variant-value=true, set at post-build in variant post-build / pre-compile in variant pre-compile, default-value=0  # Specifies the value which is used to pad unspecified data in CAN FD frames > 8 bytes for transmission. This is necessary due to the discrete possible values of the DLC if > 8 bytes. | If the length of a PDU which was requested to be sent does not match the allowed DLC values, the remaining bytes up to the next possible value shall be padded with this value.
        enumeration CanHandleType: {BASIC, FULL}, scope=ECU, post-build-variant-value=true, set at post-build in variant post-build / pre-compile in variant pre-compile  # Specifies the type (Full-CAN or Basic-CAN) of a hardware object.
        integer CanHwObjectCount: 1..65535, scope=ECU, multiplicity set at post-build in variant post-build / pre-compile in variant pre-compile, post-build-variant-multiplicity=true, post-build-variant-value=true, set at post-build in variant post-build / pre-compile in variant pre-compile, default-value=1  # Number of hardware objects used to implement one HOH. In case of a HRH this parameter defines the number of elements in the hardware FIFO or the number of shadow buffers, in case of a HTH it defines the number of hardware objects used for multiplexed transmission or for a hardware FIFO used by a FullCAN HTH.
        enumeration CanIdType: {EXTENDED, MIXED, STANDARD}, scope=ECU, post-build-variant-value=true, set at post-build in variant post-build / pre-compile in variant pre-compile  # Specifies whether the IdValue is of type | - standard identifier - extended identifier - mixed mode ImplementationType: Can_IdType
        integer CanObjectId: 0..65535, scope=ECU, set at pre-compile, symbolic-name-value=true  # Holds the handle ID of HRH or HTH. The value of this parameter is unique in a given CAN Driver, and it should start with 0 and continue without any gaps. | The HRH and HTH Ids share a common ID range. Example: HRH0-0, HRH1-1, HTH0-2, HTH1-3
        enumeration CanObjectType: {RECEIVE, TRANSMIT}, scope=ECU, post-build-variant-value=true, set at post-build in variant post-build / pre-compile in variant pre-compile  # Specifies if the HardwareObject is used as Transmit or as Receive object
        boolean CanTriggerTransmitEnable [0..1]: scope=ECU, set at pre-compile, default-value=false  # This parameter defines if or if not Can supports the trigger-transmit API for this handle.
        reference CanControllerRef: post-build-variant-value=true, set at post-build in variant post-build / pre-compile in variant pre-compile, destination=CanController  # Reference to CAN Controller to which the HOH is associated to.
        reference CanMainFunctionRWPeriodRef [0..1]: multiplicity set at post-build in variant post-build / pre-compile in variant pre-compile, post-build-variant-multiplicity=true, post-build-variant-value=true, set at post-build in variant post-build / pre-compile in variant pre-compile, destination=CanMainFunctionRWPeriods  # Reference to CanMainFunctionPeriod
        container CanHwFilter [0..*]  # This container is only valid for HRHs and contains the configuration (parameters) of one hardware filter.
          integer CanHwFilterCode: 0..4294967295, post-build-variant-value=true, set at post-build in variant post-build / pre-compile in variant pre-compile  # Specifies (together with the filter mask) the identifiers range that passes the hardware filter.
          integer CanHwFilterMask: 0..4294967295, post-build-variant-value=true, set at post-build in variant post-build / pre-compile in variant pre-compile  # Describes a mask for hardware-based filtering of CAN identifiers. The CAN identifiers of incoming messages are masked with the appropriate CanFilterMaskValue. Bits holding a 0 mean don't care, i.e. do not compare the message's identifier in the respective bit position. | The mask shall be build by filling with leading 0. In case of CanIdType EXTENDED or MIXED a 29 bit mask shall be build. In case of CanIdType STANDARD a 11 bit mask shall be build
        container CanTTHardwareObjectTrigger [0..*]  # CanTTHardwareObjectTrigger is specified in the SWS TTCAN and contains the configuration (parameters) of TTCAN triggers for Hardware Objects, which are additional to the configuration (parameters) of CAN Hardware Objects. | This container is only included and valid if TTCAN is supported by the controller and, enabled (see CanSupportTTCANRef, ECUC_Can_00430), and used.
          integer CanTTHardwareObjectBaseCycle: 0..63, scope=ECU, post-build-variant-value=true, set at post-build in variant post-build / pre-compile in variant pre-compile  # Defines the cycle_offset. | CanTTHardwareObjectBaseCycle must be not greater than cycle_count_max.
          integer CanTTHardwareObjectCycleRepetition: 1..64, scope=ECU, post-build-variant-value=true, set at post-build in variant post-build / pre-compile in variant pre-compile  # Defines the repeat_factor. | CanTTHardwareObjectCycleRepetition shall be a power of two (2), greater than cycle_offset but not greater than cycle_count_max + 1.
          integer CanTTHardwareObjectTimeMark: 0..65535, post-build-variant-value=true, set at post-build in variant post-build / pre-compile in variant pre-compile  # Defines the point in time, when the trigger will be activated. | Value is given in cycle time.
          integer CanTTHardwareObjectTriggerId: 0..63, set at pre-compile, symbolic-name-value=true  # Sequential number which allows separation of different TTCAN triggers configured for one and the same hardware object.
          enumeration CanTTHardwareObjectTriggerType: {CAN_TT_RX_TRIGGER, CAN_TT_TX_REF_TRIGGER, CAN_TT_TX_REF_TRIGGER_GAP, CAN_TT_TX_TRIGGER_EXCLUSIVE, CAN_TT_TX_TRIGGER_MERGED, CAN_TT_TX_TRIGGER_SINGLE}, post-build-variant-value=true, set at post-build in variant post-build / pre-compile in variant pre-compile  # Defines the type of the trigger associated with the hardware object. This parameter depends on plain CAN parameter CAN_OBJECT_TYPE. | If CAN_OBJECT_TYPE equals RECEIVE than this parameter is fixed to CAN_TT_RX_TRIGGER. If CAN_OBJECT_TYPE equals TRANSMIT than one of the following literals is configurable: CAN_TT_TX_REF_TRIGGER, CAN_TT_TX_REF_TRIGGER_GAP, CAN_TT_TX_TRIGGER_MERGED, CAN_TT_TX_TRIGGER_SINGLE, CAN_TT_TX_TRIGGER_EXCLUSIVE.
      container CanIcom [0..1]  # This container contains the parameters for configuring pretended networking
        container CanIcomConfig [1..*]  # This container contains the configuration parameters of the ICOM Configuration.
          integer CanIcomConfigId: 1..255, scope=ECU, set at pre-compile  # This parameter identifies the ID of the ICOM configuration.
          boolean CanIcomWakeOnBusOff: scope=ECU, set at pre-compile, default-value=true  # This parameter defines that the MCU shall wake if the bus off is detected or not.
          container CanIcomWakeupCauses  # This container contains the configuration parameters of the wakeup causes to leave the power saving mode.
            container CanIcomRxMessage [1..*]  # This container contains the configuration parameters for the wakeup causes for matching received messages. It has to be configured as often as received messages are defined as wakeup cause. | constraint: For all CanIcomRxMessage instances the Message IDs which are defined in CanIcomMessageId and in CanIcomRxMessageIdMask shall not overlap.
              integer CanIcomCounterValue [0..1]: 1..65536, scope=ECU, multiplicity set at pre-compile, set at pre-compile  # This parameter defines that the MCU shall wake if the message with the ID is received n times on the communication channel.
              integer CanIcomMessageId: 0..536870912, scope=ECU, multiplicity set at pre-compile, set at pre-compile  # This parameter defines the message ID the wakeup causes of this CanIcomRxMessage are configured for. In addition a mask (CanIcomMessageIdMask) can be defined, in that case it is possible to define a range of rx messages, which can create a wakeup condition.
              integer CanIcomMessageIdMask [0..1]: 0..536870912, scope=ECU, multiplicity set at pre-compile, set at pre-compile  # Describes a mask for filtering of CAN identifiers. The CAN identifiers of incoming messages are masked with this CanIcomMessageIdMask. If the masked identifier matches the masked value of CanIcomMessageId, it can create a wakeup condition for this CanIcomRxMessage. Bits holding a 0 mean don't care, i.e. do not compare the message's identifier in the respective bit position. The mask shall be build by filling with leading 0.
              float CanIcomMissingMessageTimerValue [0..1]: scope=ECU, multiplicity set at pre-compile, set at pre-compile  # This parameter defines that the MCU shall wake if the message with the ID is not received for a specific time in s on the | communication channel.
              boolean CanIcomPayloadLengthError: scope=ECU, set at pre-compile, default-value=false  # This parameter defines that the MCU shall wake if a payload error occurs
              container CanIcomRxMessageSignalConfig [0..*]  # This container contains the configuration parameters for the wakeup causes for matching signals. | It has to be configured as often as a signal is defined as wakeup cause. If at least one Signal conditions defined in a CanIcomRxMessageSignalConfig evaluates to true or if no CanIcomRxMessageSignalConfig are defined, the whole wakeup condition is considered to be true. All instances of this container refer to the same frame/pdu (see CanIcomMessageId).
                integer CanIcomSignalMask: 0..18446744073709551615, set at pre-compile  # This parameter shall be used to mask a signal in the payload of a CAN message. | The mask is binary AND with the signal payload. The result will be used in combination of the operations defined in CanIcomSignalOperation with the CanIcomSignalValue.
                enumeration CanIcomSignalOperation: {AND, EQUAL, GREATER, SMALLER, XOR}, scope=ECU, set at pre-compile  # This parameter defines the operation, which shall be used to verify the signal value creates a wakeup condition.
                integer CanIcomSignalValue: 0..18446744073709551615, set at pre-compile  # This parameter shall be used to define a signal value which shall be compared (CanIcomSignalOperation) with the masked CanIcomSignalMask value of the received signal (CanIcomSignalRef).
                reference CanIcomSignalRef [0..1]: scope=ECU, multiplicity set at pre-compile, set at pre-compile, destination=ComSignal  # This parameter defines a reference to the signal which shall be checked additional to the message id (CanIcomMessageId). | This reference is used for documentation to define which ComSignal originates this filter setting. All signals being referred by this reference shall point to the same PDU.
    container CanGeneral  # This container contains the parameters related each CAN Driver Unit.
      boolean CanDevErrorDetection: set at pre-compile  # Switches the Default Error Tracer (Det) detection and notification ON or OFF. | * true: enabled (ON). * false: disabled (OFF).
      integer CanIndex: 0..255, set at pre-compile  # Specifies the InstanceId of this module instance. If only one instance is present it shall have the Id 0.
      function name CanLPduReceiveCalloutFunction [0..1]: multiplicity set at pre-compile, set at pre-compile  # This parameter defines the existence and the name of a callout function that is called after a successful | reception of a received CAN Rx L-PDU. If this parameter is omitted no callout shall take place.
      float CanMainFunctionBusoffPeriod [0..1]: 0.001..65.535, multiplicity set at pre-compile, set at pre-compile  # This parameter describes the period for cyclic call to Can_MainFunction_Busoff. Unit is seconds.
      float CanMainFunctionModePeriod: 0.001..65.535, set at pre-compile  # This parameter describes the period for cyclic call to Can_MainFunction_Mode. Unit is seconds.
      float CanMainFunctionWakeupPeriod [0..1]: 0.001..65.535, multiplicity set at pre-compile, set at pre-compile  # This parameter describes the period for cyclic call to Can_MainFunction_Wakeup. Unit is seconds.
      boolean CanMultiplexedTransmission: scope=ECU, set at pre-compile  # Specifies if multiplexed transmission shall be supported.ON or OFF
      boolean CanPublicIcomSupport: scope=ECU, set at pre-compile, default-value=false  # Selects support of Pretended Network features in Can driver. | True: Enabled False: Disabled
      boolean CanSetBaudrateApi [0..1]: scope=ECU, multiplicity set at pre-compile, set at pre-compile, default-value=false  # The support of the Can_SetBaudrate API is optional. | If this parameter is set to true the Can_SetBaudrate API shall be supported. Otherwise the API is not supported.
      float CanTimeoutDuration: 1E-6..65.535, set at pre-compile  # Specifies the maximum time for blocking function until a timeout is detected. Unit is seconds.
      boolean CanVersionInfoApi: set at pre-compile  # Switches the Can_GetVersionInfo() API ON or OFF.
      reference CanOsCounterRef [0..1]: multiplicity set at pre-compile, set at pre-compile, destination=OsCounter  # This parameter contains a reference to the OsCounter, which is used by the CAN driver.
      reference CanSupportTTCANRef [0..1]: scope=ECU, set at pre-compile, destination=CanIfPrivateCfg  # The parameter refers to CanIfSupportTTCAN parameter in the CAN Interface Module configuration. | The CanIfSupportTTCAN parameter defines whether TTCAN is supported.
      container CanIcomGeneral [0..1]  # This container contains the general configuration parameters of the ICOM Configuration.
        enumeration CanIcomLevel [0..1]: {CAN_ICOM_LEVEL_ONE, CAN_ICOM_LEVEL_TWO}, scope=ECU, multiplicity set at pre-compile, set at pre-compile, default-value=CAN_ICOM_LEVEL_ONE  # Defines the level of Pretended Networking. | This parameter is reserved for future implementations (Pretended Networking level 2).
        enumeration CanIcomVariant: {CAN_ICOM_VARIANT_HW, CAN_ICOM_VARIANT_NONE, CAN_ICOM_VARIANT_SW}, scope=ECU, set at pre-compile, default-value=CAN_ICOM_VARIANT_NONE  # Defines the variant, which is supported by this CanController
      container CanMainFunctionRWPeriods [0..*]  # This container contains the parameter for configuring the period for cyclic call to Can_MainFunction_Read or Can_MainFunction_Write depending on the referring item.
        float CanMainFunctionPeriod: 0.001..65.535, set at pre-compile  # This parameter describes the period for cyclic call to Can_MainFunction_Read or Can_MainFunction_Write depending on the referring item. Unit is seconds. Different poll-cycles will be configurable if more than one CanMainFunctionPeriod is configured. In this case multiple Can_MainFunction_Read() or Can_MainFunction_Write() will be provided by the CAN Driver module.
      container CanRbCalibrationSupport [0..1]  # This container contains the switch which has to be enabled/disabled for Calibration support. Calibration of CanId, Filtermask,Default Baudrate is supported
        boolean CanRbCalibration: origin=RB:2018-09-17, default-value=false  # This parameter is used to enable calibration of CanId,CanFiltermask and CanControllerDefaultBadrate.
        string CanRbCalibrationNamePrefix [0..1]: multiplicity set at link in variant link-time / post-build in variant post-build / pre-compile in variant pre-compile, origin=RB:2018-09-12, set at link in variant link-time / post-build in variant post-build / pre-compile in variant pre-compile  # Calibration variables can have configurational names.This container provides as option of giving the desired Prefix to the calibratable CanId variable name.
        string CanRbCalibrationNameSuffix [0..1]: multiplicity set at link in variant link-time / post-build in variant post-build / pre-compile in variant pre-compile, origin=RB:2018-09-12, set at link in variant link-time / post-build in variant post-build / pre-compile in variant pre-compile  # Calibration variables can have configurational names.This container provides as option of giving the desired suffix to the calibratable CanId variable name.
        boolean CanRbNodeCalibration: origin=RB:2018-09-17, default-value=false  # This parameter is used to enable/disable feature for Calibration of frames to different nodes.If the user wants to configure a frame to a node other than what it is already configured to, then the CanNodeCalibration parameter should be enabled.
package /AUTOSAR_Can/LifeCycleInfoSets
  life cycle info set AUTOSARParameterDefinition
    life-cycle-infos:
      lc-object=BswMBswMModeRequest, lc-state=obsolete, period-begin=ar-release-version=4.2.2
      lc-object=BswMBswMModeDeclarationGroupRef, lc-state=obsolete, period-begin=ar-release-version=4.2.2
      lc-object=BswMBswMModeSwitchNotification, lc-state=obsolete, period-begin=ar-release-version=4.2.2
      lc-object=BswMBswMModeDeclarationGroupRef, lc-state=obsolete, period-begin=ar-release-version=4.2.2
      lc-object=BswMRequestRemoteMode, lc-state=obsolete, period-begin=ar-release-version=4.2.2
      lc-object=BswMModeDeclarationGroupPrototypeRef, lc-state=obsolete, period-begin=ar-release-version=4.2.2
      lc-object=BswMRequestedRemoteMode, lc-state=obsolete, period-begin=ar-release-version=4.2.2
      lc-object=BswMEcuCPartitionRef, lc-state=obsolete, period-begin=ar-release-version=4.2.2
      lc-object=BswMTriggerSlaveRTEStop, lc-state=obsolete
      lc-object=BswMCoreRef, lc-state=obsolete
      lc-object=BswMTriggerStartUpPhase2, lc-state=obsolete
      lc-object=BswMCoreRef, lc-state=obsolete
      lc-object=DcmDspDidInfotypeRef, lc-state=obsolete, period-begin=ar-release-version=4.2.2, remark=p=l-1=This reference is set to obsolete and will be removed in release 4.3. Use DcmDspEnableObdMirror instead.
      lc-object=DcmDspDidPidRef, lc-state=obsolete, period-begin=ar-release-version=4.2.2, remark=p=l-1=This reference is set to obsolete and will be removed in release 4.3. Use DcmDspEnableObdMirror instead.
      lc-object=DcmDspCommonAuthorizationRef, lc-state=obsolete, period-begin=ar-release-version=4.2.2, remark=p=l-1=This reference is set to obsolete and will be removed in release 4.3.
      lc-object=DcmDspRoutineTidRef, lc-state=obsolete, period-begin=ar-release-version=4.2.2, remark=p=l-1=This reference is set to obsolete and will be removed in release 4.3. Use DcmDspEnableObdMirror instead.
      lc-object=DemAgingCycleCounterProcessing, lc-state=obsolete, period-begin=ar-release-version=4.2.2, remark=p=l-1=This reference is set to obsolete and will be removed in release 4.3.
      lc-object=DemOBDDestinationOfEventsRef, lc-state=obsolete, period-begin=ar-release-version=4.2.2, remark=p=l-1=This reference is set to obsolete and will be removed in release 4.3.
      lc-object=EthIfMainFunctionRxTimeout, lc-state=obsolete, period-begin=ar-release-version=4.2.2
      lc-object=EthTSynGlobalTimeDomainId, lc-state=obsolete, period-begin=ar-release-version=4.2.2
      lc-object=FiMDataFixed, lc-state=obsolete
      lc-object=FiMTaskTime, lc-state=obsolete
      lc-object=FlsDemEventParameterRefs, lc-state=obsolete, period-begin=ar-release-version=4.2.2, remark=p=l-1=This container is set to obsolete and will be removed in release 4.3.
      lc-object=FLS_E_COMPARE_FAILED, lc-state=obsolete, period-begin=ar-release-version=4.2.2, remark=p=l-1=This reference is set to obsolete and will be removed in release 4.3.
      lc-object=FLS_E_ERASE_FAILED, lc-state=obsolete, period-begin=ar-release-version=4.2.2, remark=p=l-1=This reference is set to obsolete and will be removed in release 4.3.
      lc-object=FLS_E_READ_FAILED, lc-state=obsolete, period-begin=ar-release-version=4.2.2, remark=p=l-1=This reference is set to obsolete and will be removed in release 4.3.
      lc-object=FLS_E_UNEXPECTED_FLASH_ID, lc-state=obsolete, period-begin=ar-release-version=4.2.2, remark=p=l-1=This reference is set to obsolete and will be removed in release 4.3.
      lc-object=FLS_E_WRITE_FAILED, lc-state=obsolete, period-begin=ar-release-version=4.2.2, remark=p=l-1=This reference is set to obsolete and will be removed in release 4.3.
      lc-object=FlsTstNumberOfTestedCells, lc-state=obsolete, period-begin=ar-release-version=4.2.2
      lc-object=FlsTstNumberOfTestedCells, lc-state=obsolete, period-begin=ar-release-version=4.2.2
      lc-object=FrNmNumberOfClusters, lc-state=obsolete, period-begin=ar-release-version=4.2.2
      lc-object=LinNmComUserDataSupport, lc-state=obsolete
      lc-object=UDPNM_E_NETWORK_TIMEOUT, lc-state=obsolete, period-begin=ar-release-version=4.2.2
      lc-object=UDPNM_E_TCPIP_TRANSMIT_ERROR, lc-state=obsolete, period-begin=ar-release-version=4.2.2
      lc-object=WDGM_E_IMPROPER_CALLER, lc-state=obsolete, period-begin=ar-release-version=4.2.2, remark=p=l-1=This reference is set to obsolete and will be removed in R 4.3
      lc-object=WDGM_E_MONITORING, lc-state=obsolete, period-begin=ar-release-version=4.2.2, remark=p=l-1=use WDGM_E_SUPERVISION instead
      lc-object=WdgMDefensiveBehavior, lc-state=obsolete, period-begin=ar-release-version=4.2.2, remark=p=l-1=This parameter is set to obsolete and will be removed in R 4.3
      lc-object=WdgMCallerIds, lc-state=obsolete, period-begin=ar-release-version=4.2.2, remark=p=l-1=This container is set to obsolete and will be removed in R4.3
      lc-object=WdgMCallerId, lc-state=obsolete, period-begin=ar-release-version=4.2.2, remark=p=l-1=This parameter is set to obsolete and will be removed in R4.3
      lc-object=XfmTransformationBswModuleEntryRef, lc-state=obsolete, period-begin=ar-release-version=4.2.2
