AUTOSAR XML (schema 4-2-2)
package /AUTOSAR_PduR/EcucModuleDefs
  module definition PduR [0..1]: refined-module-def=PduR, variants pre-compile  # Pdu Router Module | Configuration of the PduR (PDU Router) module(with vendor specific enhancements of RB).
    container PduRBswModules [0..*]: multiplicity set at pre-compile  # Each container describes a specific BSW module (upper/CDD/lower/IpduM) that the PDU Router shall interface to. | The reason to have it as own configuration container instead of implication of the routing path is to be able to configure CDDs properly and to force module's to be used in a post-build situation even though no routing is made to/from this module (future configurations may include these modules).
      boolean PduRCancelReceive: set at pre-compile  # Specifies if the Transport protocol module supports the CancelReceive API or not. Value true the API is supported.
      boolean PduRCancelTransmit: set at pre-compile  # Specifies if the BSW module supports the CancelTransmit API or not. Value true the API is supported.
      boolean PduRChangeParameterApi: set at pre-compile  # This parameter, if set to true, enables the PduR_<Up>ChangeParameter Api for this Module.
      boolean PduRCommunicationInterface: set at pre-compile  # Specifies if the BSW module supports the Communication Interface APIs or not. Value true the APIs are supported. | A module can have both Communication Interface APIs and Transport Protocol APIs (e.g. the COM module).
      boolean PduRLowerModule: set at pre-compile  # The PduRLowerModule will decide who will call the APIs and who will implement the APIs. | For example, if the CanIf module is referenced then the PDU Router module will implement the PduR_CanIfRxIndication API. And the PDUR module will call the CanIf_Transmit API. Other APIs are of course also covered. An upper module can also be an lower module (e.g. the IpduM module).
      boolean PduRRetransmission: set at pre-compile  # If set to true this means that the destination transport protocol module will use the retransmission feature. This parameter might be set to false if the retransmission feature is not used, even though the destination transport protocol is supporting it. | This parameter is only valid for transport protocol modules and gateway operations. If transmission from a local upper layer module this module will handle the retransmission.
      boolean PduRTransportProtocol: set at pre-compile  # The PDU Router module shall use the API parameters specified for transport protocol interface.
      boolean PduRTriggertransmit: set at pre-compile  # Specifies if the BSW module supports the TriggerTransmit API or not. Value true means that the BSW module supports the TriggerTransmit interface which a lower layer module can call and also that it can call the TriggerTransmit interface of an upper layer module. Value false means that the BSW module does not support the TriggerTransmit interface which a lower layer module can call and also that it shall not call the TriggerTransmit interface of an upper layer module.
      boolean PduRTxConfirmation: set at pre-compile  # Specifies if the BSW module supports the TxConfirmation API or not. Value true the API is supported.
      boolean PduRUpperModule: set at pre-compile  # The PduRUpperModule will decide who will call the APIs and who will implement the APIs. | For example, if the COM module is referenced then the PDU Router module will implement the PduR_Transmit API. And the PDUR module will call the Com_RxIndication API. Other APIs are of course also covered. An upper module can also be an lower module (e.g. the IpduM module).
      boolean PduRUseTag: set at pre-compile  # This parameter, if set to true, enables the usage of the tag (<up>) in the following API calls: | * PduR_<Up>CancelReceive * PduR_<Up>CancelTransmit * PduR_<Up>ChangeParameter Example: If used by COM and the parameter is enabled the PduR_ComCancelTransmit is used. The background is that upper layer modules differ in usage of this tag (e.g. COM is using the tag, DCM is not).
      foreign reference PduRBswModuleRef: set at pre-compile, destination-type=ECUC-MODULE-CONFIGURATION-VALUES  # This is a reference to one BSW module's configuration (i.e. not the ECUC parameter definition template). | Example, there could be several configurations of LinIf and this reference selects one of them.
      container PduRInvalidHandlers [0..1]: multiplicity set at pre-compile  # Container for each PduRBswModule to indicate whether Invalid Handlers should be supported or not for any feature. This is relevant only for a lower layer module. This container need not be configured for upper layer modules.
        boolean PduRIHCancelReceive: origin=RB:1:0:0:2016-08-30, set at pre-compile, default-value=false  # Specifies for a PduRBswModule, if call to Invalid Handler needs to be generated instead of actual CancelReceive API. Value TRUE: Call to Invalid Handler is generated. Value FALSE: Call to Actual ModuleName_CancelReceive API is generated.
        boolean PduRIHCancelTransmit: origin=RB:1:0:0:2016-08-30, set at pre-compile, default-value=false  # Specifies for a PduRBswModule, if call to Invalid Handler needs to be generated instead of actual CancelTransmit API. Value TRUE: Call to Invalid Handler is generated. Value FALSE: Call to Actual ModuleName_CancelTransmit API is generated.
    container PduRGeneral  # This container is a subcontainer of PduR and specifies the general configuration parameters of the PDU Router.
      boolean PduRDevErrorDetect: set at pre-compile  # Switches the Default Error Tracer (Det) detection and notification ON or OFF. | * true: enabled (ON). * false: disabled (OFF).
      boolean PduRMetaDataSupport [0..1]: multiplicity set at pre-compile, set at pre-compile, default-value=false  # Enable support for MetaData handling. The size of the MetaData is defined by the configuration parameter MetaDataLength of the global PDU definitions. This feature may be used for efficient CAN-CAN-routing, where the MetaData contains the CAN ID.This feature is not yet supported.
      boolean PduRVersionInfoApi: set at pre-compile  # If true the PduR_GetVersionInfo API is available.
      boolean PduRZeroCostOperation: set at pre-compile  # If set the PduR configuration generator will report an error if zero-cost-operation cannot be fulfilled. | This parameter shall be seen as an input requirement to the configuration generator.
      boolean PduRFifoTxBufferSupport: origin=RB:1:0:0:2016-08-30, set at pre-compile  # Configuration parameter to enable or disable PDU Router support for FIFOs as PDU transmit buffers; if PDUR_GATEWAY_OPERATION is disabled, this parameter has to be disabled.This parameter shall be seen as an input requirement to the configuration generator.
      boolean PduRCanTpChangeParameterRequestApi: origin=RB:1:0:0:2016-08-30, set at pre-compile  # This parameter, if set to true, enables the PduR_CanTpChangeParameterConfirmation Api for this Module.This parameter shall be seen as an input requirement to the configuration generator.
      boolean PduRFrTpChangeParameterRequestApi: origin=RB:1:0:0:2016-08-30, set at pre-compile  # This parameter, if set to true, enables the PduR_FrTpChangeParameterConfirmation Api for this Module.This parameter shall be seen as an input requirement to the configuration generator.
      boolean PduRIFGatewayOperation: origin=RB:1:0:0:2016-08-30, set at pre-compile  # Configuration parameter to enable or disable PDU Router IF Gateway from an interface module to lower layer interface modules; if PDUR_ZERO_COST_OPERATION is enabled, this parameter has to be disabled.This parameter shall be seen as an input requirement to the configuration generator.
      boolean PduRTPGatewayOperation: origin=RB:1:0:0:2016-08-30, set at pre-compile  # Configuration parameter to enable or disable PDU Router TP gateway from a TP module to lower layer TP modules; if PDUR_ZERO_COST_OPERATION is enabled, this parameter has to be disabled.This parameter shall be seen as an input requirement to the configuration generator.
      integer PduRMemorySize: 0..65535, origin=RB:1:0:0:2016-08-30, set at pre-compile  # Memory size reserved for PDU Router buffers. Only required for gateway operation.
      enumeration PduRMinimumRoutingLoModule [0..1]: {CAN_IF, CAN_TP, FR_IF, FR_TP, LIN_IF, LIN_TP}, origin=RB:1:0:0:2016-08-30, set at pre-compile  # Lower layer module to be used for minimum routing; this parameter shall be used if PDUR_ZERO_COST_OPERATION is disabled; otherwise it shall not be used.
      integer PduRMinimumRoutingLoRxPduId [0..1]: 0..65535, origin=RB:1:0:0:2016-08-30, set at pre-compile  # Receive PDU identifier of the lower layer module which shall be used at the PDU Router interface to the lower layer module specified by PDUR_MINIMUM_ROUTING_LO_MODULE for minimum routing; this parameter shall be used if PDUR_ZERO_COST_OPERATION is disabled; otherwise it shall not be used.
      integer PduRMinimumRoutingLoTxPduId [0..1]: 0..65535, origin=RB:1:0:0:2016-08-30, set at pre-compile  # Transmit PDU identifier of the lower layer module which shall be used at the PDU Router interface to the lower layer module specified by PDUR_MINIMUM_ROUTING_LO_MODULE for minimum routing; this parameter shall be used if PDUR_ZERO_COST_OPERATION is disabled; otherwise it shall not be used.
      enumeration PduRMinimumRoutingUpModule [0..1]: {COM, DCM}, origin=RB:1:0:0:2016-08-30, set at pre-compile  # Upper layer module to be used for minimum routing; this parameter shall be used if PDUR_ZERO_COST_OPERATION is disabled; otherwise it shall not be used.
      integer PduRMinimumRoutingUpRxPduId [0..1]: 0..65535, origin=RB:1:0:0:2016-08-30, set at pre-compile  # Receive PDU identifier of the upper layer module which shall be used at the PDU Router interface to the upper layer module specified by PDUR_MINIMUM_ROUTING_UP_MODULE for minimum routing; this parameter shall be used if PDUR_ZERO_COST_OPERATION is disabled; otherwise it shall not be used.
      integer PduRMinimumRoutingUpTxPduId [0..1]: 0..65535, origin=RB:1:0:0:2016-08-30, set at pre-compile  # Transmit PDU identifier of the upper layer module which shall be used at the PDU Router interface to the upper layer module specified by PDUR_MINIMUM_ROUTING_UP_MODULE for minimum routing; this parameter shall be used if PDUR_ZERO_COST_OPERATION is disabled; otherwise it shall not be used.
      boolean PduRMulticastFromIfSupport: origin=RB:1:0:0:2016-08-30, set at pre-compile  # Configuration parameter to enable or disable PDU Router support for multicasts from an interface module to upper layer modules or lower layer interface modules; if PDUR_ZERO_COST_OPERATION is enabled, this parameter has to be disabled.This parameter shall be seen as an input requirement to the configuration generator.
      boolean PduRMulticastFromTpSupport: origin=RB:1:0:0:2016-08-30, set at pre-compile  # Configuration parameter to enable or disable PDU Router support for multicasts from a TP module to upper layer modules and lower layer TP modules; if PDUR_ZERO_COST_OPERATION is enabled, this parameter has to be disabled.This parameter shall be seen as an input requirement to the configuration generator. For Example : LoTp (Src)->PduR->(Dest1)LoTp, (Dest2)UpTp
      boolean PduRMulticastToIfSupport: origin=RB:1:0:0:2016-08-30, set at pre-compile  # Configuration parameter to enable or disable PDU Router support for multicasts from an upper layer module to interface modules; if PDUR_ZERO_COST_OPERATION is enabled, this parameter has to be disabled.This parameter shall be seen as an input requirement to the configuration generator.
      boolean PduRMulticastToTpSupport: origin=RB:1:0:0:2016-08-30, set at pre-compile  # Configuration parameter to enable or disable PDU Router support for multicasts from an upper layer module to TP modules; if PDUR_ZERO_COST_OPERATION is enabled, this parameter has to be disabled.This parameter shall be seen as an input requirement to the configuration generator.
      boolean PduRGwTpWithLimitedBuffer: origin=RB:1:0:0:2018-09-21, set at pre-compile  # Configuration parameter to enable or disable PDU Router support for gateway Tp using limited buffer resources; Note : When this parameter is set true need to configure PduRTpThreshold.
      boolean PduRSbTxBufferSupport: origin=RB:1:0:0:2016-08-30, set at pre-compile  # Configuration parameter to enable or disable PDU Router support for single buffers as PDU transmit buffers; if PDUR_GATEWAY_OPERATION is disabled, this parameter has to be disabled.This parameter shall be seen as an input requirement to the configuration generator.
      boolean PduRQueueingSupport: origin=RB:1:0:0:2016-08-30, set at pre-compile  # Configuration parameter to enable or disable PDU Router Queueing Feature. If PDUR_ZERO_COST_OPERATION is enabled, this parameter has to be disabled.
      boolean PduRDSMReInitEnabled [0..1]: origin=RB:1.0.0:2017-03-10, set at pre-compile, default-value=false  # Enables or disables the reporting of DEM events to DSM after the Re-initialisation of DSM has occured.
      float PduRDsmReInitMainFunctionPeriod [0..1]: 0.001..0.1, origin=RB:1.0.0:2017-03-10, set at pre-compile  # Specifies the period in seconds that the MainFunction has to be triggered with. | Comment:this main function is used for DsmReinit feature.
      container PduRDemSupport [0..1]  # This container containes switches for Dem Monitoring Control.
        boolean PduRInitFailed: set at pre-compile, origin=RB:1.0.0:2017-03-1  # Monitoring Control Switch for error PDUR_E_INIT_FAILED.This parameter shall be seen as an input requirement to the configuration generator.
        boolean PduRPduInstanceLost: set at pre-compile, origin=RB:1.0.0:2017-03-1  # Monitoring Control Switch for error PDUR_E_PDU_INSTANCE_LOST.This parameter shall be seen as an input requirement to the configuration generator.
    container PduRRoutingTables  # Represents one table of routing paths. | This routing table allows multiple configurations that can be used to create several routing tables in the same configuration. This is mainly used for post-build (e.g. post-build selectable) but can be used by pre-compile and link-time for variant handling.
      integer PduRConfigurationId: 0..65535, set at pre-compile  # Identification of the configuration of the PduR configuration. This identification can be read using the PduR API.
      integer PduRMaxRoutingPathCnt [0..1]: 0..65535, multiplicity set at pre-compile, set at pre-compile  # Maximum number of RoutingPaths in all RoutingTables. This parameter is needed only in case of post-build loadable implementation using static memory allocation. This parameter is not supported yet.
      integer PduRMaxRoutingPathGroupCnt [0..1]: 0..65535, multiplicity set at pre-compile, set at pre-compile  # Maximum number of RoutingPathGroups. This parameter is needed only in case of post-build loadable implementation using static memory allocation. This parameter is not supported yet.
      integer PduRMaxRoutingTableCnt [0..1]: 0..65535, multiplicity set at pre-compile, set at pre-compile  # Maximum number of RoutingTables. This parameter is needed only in case of post-build loadable implementation using static memory allocation. This parameter is not supported yet.
      container PduRDemEventParameterRefs [0..1]  # Container for the references to DemEventParameter elements which shall be invoked using the API Dem_ReportErrorStatus API in case the corresponding error occurs. The EventId is taken from the referenced DemEventParameter's DemEventId value. The standardized errors are provided in the container and can be extended by vendor specific error references.
        enumeration PduRRbDynCreate_E_INIT_FAILED [0..1]: {Disabled, Standard}, set at pre-compile, origin=RB:0.1.0:2014-10-08, default-value=Disabled  # Dynamically create PDUR_E_INIT_FAILED DemEvent | Selects the way how the PDUR_E_INIT_FAILED DemEvent is created. If not set or set to Disabled, no such DemEvent is automatically created. If the dynamic creation of this DemEvent is enabled, the reference to this DemEvent (in parameter PDUR_E_INIT_FAILED) is also automatically created and shall therefore not be set manually.
        enumeration PduRRbDynCreate_E_PDU_INSTANCE_LOST [0..1]: {Disabled, Standard}, set at pre-compile, origin=RB:0.1.0:2014-10-08, default-value=Disabled  # Dynamically create PDUR_E_PDU_INSTANCE_LOST DemEvent | Selects the way how the PDUR_E_PDU_INSTANCE_LOST DemEvent is created. If not set or set to Disabled, no such DemEvent is automatically created. If the dynamic creation of this DemEvent is enabled, the reference to this DemEvent (in parameter PDUR_E_PDU_INSTANCE_LOST) is also automatically created and shall therefore not be set manually.
        symbolic name reference PDUR_E_INIT_FAILED [0..1]: set at pre-compile, destination=DemEventParameter  # Reference to configured DEM event to report PDU Router initialization failed (PDU Router changed to PDUR_REDUCED state).
        symbolic name reference PDUR_E_PDU_INSTANCE_LOST [0..1]: set at pre-compile, destination=DemEventParameter  # Reference to configured DEM event to report Loss of a PDU instance (FIFO flushed because of an overrun).
      container PduRRoutingPathGroup [0..*]: multiplicity set at pre-compile  # This container groups routing path destinations. Destinations are used instead of routing paths since a routing path can be 1:n. It is desirable to be able to enable/disable a specific bus (i.e. a destination) rather than a routing path. Of course it is possible to create groups that covers specific routing paths as well. | Enabling and disabling of routing path groups are made using the PduR API
        boolean PduRIsEnabledAtInit: set at pre-compile  # If set to true this routing path group will be enabled after initializing the PDU Router module (i.e. enabled in the PduR_Init function).
        integer PduRRoutingPathGroupId: 0..65535, scope=ECU, set at pre-compile, symbolic-name-value=true  # Identification of the routing group. | The identification will be used by the disable/enable API in the PDU Router module API.
        reference PduRDestPduRef [1..*]: multiplicity set at pre-compile, set at pre-compile, destination=PduRDestPdu  # This reference selects one destination of the routing path.
      container PduRRoutingTable [0..*]: multiplicity set at pre-compile  # Represents one container of routing paths.
        container PduRRoutingPath [0..*]: multiplicity set at pre-compile  # This container is a subcontainer of PduRRoutingTable and specifies the routing path of a PDU.
          integer PduRTpGatewayQueueDepth [0..1]: 1.., set at pre-compile, origin=RB:1:0:0:2016-08-30  # This parameter specifies whether queue is required in Tp Gatewaying or not. If configured as 2 then, queuing is enabled. Max queue depth can be 2. By default the parameter value is 1
          container PduRDestPdu [1..*]: multiplicity set at pre-compile  # This container is a subcontainer of PduRRoutingPath and specifies one destination for the PDU to be routed.
            enumeration PduRDestPduDataProvision [0..1]: {PDUR_DIRECT, PDUR_TRIGGERTRANSMIT}, multiplicity set at pre-compile, set at pre-compile  # Specifies how data are provided: direct (as part of the Transmit call) or via | the TriggerTransmit callback function. Only required for non-TP gatewayed I-PDUs.
            integer PduRDestPduHandleId [0..1]: 0..65535, scope=ECU, multiplicity set at pre-compile, set at pre-compile, symbolic-name-value=true  # PDU identifier assigned by PDU Router. Used by communication interface and transport protocol modules for confirmation (PduR_<Lo>TxConfirmation) and for TriggerTransmit (PduR_<Lo>TriggerTransmit).
            integer PduRTpThreshold [0..1]: 1..65535, multiplicity set at pre-compile, set at pre-compile  # This parameter is only relevant for TP routings. | When configured, it enables on-the-fly routing and defines the number of bytes which must have been received before transmission on the destination bus may start. When omitted, direct TP routing is enforced. The PduRouter shall ensure that a buffer is allocated for this routing path which is at least as large as the threshold.
            boolean PduRTransmissionConfirmation [0..1]: multiplicity set at pre-compile, set at pre-compile  # This parameter is only for communication interfaces. Transport protocol modules will always call the TxConfirmation function. | If set the destination communication interface module will call the TxConfirmation. However the TxConfirmation may be not called due to error. So the PduR shall not block until the TxConfirmation is called. One background for this parameter is for the PduR to know when all modules have confirmed a multicast operation.
            reference PduRDestPduRef: set at pre-compile, destination=Pdu  # Destination PDU reference; reference to unique PDU identifier which shall be used by the PDU Router instead of the source PDU ID when calling the related function of the destination module.
            reference PduRDestTxBufferRef [0..1]: multiplicity set at pre-compile, set at pre-compile, destination=PduRTxBuffer  # Reference to a buffer that is allocated in the PduRTxBuffer. Having a global (for PduR) list of buffers allows reusage and hence less memory consumption.
            choice reference PduRDestTpBufferRef [0..1]: set at pre-compile, origin=RB:1:0:0:2016-08-30, destination=[PduRTpBuffer, PduRTpBufferPool]  # Reference to a buffer that is allocated in the PduRTpBuffer. Having a global (for PduR) list of buffers allows reusage and hence less memory consumption.
            container PduRDefaultValue [0..1]  # Specifies the default value of the I-PDU. Only required for gateway operation and if at least one PDU specified by PduRDestPdu uses TriggerTransmit Data provision. | Represented as an array of IntegerParamDef.
              container PduRDefaultValueElement [0..*]: multiplicity set at pre-compile  # Each value element is represented by the element and the position in an array.
                integer PduRDefaultValueElement: 0..255, set at pre-compile  # The default value consists of a number of elements. Each element is one byte long and the number of elements is specified by SduLength. The position of this parameter in the container is specified by the PduRElementBytePosition parameter.
                integer PduRDefaultValueElementBytePosition: 0..255, set at pre-compile  # This parameter specifies the byte position of the element within the default value
          container PduRSrcPdu  # This container is a subcontainer of PduRRoutingPath and specifies the source of the PDU to be routed.
            integer PduRSourcePduHandleId: 0..65535, scope=ECU, set at pre-compile, symbolic-name-value=true  # PDU identifier assigned by PDU Router.
            boolean PduRSrcPduUpTxConf [0..1]: scope=ECU, multiplicity set at pre-compile, set at pre-compile, default-value=true  # When enabled, the TxConfirmation will be | forwarded to the upper layer. Prerequisites: Lower layer and upper layer support TxConfirmation.This parameter is not supported yet.
            reference PduRSrcPduRef: set at pre-compile, destination=Pdu  # Source PDU reference; reference to unique PDU identifier which shall be used for the requested PDU Router operation.
      container PduRTpBufferTable [0..1]  # This container will specify the needed buffers for gatewaying using TP. It is not connected to the specific routing path destination to allow a more efficient buffer handling.
        integer PduRMaxTpBufferNumber [0..1]: 0..65535, set at pre-compile  # maximum number of TP buffers. But currently PduR templates are not using this parameter, hence Lower multiplicity is changed from 1 to 0
        container PduRTpBuffer [0..*]: multiplicity set at pre-compile  # Specifies a buffer used for gatwaying through TP.
          integer PduRTpBufferLength: 1..65535, set at pre-compile  # Length of the TP buffer in number of bytes
        container PduRTpBufferPool [0..*]  # Specifies a pool of buffers used for gateway through TP.
          integer PduRTpPoolHandleId: 0..65534, set at pre-compile, origin=RB:1:0:0:2016-08-30, with-auto=true  # Unique Handle Id for accessing Buffer Pools
          container PduRTpPoolBuffer [1..*]  # Specifies a buffer used for gateway through TP.
            integer PduRLengthOfTpBufferInPool: 1..65535, set at pre-compile, origin=RB:1:0:0:2016-08-30  # Length of the TP buffer in number of bytes
            integer PduRTpPoolBufferCopies: 1..65535, set at pre-compile, origin=RB:1:0:0:2016-08-30  # The number of copies required for this buffer
      container PduRTxBufferTable [0..1]  # This container contains the buffers used for gatewaying via communication interfaces and for single frames of transport protocols.
        integer PduRMaxTxBufferNumber [0..1]: 0..65535, set at pre-compile  # maximum number of Tx buffers. But currently PduR templates are not using this parameter, hence Lower multiplicity is changed from 1 to 0
        container PduRTxBuffer [0..*]: multiplicity set at pre-compile  # Specifies a buffer used for gatewaying via communication interfaces or for | single frames of transport protocols.
          integer PduRPduMaxLength [0..1]: 1..4294967295, set at pre-compile  # Length of the Tx buffer in bytes. This parameter limits the size of buffered routed PDUs.THis parameter is not supported yet.
          integer PduRTxBufferDepth: 0..255, set at pre-compile  # Number of Pdus that can be stored in the buffer. | If the value is 1, the buffer semantic is "last is best". If the value is greater than 1, the buffer semantic is a FiFo. For TP single frames, the depth is always 1.
          enumeration PduRTxBufferFIFOType [0..1]: {DEFERRED, IMMEDIATE}, set at pre-compile, origin=RB:1:0:0:2016-08-30  # Selects the type of FIFO for the destination buffer for a communication interface. Note that the configuration parameter Depth must not be set to 0 or 1. But currently PduR templates are not using this parameter, hence Lower multiplicity is changed from 1 to 0
          integer PduRTxBufferLength: 1..255, set at pre-compile, origin=RB:1:0:0:2016-08-30  # Length of the Tx buffer in number of bytes
