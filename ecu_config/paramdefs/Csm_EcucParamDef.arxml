AUTOSAR XML (schema 4-2-2)
package /AUTOSAR_Csm/EcucModuleDefs
  module definition Csm [0..1]: refined-module-def=Csm, variants pre-compile  # Configuration of the Csm (CryptoServiceManager) module.
    container CsmCallbacks [0..1]: multiplicity set at post-build  # Container for callback function configurations
      container CsmCallback [0..*]: multiplicity set at pre-compile  # Container for configuration of a callback function
        function name CsmCallbackFunc [0..1]: multiplicity set at pre-compile, set at pre-compile  # Callback function to be called if an asynchronous operation has finished. The corresponding job has to be configured to be processed asynchronously. (If the parameter is left empty and the corresponding job has Rte interfaces enabled, then the callback is handled through an Rte Client Server Port.)
        integer CsmCallbackId [0..1]: 0..4294967294, multiplicity set at pre-compile, set at pre-compile  # Identifier of the callback function.
    container CsmGeneral: multiplicity set at   # Container for common configuration options.
      integer CsmAsymPrivateKeyMaxLength [0..1]: 1..4294967295, multiplicity set at pre-compile, set at pre-compile, with-auto=true  # Maximum length in bytes of an asymmetric public key for all algorithm
      integer CsmAsymPublicKeyMaxLength [0..1]: 1..4294967295, multiplicity set at pre-compile, set at pre-compile, with-auto=true  # Maximum length in bytes of an asymmetric key for all algorithm
      boolean CsmDevErrorDetect: multiplicity set at , set at pre-compile, default-value=false  # Switches the development error detection and notification on or off.
      float CsmMainFunctionPeriod [0..1]: multiplicity set at pre-compile, set at pre-compile  # Specifies the period of main function Csm_MainFunction in seconds.
      integer CsmSymKeyMaxLength [0..1]: 1..4294967295, multiplicity set at pre-compile, set at pre-compile, with-auto=true  # Maximum length in bytes of a symmetric key for all algorithm
      boolean CsmUseDeprecated: multiplicity set at , set at pre-compile, default-value=false  # Decides if the deprecated interfaces shall be used (Backwards combatibility).
      boolean CsmVersionInfoApi: multiplicity set at , set at pre-compile, default-value=false  # Pre-processor switch to enable and disable availability of the API Csm_GetVersionInfo().
      boolean CsmRbAutoFillConfig: multiplicity set at , origin=RB, set at pre-compile, default-value=false  # If this parameter is set to Ture, then Csm generator try to automatically fill missing configuration parameters and connection in Csm, CryIf and Crypto components.
    container CsmJobs [0..1]: multiplicity set at pre-compile  # Container for configuration of CSM jobs.
      container CsmJob [1..*]: multiplicity set at pre-compile  # Container for configuration of CSM job. The container name serves as a symbolic name for the identifier of a job configuration.
        integer CsmJobId [0..1]: 0..4294967294, multiplicity set at pre-compile, set at pre-compile, symbolic-name-value=true  # Identifier of the CSM job
        boolean CsmJobPrimitiveCallbackUpdateNotification [0..1]: multiplicity set at pre-compile, set at pre-compile, default-value=false  # This parameter indicates, whether the callback function shall be called, if the UPDATE operation has been finished.
        integer CsmJobPriority: 0..4294967295, multiplicity set at , set at pre-compile  # Priority of the job.
        boolean CsmJobUsePort: multiplicity set at , set at pre-compile, default-value=false  # Does the job need RTE interfaces?
        reference CsmJobKeyRef [0..1]: multiplicity set at pre-compile, set at pre-compile, destination=CsmKey  # This parameter refers to the key which shall be used for the CsmPrimitive. It's possible to use a CsmKey for different jobs
        reference CsmJobPrimitiveCallbackRef [0..1]: multiplicity set at pre-compile, set at pre-compile, destination=CsmCallback  # This parameter refers to the used CsmCallback.
        reference CsmJobPrimitiveRef: multiplicity set at , set at pre-compile, destination=CsmPrimitives  # This parameter refers to the used CsmPrimitive.
        reference CsmJobQueueRef [0..1]: multiplicity set at pre-compile, set at pre-compile, destination=CsmQueue  # This parameter refers to the queue.
    container CsmKeys [0..1]: multiplicity set at post-build  # Container for CSM key configurations.
      container CsmKey [0..*]: multiplicity set at post-build  # Container for configuration of a CSM key. The container name serves as a symbolic name for the identifier of a key configuration.
        integer CsmKeyId [0..1]: 0..4294967294, multiplicity set at pre-compile, set at pre-compile  # Identifier of the CsmKey
        boolean CsmKeyUsePort: multiplicity set at , set at pre-compile  # Does the key need RTE interfaces?
        enumeration CsmRbAutoConfigCryptoSelect [0..1]: {rba_CryptoBCL, rba_CryptoHSM}, multiplicity set at pre-compile, origin=RB, set at pre-compile  # When automatic configuration completion used for the key, then this parameter needs to be filled out to select the crypto target for the key.
        string CsmRbAutoConfigKeyElement [0..*]: multiplicity set at pre-compile, origin=RB, set at pre-compile  # When automatic configuration completion used for the key, then this parameter needs to be filled out to define keyElements. The configuration needs to be defined in the following format: [elementId]_[P/p(Persistent/Volatile)][R/r(Read allowed / Read denied)][W/w(Write allowed / Write denied)][P/p(Partial access allowed / Partial access denied)]_[Size in bytes]_(optional)[Initvalue as hex string ] Example: 1_PRWp_16_0011 or 1_PRWp_16 ( KeyElementId=1, persistent stored with read/write access, partial access denied, Length=16bytes, (optional) Init Value 0x00, 0x11 )
        symbolic name reference CsmKeyRef [0..1]: multiplicity set at pre-compile, set at pre-compile, destination=CryIfKey  # This parameter refers to the used CryIfKey. The underlying CryIfKey refers to a specific CryptoKey in the Crypto Driver.
    container CsmPrimitives [0..*]: multiplicity set at post-build  # Container for configuration of CsmPrimitives
      enumeration CsmRbAutoConfigCryptoSelect [0..1]: {rba_CryptoBCL, rba_CryptoHSM}, multiplicity set at pre-compile, origin=RB, set at pre-compile  # When automatic configuration completion used for a job-primitive pair, then this parameter needs to be filled out to select the crypto target for the key.
      container CsmAEADDecrypt [0..1]: multiplicity set at post-build  # Configuration of AEAD decryption primitives
        container CsmAEADDecryptConfig: multiplicity set at   # Container for configuration of a CSM decryption interface. The container name serves as a symbolic name for the identifier of an decryption interface.
          enumeration CsmAEADDecryptAlgorithmFamiliy: {CRYPTO_ALGOFAM_3DES, CRYPTO_ALGOFAM_AES, CRYPTO_ALGOFAM_CUSTOM}, multiplicity set at , set at pre-compile  # Determines the algorithm family used for the crypto service. This parameter defines the most significant part of the algorithm.
          string CsmAEADDecryptAlgorithmFamilyCustom [0..1]: multiplicity set at pre-compile, set at pre-compile, with-auto=true  # This is the name of the custom algorithm family, if CRYPTO_ALGOFAM_CUSTOM is used as CsmAEADDecryptAlgorithmFamily.
          integer CsmAEADDecryptAlgorithmKeyLength: 1..4294967295, multiplicity set at , set at pre-compile  # Size of the AEAD decryption key in bytes
          enumeration CsmAEADDecryptAlgorithmMode: {CRYPTO_ALGOMODE_CUSTOM, CRYPTO_ALGOMODE_GCM}, multiplicity set at , set at pre-compile  # Determines the algorithm mode used for the crypto service
          string CsmAEADDecryptAlgorithmModeCustom [0..1]: multiplicity set at pre-compile, set at pre-compile, with-auto=true  # Name of the custom algorithm mode used for the crypto service
          integer CsmAEADDecryptAssociatedDataMaxLength [0..1]: 1..4294967295, multiplicity set at pre-compile, set at pre-compile  # Max size of the input associated data length in bytes
          integer CsmAEADDecryptCiphertextMaxLength [0..1]: 1..4294967295, multiplicity set at pre-compile, set at pre-compile  # Max size of the input ciphertext in bytes
          integer CsmAEADDecryptPlaintextMaxLength [0..1]: 1..4294967295, multiplicity set at pre-compile, set at pre-compile  # Size of the output plaintext length in bytes
          enumeration CsmAEADDecryptProcessing: {CSM_ASYNCHRONOUS, CSM_SYNCHRONOUS}, multiplicity set at , set at pre-compile  # Determines how the interface shall be used for that primitive. Synchronous processing returns with the result while asynchronous processing returns without processing the job. The caller will be notified by the corresponding callback
          integer CsmAEADDecryptTagLength: 1..4294967295, multiplicity set at , set at pre-compile  # Size of the input Tag length in BITS
          reference CsmAEADDecryptKeyRef: multiplicity set at , set at pre-compile, destination=CsmKey  # This parameter refers to the key used for that decryption primitive.
          reference CsmAEADDecryptQueueRef: multiplicity set at , set at pre-compile, destination=CsmQueue  # This parameter refers to the queue used for that decryption primitive.
      container CsmAEADEncrypt [0..1]: multiplicity set at post-build  # Configuration of AEAD encryption primitives
        container CsmAEADEncryptConfig: multiplicity set at   # Container for configuration of a CSM encryption interface. The container name serves as a symbolic name for the identifier of an encryption interface.
          enumeration CsmAEADEncryptAlgorithmFamiliy: {CRYPTO_ALGOFAM_3DES, CRYPTO_ALGOFAM_AES, CRYPTO_ALGOFAM_CUSTOM}, multiplicity set at , set at pre-compile  # Determines the algorithm family used for the crypto service. This parameter defines the most significant part of the algorithm.
          string CsmAEADEncryptAlgorithmFamilyCustom [0..1]: multiplicity set at pre-compile, set at pre-compile, with-auto=true  # This is the name of the custom algorithm family, if CRYPTO_ALGOFAM_CUSTOM is used as CsmAEADEncryptAlgorithmFamily.
          integer CsmAEADEncryptAlgorithmKeyLength: 1..4294967295, multiplicity set at , set at pre-compile  # Size of the AEAD encryption key in bytes
          enumeration CsmAEADEncryptAlgorithmMode: {CRYPTO_ALGOMODE_CUSTOM, CRYPTO_ALGOMODE_GCM}, multiplicity set at , set at pre-compile  # Determines the algorithm mode used for the crypto service
          string CsmAEADEncryptAlgorithmModeCustom [0..1]: multiplicity set at pre-compile, set at pre-compile, with-auto=true  # Name of the custom algorithm mode used for the crypto service
          integer CsmAEADEncryptAssociatedDataMaxLength [0..1]: 1..4294967295, multiplicity set at pre-compile, set at pre-compile  # Max size of the input associated data length in bytes
          integer CsmAEADEncryptCiphertextMaxLength [0..1]: 1..4294967295, multiplicity set at pre-compile, set at pre-compile  # Max size of the output ciphertext length in bytes
          integer CsmAEADEncryptPlaintextMaxLength [0..1]: 1..4294967295, multiplicity set at pre-compile, set at pre-compile  # Max size of the input plaintext length in bytes
          enumeration CsmAEADEncryptProcessing: {CSM_ASYNCHRONOUS, CSM_SYNCHRONOUS}, multiplicity set at , set at pre-compile  # Determines how the interface shall be used for that primitive. Synchronous processing returns with the result while asynchronous processing returns without processing the job. The caller will be notified by the corresponding callback
          integer CsmAEADEncryptTagLength: 1..4294967295, multiplicity set at , set at pre-compile  # Size of the output Tag length in BITS
          reference CsmAEADEncryptKeyRef: multiplicity set at , set at pre-compile, destination=CsmKey  # This parameter refers to the key used for that encryption primitive.
          reference CsmAEADEncryptQueueRef: multiplicity set at , set at pre-compile, destination=CsmQueue  # This parameter refers to the queue used for that encryption primitive.
      container CsmDecrypt [0..1]: multiplicity set at post-build  # Configurations of Decryption primitives
        container CsmDecryptConfig: multiplicity set at   # Container for configuration of a CSM decryption interface. The container name serves as a symbolic name for the identifier of an decryption interface.
          enumeration CsmDecryptAlgorithmFamiliy: {CRYPTO_ALGOFAM_3DES, CRYPTO_ALGOFAM_AES, CRYPTO_ALGOFAM_CHACHA, CRYPTO_ALGOFAM_CUSTOM, CRYPTO_ALGOFAM_ECIES, CRYPTO_ALGOFAM_RSA}, multiplicity set at , set at pre-compile  # Determines the algorithm family used for the crypto service. This parameter defines the most significant part of the algorithm.
          string CsmDecryptAlgorithmFamilyCustom [0..1]: multiplicity set at pre-compile, set at pre-compile, with-auto=true  # Name of the custom algorithm family, if CRYPTO_ALGOFAM_CUSTOM is used as CsmDecryptAlgorithmFamily.
          integer CsmDecryptAlgorithmKeyLength: 1..4294967295, multiplicity set at , set at pre-compile  # Size of the encryption key in bytes
          enumeration CsmDecryptAlgorithmMode: {CRYPTO_ALGOMODE_12ROUNDS, CRYPTO_ALGOMODE_20ROUNDS, CRYPTO_ALGOMODE_8ROUNDS, CRYPTO_ALGOMODE_CBC, CRYPTO_ALGOMODE_CBC_NIST_SP800_38A, CRYPTO_ALGOMODE_CBC_NONE, CRYPTO_ALGOMODE_CBC_PKCS7_v1_5, CRYPTO_ALGOMODE_CFB, CRYPTO_ALGOMODE_CTR, CRYPTO_ALGOMODE_CUSTOM, CRYPTO_ALGOMODE_ECB, CRYPTO_ALGOMODE_OFB, CRYPTO_ALGOMODE_RSAES_OAEP, CRYPTO_ALGOMODE_RSAES_PKCS1_v1_5, CRYPTO_ALGOMODE_XTS}, multiplicity set at , set at pre-compile  # Determines the algorithm mode used for the crypto service
          string CsmDecryptAlgorithmModeCustom [0..1]: multiplicity set at pre-compile, set at pre-compile, with-auto=true  # Name of the custom algorithm mode used for the crypto service
          enumeration CsmDecryptAlgorithmSecondaryFamily: {CRYPTO_ALGOFAM_CUSTOM, CRYPTO_ALGOFAM_NOT_SET}, multiplicity set at , set at pre-compile, default-value=CRYPTO_ALGOFAM_NOT_SET  # Determines the secondary algorithm family used for the crypto service
          string CsmDecryptAlgorithmSecondaryFamilyCustom [0..1]: multiplicity set at pre-compile, set at pre-compile, with-auto=true  # Name of the custom secondary algorithm family used for the crypto service
          integer CsmDecryptDataMaxLength [0..1]: 1..4294967295, multiplicity set at pre-compile, set at pre-compile  # Max size of the input ciphertext length in bytes
          enumeration CsmDecryptProcessing: {CSM_ASYNCHRONOUS, CSM_SYNCHRONOUS}, multiplicity set at , set at pre-compile  # Determines how the interface shall be used for that primitive. Synchronous processing returns with the result while asynchronous processing returns without processing the job. The caller will be notified by the corresponding callback
          integer CsmDecryptResultMaxLength [0..1]: 1..4294967295, multiplicity set at pre-compile, set at pre-compile  # Max size of the output plaintext length in bytes
      container CsmEncrypt [0..1]: multiplicity set at post-build  # Configurations of Encryption primitives
        container CsmEncryptConfig: multiplicity set at   # Container for configuration of a CSM encryption interface. The container name serves as a symbolic name for the identifier of an encryption interface.
          enumeration CsmEncryptAlgorithmFamiliy: {CRYPTO_ALGOFAM_3DES, CRYPTO_ALGOFAM_AES, CRYPTO_ALGOFAM_CHACHA, CRYPTO_ALGOFAM_CUSTOM, CRYPTO_ALGOFAM_ECIES, CRYPTO_ALGOFAM_RSA}, multiplicity set at , set at pre-compile  # Determines the algorithm family used for the crypto service. This parameter defines the most significant part of the algorithm.
          string CsmEncryptAlgorithmFamilyCustom [0..1]: multiplicity set at pre-compile, set at pre-compile, with-auto=true  # This is the name of the custom algorithm family, if CRYPTO_ALGOFAM_CUSTOM is used as CsmEncryptAlgorithmFamily.
          integer CsmEncryptAlgorithmKeyLength: 1..4294967295, multiplicity set at , origin=RB, set at pre-compile  # Size of the encryption key in bytes
          enumeration CsmEncryptAlgorithmMode: {CRYPTO_ALGOMODE_12ROUNDS, CRYPTO_ALGOMODE_20ROUNDS, CRYPTO_ALGOMODE_8ROUNDS, CRYPTO_ALGOMODE_CBC, CRYPTO_ALGOMODE_CBC_NIST_SP800_38A, CRYPTO_ALGOMODE_CBC_NONE, CRYPTO_ALGOMODE_CBC_PKCS7_v1_5, CRYPTO_ALGOMODE_CFB, CRYPTO_ALGOMODE_CTR, CRYPTO_ALGOMODE_CUSTOM, CRYPTO_ALGOMODE_ECB, CRYPTO_ALGOMODE_NOT_SET, CRYPTO_ALGOMODE_OFB, CRYPTO_ALGOMODE_RSAES_OAEP, CRYPTO_ALGOMODE_RSAES_PKCS1_v1_5, CRYPTO_ALGOMODE_XTS}, multiplicity set at , set at pre-compile  # Determines the algorithm mode used for the crypto service
          string CsmEncryptAlgorithmModeCustom [0..1]: multiplicity set at pre-compile, set at pre-compile, with-auto=true  # Name of the custom algorithm mode used for the crypto service
          enumeration CsmEncryptAlgorithmSecondaryFamily: {CRYPTO_ALGOFAM_CUSTOM, CRYPTO_ALGOFAM_NOT_SET}, multiplicity set at , set at pre-compile, default-value=CRYPTO_ALGOFAM_NOT_SET  # Determines the algorithm family used for the crypto service
          string CsmEncryptAlgorithmSecondaryFamilyCustom [0..1]: multiplicity set at pre-compile, set at pre-compile, with-auto=true  # Name of the custom secondary algorithm family used for the crypto service
          integer CsmEncryptDataMaxLength [0..1]: 1..4294967295, multiplicity set at pre-compile, set at pre-compile  # Max size of the input plaintext length in bytes
          enumeration CsmEncryptProcessing: {CSM_ASYNCHRONOUS, CSM_SYNCHRONOUS}, multiplicity set at , set at pre-compile  # Determines how the interface shall be used for that primitive. Synchronous processing returns with the result while asynchronous processing returns without processing the job. The caller will be notified by the corresponding callback
          integer CsmEncryptResultMaxLength [0..1]: 1..4294967295, multiplicity set at pre-compile, set at pre-compile  # Max size of the output cipher length in bytes
      container CsmHash [0..1]: multiplicity set at post-build  # Container for Hash Configurations
        container CsmHashConfig: multiplicity set at   # Container for configuration of a CSM hash. The container name serves as a symbolic name for the identifier of a key configuration.
          enumeration CsmHashAlgorithmFamiliy: {CRYPTO_ALGOFAM_BLAKE_1_256, CRYPTO_ALGOFAM_BLAKE_1_512, CRYPTO_ALGOFAM_BLAKE_2s_256, CRYPTO_ALGOFAM_BLAKE_2s_512, CRYPTO_ALGOFAM_CUSTOM, CRYPTO_ALGOFAM_RIPEMD160, CRYPTO_ALGOFAM_SHA1, CRYPTO_ALGOFAM_SHA2_224, CRYPTO_ALGOFAM_SHA2_256, CRYPTO_ALGOFAM_SHA2_384, CRYPTO_ALGOFAM_SHA2_512, CRYPTO_ALGOFAM_SHA2_512_224, CRYPTO_ALGOFAM_SHA2_512_256, CRYPTO_ALGOFAM_SHA3_224, CRYPTO_ALGOFAM_SHA3_256, CRYPTO_ALGOFAM_SHA3_384, CRYPTO_ALGOFAM_SHA3_512, CRYPTO_ALGOFAM_SHA3_SHAKE128, CRYPTO_ALGOFAM_SHA3_SHAKE256}, multiplicity set at , set at pre-compile  # Determines the algorithm family used for the crypto service. This parameter defines the most significant part of the algorithm.
          string CsmHashAlgorithmFamilyCustom [0..1]: multiplicity set at pre-compile, set at pre-compile, with-auto=true  # This is the name of the custom algorithm family, if CRYPTO_ALGOFAM_CUSTOM is used as CsmHashAlgorithmFamily.
          enumeration CsmHashAlgorithmMode: {CRYPTO_ALGOMODE_CUSTOM, CRYPTO_ALGOMODE_NOT_SET}, multiplicity set at , set at pre-compile, default-value=CRYPTO_ALGOMODE_NOT_SET  # Determines the algorithm mode used for the crypto service
          string CsmHashAlgorithmModeCustom [0..1]: multiplicity set at pre-compile, set at pre-compile, with-auto=true  # Name of the custom primitive mode.
          enumeration CsmHashAlgorithmSecondaryFamily: {CRYPTO_ALGOFAM_CUSTOM, CRYPTO_ALGOFAM_NOT_SET}, multiplicity set at , set at pre-compile, default-value=CRYPTO_ALGOFAM_NOT_SET  # Determines the algorithm family used for the crypto service
          string CsmHashAlgorithmSecondaryFamilyCustom [0..1]: multiplicity set at pre-compile, set at pre-compile, with-auto=true  # This is the second name of the custom algorithm family, if CRYPTO_ALGOFAM_CUSTOM is set as CsmHashAlgorithmSecondaryFamily.
          integer CsmHashDataMaxLength [0..1]: 1..4294967295, multiplicity set at pre-compile, set at pre-compile  # Max size of the input data length in bytes
          enumeration CsmHashProcessing: {CSM_ASYNCHRONOUS, CSM_SYNCHRONOUS}, multiplicity set at , set at pre-compile  # Determines how the interface shall be used for that primitive. Synchronous processing returns with the result while asynchronous processing returns without processing the job. The caller will be notified by the corresponding callback.
          integer CsmHashResultLength: 1..4294967295, multiplicity set at , set at pre-compile  # Size of the output hash length in bytes
      container CsmMacGenerate [0..1]: multiplicity set at post-build  # Configurations of MacGenerate primitives
        container CsmMacGenerateConfig: multiplicity set at   # Container for configuration of a CSM mac generation interface. The container name serves as a symbolic name for the identifier of a MAC generation interface.
          enumeration CsmMacGenerateAlgorithmFamiliy: {CRYPTO_ALGOFAM_3DES, CRYPTO_ALGOFAM_AES, CRYPTO_ALGOFAM_BLAKE_1_256, CRYPTO_ALGOFAM_BLAKE_1_512, CRYPTO_ALGOFAM_BLAKE_2s_256, CRYPTO_ALGOFAM_BLAKE_2s_512, CRYPTO_ALGOFAM_CHACHA, CRYPTO_ALGOFAM_CUSTOM, CRYPTO_ALGOFAM_RIPEMD160, CRYPTO_ALGOFAM_RNG, CRYPTO_ALGOFAM_SHA1, CRYPTO_ALGOFAM_SHA2_224, CRYPTO_ALGOFAM_SHA2_256, CRYPTO_ALGOFAM_SHA2_384, CRYPTO_ALGOFAM_SHA2_512, CRYPTO_ALGOFAM_SHA2_512_224, CRYPTO_ALGOFAM_SHA2_512_256, CRYPTO_ALGOFAM_SHA3_224, CRYPTO_ALGOFAM_SHA3_256, CRYPTO_ALGOFAM_SHA3_384, CRYPTO_ALGOFAM_SHA3_512, CRYPTO_ALGOFAM_SHA3_SHAKE128, CRYPTO_ALGOFAM_SHA3_SHAKE256}, multiplicity set at , set at pre-compile  # Determines the algorithm family used for the crypto service. This parameter defines the most significant part of the algorithm.
          string CsmMacGenerateAlgorithmFamilyCustom [0..1]: multiplicity set at pre-compile, set at pre-compile, with-auto=true  # This is the name of the custom algorithm family,
          integer CsmMacGenerateAlgorithmKeyLength: 1..4294967295, multiplicity set at , set at pre-compile  # Size of the MAC key in bytes
          enumeration CsmMacGenerateAlgorithmMode: {CRYPTO_ALGOMODE_CMAC, CRYPTO_ALGOMODE_CTRDRBG, CRYPTO_ALGOMODE_CUSTOM, CRYPTO_ALGOMODE_GMAC, CRYPTO_ALGOMODE_HMAC, CRYPTO_ALGOMODE_NOT_SET, CRYPTO_ALGOMODE_SIPHASH_2_4, CRYPTO_ALGOMODE_SIPHASH_4_8}, multiplicity set at , set at pre-compile  # Determines the algorithm mode used for the crypto service
          string CsmMacGenerateAlgorithmModeCustom [0..1]: multiplicity set at pre-compile, set at pre-compile, with-auto=true  # Name of the custom algorithm mode used for the crypto service
          enumeration CsmMacGenerateAlgorithmSecondaryFamily: {CRYPTO_ALGOFAM_CUSTOM, CRYPTO_ALGOFAM_NOT_SET}, multiplicity set at , set at pre-compile, default-value=CRYPTO_ALGOFAM_NOT_SET  # Determines the secondary algorithm family used for the crypto service
          string CsmMacGenerateAlgorithmSecondaryFamilyCustom [0..1]: multiplicity set at pre-compile, set at pre-compile, with-auto=true  # This is the second name of the custom algorithm family, if CRYPTO_ALGOFAM_CUSTOM is set as CsmHashAlgorithmSecondaryFamilyCustom.
          integer CsmMacGenerateDataMaxLength [0..1]: 1..4294967295, multiplicity set at pre-compile, set at pre-compile  # Max size of the input data length in bytes
          enumeration CsmMacGenerateProcessing: {CSM_ASYNCHRONOUS, CSM_SYNCHRONOUS}, multiplicity set at , set at pre-compile  # Determines how the interface shall be used for that primitive. Synchronous processing returns with the result while asynchronous processing returns without processing the job. The caller will be notified by the corresponding callback.
          integer CsmMacGenerateResultLength: 1..4294967295, multiplicity set at , set at pre-compile  # Size of the output MAC length in bytes
      container CsmMacVerify [0..1]: multiplicity set at post-build  # Configurations of MacVerify primitives
        container CsmMacVerifyConfig: multiplicity set at   # Container for configuration of a CSM MAC verification interface. The container name serves as a symbolic name for the identifier of a MAC generation interface
          enumeration CsmMacVerifyAlgorithmFamiliy: {CRYPTO_ALGOFAM_AES, CRYPTO_ALGOFAM_BLAKE_1_256, CRYPTO_ALGOFAM_BLAKE_1_512, CRYPTO_ALGOFAM_BLAKE_2s_256, CRYPTO_ALGOFAM_BLAKE_2s_512, CRYPTO_ALGOFAM_CUSTOM, CRYPTO_ALGOFAM_RIPEMD160, CRYPTO_ALGOFAM_SHA1, CRYPTO_ALGOFAM_SHA2_224, CRYPTO_ALGOFAM_SHA2_256, CRYPTO_ALGOFAM_SHA2_384, CRYPTO_ALGOFAM_SHA2_512, CRYPTO_ALGOFAM_SHA2_512_224, CRYPTO_ALGOFAM_SHA2_512_256, CRYPTO_ALGOFAM_SHA3_224, CRYPTO_ALGOFAM_SHA3_256, CRYPTO_ALGOFAM_SHA3_384, CRYPTO_ALGOFAM_SHA3_512, CRYPTO_ALGOFAM_SHA3_SHAKE128, CRYPTO_ALGOFAM_SHA3_SHAKE256, CRYPTO_ALGOFAM_SIPHASH}, multiplicity set at , set at pre-compile  # Determines the algorithm family used for the crypto service. This parameter defines the most significant part of the algorithm.
          string CsmMacVerifyAlgorithmFamilyCustom [0..1]: multiplicity set at pre-compile, set at pre-compile, with-auto=true  # Name of the custom algorithm family used for the crypto service
          enumeration CsmMacVerifyAlgorithmMode: {CRYPTO_ALGOMODE_CMAC, CRYPTO_ALGOMODE_CTRDRBG, CRYPTO_ALGOMODE_CUSTOM, CRYPTO_ALGOMODE_GMAC, CRYPTO_ALGOMODE_HMAC, CRYPTO_ALGOMODE_NOT_SET, CRYPTO_ALGOMODE_SIPHASH_2_4, CRYPTO_ALGOMODE_SIPHASH_4_8}, multiplicity set at , origin=RB, set at pre-compile  # Determines the algorithm mode used for the crypto service
          string CsmMacVerifyAlgorithmModeCustom [0..1]: multiplicity set at pre-compile, origin=RB, set at pre-compile, with-auto=true  # Name of the custom algorithm mode used for the crypto service
          enumeration CsmMacVerifyAlgorithmSecondaryFamily: {CRYPTO_ALGOFAM_CUSTOM, CRYPTO_ALGOFAM_NOT_SET}, multiplicity set at , set at pre-compile, default-value=CRYPTO_ALGOFAM_NOT_SET  # Determines the secondary algorithm family used for the crypto service
          string CsmMacVerifyAlgorithmSecondaryFamilyCustom [0..1]: multiplicity set at pre-compile, set at pre-compile, with-auto=true  # This is the second the name of the custom algorithm, if CRYPTO_ALGOFAM_CUSTOM is set as CsmMacVerifyAlgorithmSecondaryFamily
          integer CsmMacVerifyAlgorithmKeyLength: 1..4294967295, multiplicity set at , origin=RB, set at pre-compile  # Size of the MAC key in bytes
          integer CsmMacVerifyCompareLength: 1..4294967295, multiplicity set at , set at pre-compile  # Size of the input MAC length, that shall be verified, in BITS
          integer CsmMacVerifyDataMaxLength [0..1]: 1..4294967295, multiplicity set at pre-compile, set at pre-compile  # Max size of the input data length, for whichs MAC shall be verified, in bytes
          enumeration CsmMacVerifyProcessing: {CSM_ASYNCHRONOUS, CSM_SYNCHRONOUS}, multiplicity set at , set at pre-compile  # Determines how the interface shall be used for that primitive. Synchronous processing returns with the result while asynchronous processing returns without processing the job. The caller will be notified by the corresponding callback.
      container CsmRandomGenerate [0..1]: multiplicity set at post-build  # Configurations of RandomGenerate primitives
        container CsmRandomGenerateConfig: multiplicity set at   # Container for configuration of a CSM random generator. The container name serves as a symbolic name for the identifier of a random generator configuration.
          enumeration CsmRandomGenerateAlgorithmFamiliy: {CRYPTO_ALGOFAM_3DES, CRYPTO_ALGOFAM_AES, CRYPTO_ALGOFAM_BLAKE_1_256, CRYPTO_ALGOFAM_BLAKE_1_512, CRYPTO_ALGOFAM_BLAKE_2s_256, CRYPTO_ALGOFAM_BLAKE_2s_512, CRYPTO_ALGOFAM_CHACHA, CRYPTO_ALGOFAM_CUSTOM, CRYPTO_ALGOFAM_RIPEMD160, CRYPTO_ALGOFAM_RNG, CRYPTO_ALGOFAM_SHA1, CRYPTO_ALGOFAM_SHA2_224, CRYPTO_ALGOFAM_SHA2_256, CRYPTO_ALGOFAM_SHA2_384, CRYPTO_ALGOFAM_SHA2_512, CRYPTO_ALGOFAM_SHA2_512_224, CRYPTO_ALGOFAM_SHA2_512_256, CRYPTO_ALGOFAM_SHA3_224, CRYPTO_ALGOFAM_SHA3_256, CRYPTO_ALGOFAM_SHA3_384, CRYPTO_ALGOFAM_SHA3_512, CRYPTO_ALGOFAM_SHA3_SHAKE128, CRYPTO_ALGOFAM_SHA3_SHAKE256}, multiplicity set at , set at pre-compile  # Determines the algorithm family used for the crypto service. This parameter defines the most significant part of the algorithm.
          string CsmRandomGenerateAlgorithmFamilyCustom [0..1]: multiplicity set at pre-compile, set at pre-compile, with-auto=true  # Name of the custom algorithm family used for the crypto service. This is the name of the custom algorithm family, if CRYPTO_ALGOFAM_CUSTOM is used as CsmRandomAlgorithmFamily
          enumeration CsmRandomGenerateAlgorithmMode: {CRYPTO_ALGOMODE_CMAC, CRYPTO_ALGOMODE_CTRDRBG, CRYPTO_ALGOMODE_CUSTOM, CRYPTO_ALGOMODE_GMAC, CRYPTO_ALGOMODE_HMAC, CRYPTO_ALGOMODE_NOT_SET, CRYPTO_ALGOMODE_SIPHASH_2_4, CRYPTO_ALGOMODE_SIPHASH_4_8}, multiplicity set at , set at pre-compile  # Determines the algorithm mode used for the crypto service
          string CsmRandomGenerateAlgorithmModeCustom [0..1]: multiplicity set at pre-compile, set at pre-compile, with-auto=true  # Name of the custom algorithm mode used for the crypto service. This is the name of the custom algorithm family, if CRYPTO_ALGOFAM_CUSTOM is used as CsmRandomGenerateAlgorithmFamily.
          enumeration CsmRandomGenerateAlgorithmSecondaryFamily: {CRYPTO_ALGOFAM_CUSTOM, CRYPTO_ALGOFAM_NOT_SET}, multiplicity set at , set at pre-compile  # Determines the algorithm family used for the crypto service
          string CsmRandomGenerateAlgorithmSecondaryFamilyCustom [0..1]: multiplicity set at pre-compile, set at pre-compile, with-auto=true  # Name of the custom secondary algorithm family used for the crypto service. This is the second name of the custom algorithm family, if CRYPTO_ALGOFAM_CUSTOM is set as Csm RandomAlgorithmSecondaryFamily.
          enumeration CsmRandomGenerateProcessing: {CSM_ASYNCHRONOUS, CSM_SYNCHRONOUS}, multiplicity set at , set at pre-compile  # Determines how the interface shall be used for that primitive. Synchronous processing returns with the result while asynchronous processing returns without processing the job. The caller will be notified by the corresponding callback
          integer CsmRandomGenerateResultLength: 1..4294967295, multiplicity set at , set at pre-compile  # Size of the random generate key in bytes
      container CsmRandomSeed [0..1]: multiplicity set at post-build  # Configurations of RandomSeed primitives
        container CsmRandomSeedConfig: multiplicity set at   # Container for configuration of CSM random seed. The container name serves as a symbolic name for the identifier of a random seed configuration.
          enumeration CsmRandomSeedAlgorithmFamiliy: {CRYPTO_ALGOFAM_3DES, CRYPTO_ALGOFAM_AES, CRYPTO_ALGOFAM_BLAKE_1_256, CRYPTO_ALGOFAM_BLAKE_1_512, CRYPTO_ALGOFAM_BLAKE_2s_256, CRYPTO_ALGOFAM_BLAKE_2s_512, CRYPTO_ALGOFAM_CHACHA, CRYPTO_ALGOFAM_CUSTOM, CRYPTO_ALGOFAM_RIPEMD160, CRYPTO_ALGOFAM_RNG, CRYPTO_ALGOFAM_SHA1, CRYPTO_ALGOFAM_SHA2_224, CRYPTO_ALGOFAM_SHA2_256, CRYPTO_ALGOFAM_SHA2_384, CRYPTO_ALGOFAM_SHA2_512, CRYPTO_ALGOFAM_SHA2_512_224, CRYPTO_ALGOFAM_SHA2_512_256, CRYPTO_ALGOFAM_SHA3_224, CRYPTO_ALGOFAM_SHA3_256, CRYPTO_ALGOFAM_SHA3_384, CRYPTO_ALGOFAM_SHA3_512, CRYPTO_ALGOFAM_SHA3_SHAKE128, CRYPTO_ALGOFAM_SHA3_SHAKE256}, multiplicity set at , set at pre-compile  # Determines the algorithm family used for the crypto service. This parameter defines the most significant part of the algorithm.
          string CsmRandomSeedAlgorithmFamilyCustom [0..1]: multiplicity set at pre-compile, set at pre-compile, with-auto=true  # Name of the custom algorithm family used for the crypto service. This is the name of the custom algorithm family, if CRYPTO_ALGOFAM_CUSTOM is used as CsmRandomAlgorithmFamily
          enumeration CsmRandomSeedAlgorithmMode: {CRYPTO_ALGOMODE_CMAC, CRYPTO_ALGOMODE_CTRDRBG, CRYPTO_ALGOMODE_CUSTOM, CRYPTO_ALGOMODE_GMAC, CRYPTO_ALGOMODE_HMAC, CRYPTO_ALGOMODE_NOT_SET, CRYPTO_ALGOMODE_SIPHASH_2_4, CRYPTO_ALGOMODE_SIPHASH_4_8}, multiplicity set at , set at pre-compile  # Determines the algorithm mode used for the crypto service
          string CsmRandomSeedAlgorithmModeCustom [0..1]: multiplicity set at pre-compile, set at pre-compile, with-auto=true  # Name of the custom algorithm mode used for the crypto service. This is the name of the custom algorithm family, if CRYPTO_ALGOFAM_CUSTOM is used as CsmRandomGenerateAlgorithmFamily.
          enumeration CsmRandomSeedAlgorithmSecondaryFamily: {CRYPTO_ALGOFAM_CUSTOM, CRYPTO_ALGOFAM_NOT_SET}, multiplicity set at , set at pre-compile  # Determines the algorithm family used for the crypto service
          string CsmRandomSeedAlgorithmSecondaryFamilyCustom [0..1]: multiplicity set at pre-compile, set at pre-compile, with-auto=true  # Name of the custom secondary algorithm family used for the crypto service. This is the second name of the custom algorithm family, if CRYPTO_ALGOFAM_CUSTOM is set as Csm RandomAlgorithmSecondaryFamily.
          enumeration CsmRandomSeedProcessing: {CSM_ASYNCHRONOUS, CSM_SYNCHRONOUS}, multiplicity set at , set at pre-compile  # Determines how the interface shall be used for that primitive. Synchronous processing returns with the result while asynchronous processing returns without processing the job. The caller will be notified by the corresponding callback
          integer CsmRandomDataMaxLength: 1..4294967295, multiplicity set at , set at pre-compile  # Size of the seed in bytes
      container CsmSecureCounter [0..1]: multiplicity set at post-build  # Configurations of SecureCounter primitives
        container CsmSecureCounterConfig: multiplicity set at   # Container for configuration of a CSM counter. The container name serves as a symbolic name for the identifier of a secure counter configuration.
          reference CsmSecureCounterQueueRef: multiplicity set at , set at pre-compile, destination=CsmQueue  # This parameter refers to the queue used for that secure counter
      container CsmJobKeyExchangeCalcPubVal [0..1]: multiplicity set at post-build  # Configurations of JobKeyExchangeCalcPubVal primitives
        container CsmJobKeyExchangeCalcPubValConfig: multiplicity set at   # Container for configuration of a CSM JobKeyExchangeCalcPubVal interface. The container name serves as a symbolic name for the identifier of JobKeyExchangeCalcPubVal interface.
          enumeration CsmJobKeyExchangeCalcPubValAlgorithmFamiliy: {CRYPTO_ALGOFAM_DH, CRYPTO_ALGOFAM_RSA, CRYPTO_ALGOFAM_CUSTOM}, multiplicity set at , set at pre-compile  # Determines the algorithm family used for the crypto service. This parameter defines the most significant part of the algorithm.
          string CsmJobKeyExchangeCalcPubValAlgorithmFamilyCustom [0..1]: multiplicity set at pre-compile, set at pre-compile, with-auto=true  # Name of the custom algorithm family used for the crypto service.
          enumeration CsmJobKeyExchangeCalcPubValAlgorithmMode: {CRYPTO_ALGOMODE_CUSTOM, CRYPTO_ALGOMODE_NOT_SET}, multiplicity set at , set at pre-compile  # Determines the algorithm mode used for the crypto service
          string CsmJobKeyExchangeCalcPubValAlgorithmModeCustom [0..1]: multiplicity set at pre-compile, set at pre-compile, with-auto=true  # Name of the custom algorithm mode used for the crypto service
          enumeration CsmJobKeyExchangeCalcPubValAlgorithmSecondaryFamily: {CRYPTO_ALGOFAM_CUSTOM, CRYPTO_ALGOFAM_NOT_SET}, multiplicity set at , set at pre-compile, default-value=CRYPTO_ALGOFAM_NOT_SET  # Determines the algorithm mode used for the crypto service
          string CsmJobKeyExchangeCalcPubValAlgorithmSecondaryFamilyCustom [0..1]: multiplicity set at pre-compile, set at pre-compile, with-auto=true  # Name of the custom secondary algorithm family used for the crypto service. This is the second name of the custom algorithm family, if CRYPTO_ALGOFAM_CUSTOM is set as CsmJobKeyExchangeCalcPubValAlgorithmSecondaryFamily.
          enumeration CsmJobKeyExchangeCalcPubValProcessing: {CSM_ASYNCHRONOUS, CSM_SYNCHRONOUS}, multiplicity set at , set at pre-compile  # Determines how the interface shall be used for that primitive. Synchronous processing returns with the result while asynchronous processing returns without processing the job. The caller will be notified by the corresponding callback
          integer CsmJobKeyExchangeCalcPubValDataMaxLength: 1..4294967295, multiplicity set at , set at pre-compile  # Size of the public value in bytes
          integer CsmJobKeyExchangeCalcPubValResultLength: 1..4294967295, multiplicity set at , set at pre-compile  # Size of the calculated public value in bytes
      container CsmJobKeyExchangeCalcSecret [0..1]: multiplicity set at post-build  # Configurations of JobKeyExchangeCalcSecret primitives
        container CsmJobKeyExchangeCalcSecretConfig: multiplicity set at   # Container for configuration of a CSM JobKeyExchangeCalcSecret interface. The container name serves as a symbolic name for the identifier of JobKeyExchangeCalcSecret interface.
          enumeration CsmJobKeyExchangeCalcSecretAlgorithmFamiliy: {CRYPTO_ALGOFAM_DH, CRYPTO_ALGOFAM_RSA, CRYPTO_ALGOFAM_CUSTOM}, multiplicity set at , set at pre-compile  # Determines the algorithm family used for the crypto service. This parameter defines the most significant part of the algorithm.
          string CsmJobKeyExchangeCalcSecretAlgorithmFamilyCustom [0..1]: multiplicity set at pre-compile, set at pre-compile, with-auto=true  # Name of the custom algorithm family used for the crypto service.
          enumeration CsmJobKeyExchangeCalcSecretAlgorithmMode: {CRYPTO_ALGOMODE_CUSTOM, CRYPTO_ALGOMODE_NOT_SET}, multiplicity set at , set at pre-compile  # Determines the algorithm mode used for the crypto service
          string CsmJobKeyExchangeCalcSecretAlgorithmModeCustom [0..1]: multiplicity set at pre-compile, set at pre-compile, with-auto=true  # Name of the custom algorithm mode used for the crypto service
          enumeration CsmJobKeyExchangeCalcSecretAlgorithmSecondaryFamily: {CRYPTO_ALGOFAM_CUSTOM, CRYPTO_ALGOFAM_NOT_SET}, multiplicity set at , set at pre-compile, default-value=CRYPTO_ALGOFAM_NOT_SET  # Determines the algorithm mode used for the crypto service
          string CsmJobKeyExchangeCalcSecretAlgorithmSecondaryFamilyCustom [0..1]: multiplicity set at pre-compile, set at pre-compile, with-auto=true  # Name of the custom secondary algorithm family used for the crypto service. This is the second name of the custom algorithm family, if CRYPTO_ALGOFAM_CUSTOM is set as CsmJobKeyExchangeCalcSecretAlgorithmSecondaryFamily.
          enumeration CsmJobKeyExchangeCalcSecretProcessing: {CSM_ASYNCHRONOUS, CSM_SYNCHRONOUS}, multiplicity set at , set at pre-compile  # Determines how the interface shall be used for that primitive. Synchronous processing returns with the result while asynchronous processing returns without processing the job. The caller will be notified by the corresponding callback
          integer CsmJobKeyExchangeCalcSecretDataMaxLength: 1..4294967295, multiplicity set at , set at pre-compile  # Size of the public value in bytes
      container CsmSignatureGenerate [0..1]: multiplicity set at post-build  # Configurations of SignatureGenerate primitives
        container CsmSignatureGenerateConfig: multiplicity set at   # Container for configuration of a CSM signature generation interface. The container name serves as a symbolic name for the identifier of signature generation interface.
          enumeration CsmSignatureGenerateAlgorithmFamiliy: {CRYPTO_ALGOFAM_BRAINPOOL, CRYPTO_ALGOFAM_CUSTOM, CRYPTO_ALGOFAM_ECCNIST, CRYPTO_ALGOFAM_ED25519, CRYPTO_ALGOFAM_RSA}, multiplicity set at , set at pre-compile  # Determines the algorithm family used for the crypto service. This parameter defines the most significant part of the algorithm.
          string CsmSignatureGenerateAlgorithmFamilyCustom [0..1]: multiplicity set at pre-compile, set at pre-compile, with-auto=true  # Name of the custom algorithm family used for the crypto service.
          enumeration CsmSignatureGenerateAlgorithmMode: {CRYPTO_ALGOMODE_CUSTOM, CRYPTO_ALGOMODE_NOT_SET, CRYPTO_ALGOMODE_RSASSA_PKCS1_v1_5, CRYPTO_ALGOMODE_RSASSA_PSS}, multiplicity set at , set at pre-compile  # Determines the algorithm mode used for the crypto service
          string CsmSignatureGenerateAlgorithmModeCustom [0..1]: multiplicity set at pre-compile, set at pre-compile, with-auto=true  # Name of the custom algorithm mode used for the crypto service
          enumeration CsmSignatureGenerateAlgorithmSecondaryFamily: {CRYPTO_ALGOFAM_BLAKE, CRYPTO_ALGOFAM_CUSTOM, CRYPTO_ALGOFAM_NOT_SET, CRYPTO_ALGOFAM_RIPEMD160, CRYPTO_ALGOFAM_SHA1, CRYPTO_ALGOFAM_SHA2_224, CRYPTO_ALGOFAM_SHA2_256, CRYPTO_ALGOFAM_SHA2_384, CRYPTO_ALGOFAM_SHA2_512, CRYPTO_ALGOFAM_SHA2_512_224, CRYPTO_ALGOFAM_SHA2_512_256, CRYPTO_ALGOFAM_SHA3_224, CRYPTO_ALGOFAM_SHA3_256, CRYPTO_ALGOFAM_SHA3_384, CRYPTO_ALGOFAM_SHA3_512, CRYPTO_ALGOFAM_SHA3_SHAKE128, CRYPTO_ALGOFAM_SHA3_SHAKE256, CRYPTO_ALGOFAM_AES}, multiplicity set at , set at pre-compile, default-value=CRYPTO_ALGOFAM_NOT_SET  # Determines the algorithm mode used for the crypto service
          string CsmSignatureGenerateAlgorithmSecondaryFamilyCustom [0..1]: multiplicity set at pre-compile, set at pre-compile, with-auto=true  # Name of the custom secondary algorithm family used for the crypto service. This is the second name of the custom algorithm family, if CRYPTO_ALGOFAM_CUSTOM is set as CsmSignatureGenerateAlgorithmSecondaryFamily.
          integer CsmSignatureGenerateDataMaxLength [0..1]: 1..4294967295, multiplicity set at pre-compile, set at pre-compile  # Size of the input data length in bytes
          integer CsmSignatureGenerateKeyLength: 1..4294967295, multiplicity set at , set at pre-compile  # Size of the signature generate key in bytes
          enumeration CsmSignatureGenerateProcessing: {CSM_ASYNCHRONOUS, CSM_SYNCHRONOUS}, multiplicity set at , set at pre-compile  # Determines how the interface shall be used for that primitive. Synchronous processing returns with the result while asynchronous processing returns without processing the job. The caller will be notified by the corresponding callback
          integer CsmSignatureGenerateResultLength: 1..4294967295, multiplicity set at , set at pre-compile  # Size of the output signature length in bytes
      container CsmSignatureVerify [0..1]: multiplicity set at post-build  # Configurations of SignatureVerify primitives
        container CsmSignatureVerifyConfig: multiplicity set at   # Container for configuration of a CSM signature verification interface. The container name serves as a symbolic name for the identifier of signature verification interface.
          enumeration CsmSignatureVerifyAlgorithmFamiliy: {CRYPTO_ALGOFAM_BRAINPOOL, CRYPTO_ALGOFAM_CUSTOM, CRYPTO_ALGOFAM_ECCNIST, CRYPTO_ALGOFAM_ED25519, CRYPTO_ALGOFAM_RSA}, multiplicity set at , set at pre-compile  # Determines the algorithm family used for the crypto service. This parameter defines the most significant part of the algorithm.
          string CsmSignatureVerifyAlgorithmFamilyCustom [0..1]: multiplicity set at pre-compile, set at pre-compile, with-auto=true  # Name of the custom algorithm family used for the crypto service. This is the name of the custom algorithm family, if CRYPTO_ALGOFAM_CUSTOM is used as CsmSignatureVerifyAlgorithmFamily.
          enumeration CsmSignatureVerifyAlgorithmMode: {CRYPTO_ALGOMODE_CUSTOM, CRYPTO_ALGOMODE_NOT_SET, CRYPTO_ALGOMODE_RSASSA_PKCS1_v1_5, CRYPTO_ALGOMODE_RSASSA_PSS}, multiplicity set at , set at pre-compile  # Determines the algorithm mode used for the crypto service
          string CsmSignatureVerifyAlgorithmModeCustom [0..1]: multiplicity set at pre-compile, set at pre-compile, with-auto=true  # Name of the custom algorithm mode used for the crypto service
          enumeration CsmSignatureVerifyAlgorithmSecondaryFamily: {CRYPTO_ALGOFAM_BLAKE, CRYPTO_ALGOFAM_CUSTOM, CRYPTO_ALGOFAM_NOT_SET, CRYPTO_ALGOFAM_RIPEMD160, CRYPTO_ALGOFAM_SHA1, CRYPTO_ALGOFAM_SHA2_224, CRYPTO_ALGOFAM_SHA2_256, CRYPTO_ALGOFAM_SHA2_384, CRYPTO_ALGOFAM_SHA2_512, CRYPTO_ALGOFAM_SHA2_512_224, CRYPTO_ALGOFAM_SHA2_512_256, CRYPTO_ALGOFAM_SHA3_224, CRYPTO_ALGOFAM_SHA3_256, CRYPTO_ALGOFAM_SHA3_384, CRYPTO_ALGOFAM_SHA3_512, CRYPTO_ALGOFAM_SHA3_SHAKE128, CRYPTO_ALGOFAM_SHA3_SHAKE256, CRYPTO_ALGOFAM_AES}, multiplicity set at , set at pre-compile  # Determines the algorithm family used for the crypto service. This parameter defines the most significant part of the algorithm.
          string CsmSignatureVerifyAlgorithmSecondaryFamilyCustom [0..1]: multiplicity set at pre-compile, set at pre-compile, with-auto=true  # Name of the custom secondary algorithm family used for the crypto service. This is the name of the custom algorithm family, if CRYPTO_ALGOFAM_CUSTOM is used as CsmSignatureVerifyAlgorithmFamily.
          integer CsmSignatureVerifyCompareLength: 1..4294967295, multiplicity set at , set at pre-compile  # Size of the input data length, for whichs signature shall be verified, in bytes
          integer CsmSignatureVerifyDataMaxLength [0..1]: 1..4294967295, multiplicity set at pre-compile, set at pre-compile  # Size of the input data length, for whichs signature shall be verified, in bytes
          integer CsmSignatureVerifyKeyLength: 1..4294967295, multiplicity set at , origin=RB, set at pre-compile  # Size of the signature verify key in bytes
          enumeration CsmSignatureVerifyProcessing: {CSM_ASYNCHRONOUS, CSM_SYNCHRONOUS}, multiplicity set at , set at pre-compile  # Determines how the interface shall be used for that primitive. Synchronous processing returns with the result while asynchronous processing returns without processing the job. The caller will be notified by the corresponding callback.
    container CsmQueues [0..1]: multiplicity set at post-build  # Container for CSM queue configurations
      container CsmQueue [1..*]: multiplicity set at post-build  # Container for configuration of a CSM queue. The container name serves as a symbolic name for the identifier of a queue configuration.
        integer CsmQueueSize [0..1]: 1..4294967295, multiplicity set at pre-compile, set at pre-compile  # Size of the CsmQueue. If jobs cannot be processed by the underlying hardware since the hardware is busy, the jobs stay in the prioritized queue. If the queue is full, the next job will be rejected.
        symbolic name reference CsmChannelRef [0..1]: multiplicity set at pre-compile, set at pre-compile, destination=CryIfChannel  # Refers to the underlying Crypto Interface channel.
