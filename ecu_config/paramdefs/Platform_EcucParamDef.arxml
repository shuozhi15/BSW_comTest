AUTOSAR XML (schema 4-2-2)
package /AUTOSAR_Platform/EcucModuleDefs
  module definition Platform: category=VENDOR_SPECIFIC_MODULE_DEFINITION, refined-module-def=Platform, variants pre-compile  # CUBAS Central Elements: Platform
    container PlatformRbSettings  # Configuration settings for CUCEL Central Elements module: Platform
      enumeration PlatformRbArRelease: origin=RB:42.1.0.0:2016-10-14, set at pre-compile  # Configuration parameter for the AUTOSAR version/revision | Select the AUTOSAR version/revision the project is based on
        AR42_Rev2  # AUTOSAR Version 4.2 Revison 2
      enumeration PlatformRbCpuBitOrder: origin=RB:2.0.0:2013-06-12, set at pre-compile  # Configuration parameter to choose the bit order of the controller | Choose one of two possible bit orders: MSB_FIRST or LSB_FIRST. The bit order shall not be mixed with the byte order. The bit order is only relevant for definition of the bit order in pictures in specifications of a controller. On software implementation side the bit order has mostly no relevance.
        MSB_FIRST  # MSB_FIRST, Most significant bit is first
        LSB_FIRST  # LSB_FIRST, Low significant bit is first
      enumeration PlatformRbCpuByteOrder: origin=RB:2.0.0:2013-06-12, set at pre-compile  # Configuration parameter to choose the byte order of the controller | Choose one of two possible byte orders: HIGH_BYTE_FIRST or LOW_BYTE_FIRST
        HIGH_BYTE_FIRST  # High bytes are first
        LOW_BYTE_FIRST  # Low bytes are first
      enumeration PlatformRbCpuType: origin=RB:2.0.0:2013-06-12, set at pre-compile  # Configuration parameter to choose the type of a controller | Choose one of three two possible controller types: 8, 16, or 32 bit controller
        CPU_TYPE_8  # 8 bit controller
        CPU_TYPE_16  # 16 bit controller
        CPU_TYPE_32  # 32 bit controller
      enumeration PlatformRbFloatActivation: origin=RB:4.0.0:2018-05-10, set at pre-compile  # Configuration parameter to activate the float data types | If PlatformRbFloatActivation is set to "ALLOW", the float data types are activated. If "SUPPRESS" is chosen the float data types are not generated.
        ALLOW  # ALLOW, float data types are activated
        SUPPRESS  # SUPPRESS, float data types are suppressed
      enumeration PlatformRbFloatdeActivation [0..1]: multiplicity set at pre-compile, origin=RB:2.0.0:2013-06-12, set at pre-compile  # Configuration parameter to deactivate either the float32 or float64 data types | If PlatformRbFloatdeActivation is set to "SUPPRESS_float32", the float32 data type is deactivated. If "SUPPRESS_float64" is chosen the float64 data type is not generated.
        SUPPRESS_float32  # SUPPRESS, only float32 data types is deactivated
        SUPPRESS_float64  # SUPPRESS, only float64 data types is deactivated
      enumeration PlatformRbNativeActivation [0..1]: multiplicity set at pre-compile, origin=RB:4.0.0:2018-05-10, set at pre-compile  # Configuration parameter to activate the Native declaration | If PlatformRbNativeActivation is set to "ALLOW", the native type of the corresponding base type will be generated. If "SUPPRESS" is chosen then the native type will not be generated.
        ALLOW  # ALLOW, native type generation for base types
        SUPPRESS  # SUPPRESS, native type generation for base types
      string PlatformRbNativeBoolean: origin=RB:2.0.0:2013-06-12, set at pre-compile, default-value=static  # Configuration parameter to define the native declaration of the data type boolean | Specify the native declaration which is used by the compiler to define the data type boolean.
      string PlatformRbNativeFloat32: origin=RB:2.0.0:2013-06-12, set at pre-compile, default-value=static  # Configuration parameter to define the native declaration of the data type float32 | Specify the native declaration which is used by the compiler to define the data type float32.
      string PlatformRbNativeFloat64: origin=RB:2.0.0:2013-06-12, set at pre-compile, default-value=static  # Configuration parameter to define the native declaration of the data type float64 | Specify the native declaration which is used by the compiler to define the data type float64.
      string PlatformRbNativeSint16: origin=RB:2.0.0:2013-06-12, set at pre-compile, default-value=static  # Configuration parameter to define the native declaration of the data type sint16 | Specify the native declaration which is used by the compiler to define the data type sint16.
      string PlatformRbNativeSint16Least: origin=RB:2.0.0:2013-06-12, set at pre-compile, default-value=static  # Configuration parameter to define the native declaration of the data type sint16_least | Specify the native declaration which is used by the compiler to define the data type sint16_least.
      string PlatformRbNativeSint32: origin=RB:2.0.0:2013-06-12, set at pre-compile, default-value=static  # Configuration parameter to define the native declaration of the data type sint32 | Specify the native declaration which is used by the compiler to define the data type sint32.
      string PlatformRbNativeSint32Least: origin=RB:2.0.0:2013-06-12, set at pre-compile, default-value=static  # Configuration parameter to define the native declaration of the data type sint32_least | Specify the native declaration which is used by the compiler to define the data type sint32_least.
      string PlatformRbNativeSint64: origin=RB:4.1.2:2014-12-12, set at pre-compile, default-value=static  # Configuration parameter to define the native declaration of the data type Sint64 | Specify the native declaration which is used by the compiler to define the data type Sint64.
      string PlatformRbNativeSint8: origin=RB:2.0.0:2013-06-12, set at pre-compile, default-value=static  # Configuration parameter to define the native declaration of the data type sint8 | Specify the native declaration which is used by the compiler to define the data type sint8.
      string PlatformRbNativeSint8Least: origin=RB:2.0.0:2013-06-12, set at pre-compile, default-value=static  # Configuration parameter to define the native declaration of the data type sint8_least | Specify the native declaration which is used by the compiler to define the data type sint8_least.
      string PlatformRbNativeUint16: origin=RB:2.0.0:2013-06-12, set at pre-compile, default-value=static  # Configuration parameter to define the native declaration of the data type uint16 | Specify the native declaration which is used by the compiler to define the data type uint16.
      string PlatformRbNativeUint16Least: origin=RB:2.0.0:2013-06-12, set at pre-compile, default-value=static  # Configuration parameter to define the native declaration of the data type uint16_least | Specify the native declaration which is used by the compiler to define the data type uint16_least.
      string PlatformRbNativeUint32: origin=RB:2.0.0:2013-06-12, set at pre-compile, default-value=static  # Configuration parameter to define the native declaration of the data type uint32 | Specify the native declaration which is used by the compiler to define the data type uint32.
      string PlatformRbNativeUint32Least: origin=RB:2.0.0:2013-06-12, set at pre-compile, default-value=static  # Configuration parameter to define the native declaration of the data type uint32_least | Specify the native declaration which is used by the compiler to define the data type uint32_least.
      string PlatformRbNativeUint64: origin=RB:4.1.2:2014-12-12, set at pre-compile, default-value=static  # Configuration parameter to define the native declaration of the data type uint64 | Specify the native declaration which is used by the compiler to define the data type uint64.
      string PlatformRbNativeUint8: origin=RB:2.0.0:2013-06-12, set at pre-compile, default-value=static  # Configuration parameter to define the native declaration of the data type uint8 | Specify the native declaration which is used by the compiler to define the data type uint8.
      string PlatformRbNativeUint8Least: origin=RB:2.0.0:2013-06-12, set at pre-compile, default-value=static  # Configuration parameter to define the native declaration of the data type uint8_least | Specify the native declaration which is used by the compiler to define the data type uint8_least.
      string PlatformRbTypeEmitter [0..1]: multiplicity set at pre-compile, origin=RB:2.0.0:2013-06-12, set at pre-compile, default-value=platform  # Configuration parameter for type emitter | To suppress the typedef in RTE specify the typeEmitter attribute with a value other than RTE. By default the value is provided other than RTE which is platform
