AUTOSAR XML (schema 4-2-2)
package /ARPackage_7
  module config Os_0: definition=Os
    OsTask_0 (OsTask): OsTaskPriority=1, OsTaskActivation=1
    OSDEFAULTAPPMODE (OsAppMode)
