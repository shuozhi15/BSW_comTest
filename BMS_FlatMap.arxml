AUTOSAR XML (schema 4-2-2)
package /BMS_FlatView
  flat map BMS_FlatMap
    4 x flat instance descriptor:
      CPT_ComM: upstream-reference=RootSwCompositionPrototype_0.CPT_ComM, ecu-extract-reference=CPT_BMS_FlatView.CPT_ComM
      CPT_swc: upstream-reference=RootSwCompositionPrototype_0.CPT_swc, ecu-extract-reference=CPT_BMS_FlatView.CPT_swc
      DataElements_VariableDataPrototype_0: sw-refresh-timing={cse-code=4, cse-code-factor=1}, upstream-reference=RootSwCompositionPrototype_0.CPT_swc.crash_r.DataElements_VariableDataPrototype_0, ecu-extract-reference=CPT_BMS_FlatView.CPT_swc.crash_r.DataElements_VariableDataPrototype_0
      DataElements_VariableDataPrototype_0_0: sw-refresh-timing={cse-code=4, cse-code-factor=1}, upstream-reference=RootSwCompositionPrototype_0.CPT_swc.soc_p.DataElements_VariableDataPrototype_0, ecu-extract-reference=CPT_BMS_FlatView.CPT_swc.soc_p.DataElements_VariableDataPrototype_0
