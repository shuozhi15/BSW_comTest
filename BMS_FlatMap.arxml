AUTOSAR XML (schema 4-2-2)
package /BMS_FlatView
  flat map BMS_FlatMap
    6 x flat instance descriptor:
      CPT_BswM: upstream-reference=RootSwCompositionPrototype_0.CPT_BswM, ecu-extract-reference=CPT_BMS_FlatView.CPT_BswM
      CPT_ComM: upstream-reference=RootSwCompositionPrototype_0.CPT_ComM, ecu-extract-reference=CPT_BMS_FlatView.CPT_ComM
      CPT_EcuM: upstream-reference=RootSwCompositionPrototype_0.CPT_EcuM, ecu-extract-reference=CPT_BMS_FlatView.CPT_EcuM
      CPT_swc: upstream-reference=RootSwCompositionPrototype_0.CPT_swc, ecu-extract-reference=CPT_BMS_FlatView.CPT_swc
      soc_p: sw-refresh-timing={cse-code=4, cse-code-factor=1}, upstream-reference=RootSwCompositionPrototype_0.CPT_swc.PPortPrototype_0.soc_p, ecu-extract-reference=CPT_BMS_FlatView.CPT_swc.PPortPrototype_0.soc_p
      crash_r: sw-refresh-timing={cse-code=4, cse-code-factor=1}, upstream-reference=RootSwCompositionPrototype_0.CPT_swc.RPortPrototype_0.crash_r, ecu-extract-reference=CPT_BMS_FlatView.CPT_swc.RPortPrototype_0.crash_r
