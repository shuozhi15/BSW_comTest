AUTOSAR XML (schema 4-2-2)
package /ARPackage_6
  module config Rte_0: definition=Rte
    RteGeneration_0 (RteGeneration):
      RteGenerationMode = COMPATIBILITY_MODE
      RteCalibrationSupport = NONE
      RteDevErrorDetect = false
      RteDevErrorDetectUninit = false
      RteGenerationMode = VENDOR_MODE
      RteMeasurementSupport = true
      RteOptimizationMode = RUNTIME
      RteToolChainSignificantCharacters = 127
      RteVfbTraceEnabled = false
    CPT_swc (RteSwComponentInstance): RteSoftwareComponentInstanceRef=CPT_swc
      TimingEvent_10ms (RteEventToTaskMapping): RtePositionInTask=3, RteActivationOffset=0.0, RteMappedToTaskRef=OsTask_0, RteEventRef=TimingEvent_10ms
    5 x RteBswModuleInstance:
      Com: RteBswImplementationRef=Com
        EV_BSWSE_MainFunctionTx (RteBswEventToTaskMapping): RteBswPositionInTask=7, RteBswActivationOffset=0.0, RteBswMappedToTaskRef=OsTask_0, RteBswEventRef=EV_BSWSE_MainFunctionTx
        EV_BSWSE_MainFunctionRx (RteBswEventToTaskMapping): RteBswPositionInTask=5, RteBswActivationOffset=0.0, RteBswMappedToTaskRef=OsTask_0, RteBswEventRef=EV_BSWSE_MainFunctionRx
      CanSM: RteBswImplementationRef=CanSM
        EV_BSWSE_MainFunction (RteBswEventToTaskMapping): RteBswPositionInTask=6, RteBswActivationOffset=0.0, RteBswMappedToTaskRef=OsTask_0, RteBswEventRef=EV_BSWSE_MainFunction
      BSWIMPL_BswM: RteBswImplementationRef=BSWIMPL_BswM
        TE_BswM_MainFunction (RteBswEventToTaskMapping): RteBswPositionInTask=4, RteBswActivationOffset=0.0, RteBswMappedToTaskRef=OsTask_0, RteBswEventRef=TE_BswM_MainFunction
      ComM: RteBswImplementationRef=ComM
        EV_BSWSE_MainFunction_ComMChannel_Can_Network_Channel (RteBswEventToTaskMapping):
          RteBswPositionInTask = 1
          RteBswActivationOffset = 0.0
          RteBswMappedToTaskRef = OsTask_0
          RteBswEventRef = EV_BSWSE_MainFunction_ComMChannel_Can_Network_Channel
      EcuM: RteBswImplementationRef=EcuM
        TE_EcuM_MainFunction (RteBswEventToTaskMapping): RteBswPositionInTask=2, RteBswActivationOffset=0.0, RteBswMappedToTaskRef=OsTask_0, RteBswEventRef=TE_EcuM_MainFunction
