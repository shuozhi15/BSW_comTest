AUTOSAR XML (schema 4-2-2)
package /Rte
  module config Rte
    RteGeneration_0 (RteGeneration):
      RteGenerationMode = COMPATIBILITY_MODE
      RteCalibrationSupport = NONE
      RteDevErrorDetect = false
      RteDevErrorDetectUninit = false
      RteGenerationMode = VENDOR_MODE
      RteMeasurementSupport = true
      RteOptimizationMode = RUNTIME
      RteToolChainSignificantCharacters = 127
      RteVfbTraceEnabled = false
    CanNm (RteBswModuleInstance): RteBswImplementationRef=CanNm
      EV_BSWSE_MainFunction (RteBswEventToTaskMapping): RteBswPositionInTask=5, RteBswActivationOffset=0.0, RteBswMappedToTaskRef=OsTask_10ms, RteBswEventRef=EV_BSWSE_MainFunction
    Com (RteBswModuleInstance): RteBswImplementationRef=Com
      EV_BSWSE_MainFunctionTx (RteBswEventToTaskMapping): RteBswPositionInTask=6, RteBswActivationOffset=0.0, RteBswMappedToTaskRef=OsTask_10ms, RteBswEventRef=EV_BSWSE_MainFunctionTx
      EV_BSWSE_MainFunctionRx (RteBswEventToTaskMapping): RteBswPositionInTask=3, RteBswActivationOffset=0.0, RteBswMappedToTaskRef=OsTask_10ms, RteBswEventRef=EV_BSWSE_MainFunctionRx
    CPT_swc (RteSwComponentInstance): RteSoftwareComponentInstanceRef=CPT_swc
      TimingEvent_10ms (RteEventToTaskMapping): RtePositionInTask=1, RteActivationOffset=0.0, RteMappedToTaskRef=OsTask_10ms, RteEventRef=TimingEvent_10ms
    CanSM (RteBswModuleInstance): RteBswImplementationRef=CanSM
      EV_BSWSE_MainFunction (RteBswEventToTaskMapping): RteBswPositionInTask=4, RteBswActivationOffset=0.0, RteBswMappedToTaskRef=OsTask_10ms, RteBswEventRef=EV_BSWSE_MainFunction
    ComM (RteBswModuleInstance): RteBswImplementationRef=ComM
      EV_BSWSE_MainFunction_ComMChannel_Can_NCluster_Channel (RteBswEventToTaskMapping):
        RteBswPositionInTask = 2
        RteBswActivationOffset = 0.0
        RteBswMappedToTaskRef = OsTask_10ms
        RteBswEventRef = EV_BSWSE_MainFunction_ComMChannel_Can_NCluster_Channel
