AUTOSAR XML (schema 4-2-2)
package /System
  system System: category=SYSTEM_DESCRIPTION, system-version=1.0.0
    system mapping BMS_system
      data-mappings:
        data-element=CPT_swc.RootSwCompositionPrototype_0.crash_r.DataElements_VariableDataPrototype_0, system-signal=TMR_VoltageHV
        data-element=CPT_swc.RootSwCompositionPrototype_0.soc_p.DataElements_VariableDataPrototype_0, system-signal=BMS_BattCellOrder18Vol
      sw-mappings:
        swc to ecu mapping SwcToEcuMapping_0: component=[RootSwCompositionPrototype_0.CPT_swc, RootSwCompositionPrototype_0.CPT_ComM], ecu-instance=BMS
    root-software-compositions:
      root sw composition prototype RootSwCompositionPrototype_0: software-composition=Composition1
