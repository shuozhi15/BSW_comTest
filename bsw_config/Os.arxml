AUTOSAR XML (schema 4-2-2)
package /Os
  module config Os
    OsTask_10ms (OsTask): OsTaskPriority=1, OsTaskActivation=1
    OSDEFAULTAPPMODE (OsAppMode)
