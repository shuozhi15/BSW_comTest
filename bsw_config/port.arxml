AUTOSAR XML (schema 4-2-2)
package /port
  sender receiver interface soc
    data DataElements_VariableDataPrototype_0: type=uint16
  sender receiver interface crash
    data DataElements_VariableDataPrototype_0: type=uint8
