AUTOSAR XML (schema 4-2-2)
package /System_0_EcuExtract
  system EXTR_BMS: category=ECU_EXTRACT, ecu-extract-version=1.0.0, system-version=1.0.0
    system mapping SYSMPG_BMS
      data-mappings:
        data-element=CPT_BMS_FlatView.PPortPrototype_0.soc_p, system-signal=TMR_CurrentHV
        data-element=CPT_BMS_FlatView.RPortPrototype_0.crash_r, system-signal=BMS_SubsymCodeFrameOrder2
      sw-mappings:
        swc to ecu mapping SwcToEcuMapping_0: component=[CPT_BMS_FlatView.CPT_BswM, CPT_BMS_FlatView.CPT_ComM, CPT_BMS_FlatView.CPT_EcuM, CPT_BMS_FlatView.CPT_swc], ecu-instance=BMS
    root-software-compositions:
      root sw composition prototype CPT_BMS_FlatView: flat-map=BMS_FlatMap, software-composition=BMS_FlatView
